## CMakeLists.txt
```
#
# Copyright (c) 2022 Nordic Semiconductor ASA
#
# SPDX-License-Identifier: LicenseRef-Nordic-5-Clause
#

cmake_minimum_required(VERSION 3.20.0)

find_package(Zephyr REQUIRED HINTS $ENV{ZEPHYR_BASE})
project(nrf_wfa_dut)

set(WIFI_NRF_DRV_BASE ${WEST_TOPDIR}/nrf/drivers/wifi/nrf700x)


target_include_directories(app
	PUBLIC
	${ZEPHYR_BASE}/subsys/net/ip
	${WIFI_NRF_DRV_BASE}/inc
	${CMAKE_SOURCE_DIR}/inc
	${ZEPHYR_BASE}/include/zephyr/posix
	)

#zephyr_library_compile_definitions(
	#	COMMAND_BYTE_STREAM
	#)

zephyr_library_compile_definitions(WFA_STA_TB)

zephyr_library_compile_definitions_ifdef(CONFIG_WFA_DUT_UART
	WFA_DUT_UART
	)

# set ccflags to "-w"
zephyr_compile_options(-w)

target_sources(app PRIVATE
	src/wifi_main.c
	src/wfa_dut_shell.c
	src/dut/wfa_sock.c
	src/dut/wfa_tg.c
	src/dut/wfa_cs.c
	src/dut/wfa_ca_resp.c
	src/dut/wfa_tlv.c
	src/dut/wfa_typestr.c
	src/dut/wfa_cmdtbl.c
	src/dut/wfa_cmdproc.c
	src/dut/wfa_miscs.c
	src/dut/wfa_thr.c
	src/dut/wfa_wmmps.c
	src/dut/wfa_dut_init.c
	src/dut/wfa_dut.c
)
```

## Kconfig
```
# Copyright (c) 2023 Nordic Semiconductor ASA
#
# SPDX-License-Identifier: LicenseRef-Nordic-5-Clause
#
source "Kconfig.zephyr"

config WFA_DUT_UART
    bool "Use UART to communicate with CA"

# POSIX thread priority for WMM threads
# Zephyr thread priority is calculated as (15 - WFA_WMM_THREAD_PRIO_x)
config WFA_WMM_THREAD_PRIO_BE
    int "WMM priority for BE"
    default 0
    range 0 15

config WFA_WMM_THREAD_PRIO_BK
    int "WMM priority for BK"
    default 3
    range 0 15

config WFA_WMM_THREAD_PRIO_VI
    int "WMM priority for VI"
    default 12
    range 0 15

config WFA_WMM_THREAD_PRIO_VO
    int "WMM priority for VO"
    default 15
    range 0 15

config WFA_WMM_THREAD_PRIO_RX
    int "WMM priority for RX"
    default 0
    range 0 15

config WFA_DUT_IFACE
    string "Primary DUT interface"
    default "wlan0"

config WFA_DUT_PORT
    int "DUT port"
    default 8000
```

## prj.conf
```kconfig
#
# Copyright (c) 2022 Nordic Semiconductor ASA
#
# SPDX-License-Identifier: LicenseRef-Nordic-5-Clause
#
CONFIG_WIFI=y
CONFIG_WIFI_NRF700X=y

# WPA supplicant
CONFIG_WPA_SUPP=y
CONFIG_NET_L2_WIFI_SHELL=y

# WPA_CLI
CONFIG_WPA_CLI=y

# System settings
CONFIG_NEWLIB_LIBC=y
CONFIG_NEWLIB_LIBC_NANO=n

# Networking
CONFIG_NETWORKING=y
CONFIG_NET_SOCKETS=y
CONFIG_NET_LOG=y
CONFIG_NET_IPV6=y
CONFIG_NET_IPV4=y
CONFIG_NET_UDP=y
CONFIG_NET_TCP=y
CONFIG_NET_DHCPV4=n
CONFIG_DNS_RESOLVER=y
CONFIG_NET_SOCKETS_POSIX_NAMES=y
CONFIG_PTHREAD_IPC=y
CONFIG_POSIX_FS=y
CONFIG_FILE_SYSTEM=y
CONFIG_FILE_SYSTEM_SHELL=y
CONFIG_FILE_SYSTEM_LITTLEFS=y
CONFIG_POSIX_MAX_FDS=16

CONFIG_NET_STATISTICS=y
CONFIG_NET_STATISTICS_WIFI=y
CONFIG_NET_STATISTICS_USER_API=y

CONFIG_NET_PKT_RX_COUNT=8
CONFIG_NET_PKT_TX_COUNT=8

# Below section is the primary contributor to SRAM and is currently
# tuned for performance, but this will be revisited in the future.
CONFIG_NET_BUF_RX_COUNT=16
CONFIG_NET_BUF_TX_COUNT=16
CONFIG_NET_BUF_DATA_SIZE=1500
CONFIG_HEAP_MEM_POOL_SIZE=153600
CONFIG_NET_TC_TX_COUNT=1
CONFIG_NET_TC_RX_COUNT=1

CONFIG_NET_IF_UNICAST_IPV6_ADDR_COUNT=4
CONFIG_NET_IF_MCAST_IPV6_ADDR_COUNT=5
CONFIG_NET_MAX_CONTEXTS=16
CONFIG_NET_CONTEXT_SYNC_RECV=y

# Due to memory constraints, we need to limit the number of threads as per WFA cert tests
# Should be same as WFA_THREADS_NUM
CONFIG_MAX_PTHREAD_COUNT=4
# Every pthread_create needs a mutex, and WFA DUT needs an extra mutex/thread
# CONFIG_MAX_PTHREAD_COUNT * 2
CONFIG_MAX_PTHREAD_MUTEX_COUNT=8
# Same as above: CONFIG_MAX_PTHREAD_COUNT * 2
CONFIG_MAX_PTHREAD_COND_COUNT=8
CONFIG_NET_IF_MAX_IPV4_COUNT=3
CONFIG_NET_IF_MAX_IPV6_COUNT=3

CONFIG_INIT_STACKS=y

CONFIG_NET_L2_ETHERNET=y
CONFIG_NET_SHELL=y

CONFIG_NET_IPV4=y
CONFIG_NET_CONFIG_SETTINGS=y
CONFIG_NET_CONFIG_MY_IPV6_ADDR="2001:db8::1"
CONFIG_NET_CONFIG_PEER_IPV6_ADDR="2001:db8::2"
#CONFIG_NET_CONFIG_MY_IPV4_ADDR="192.165.100.150"
#CONFIG_NET_CONFIG_PEER_IPV4_ADDR="192.165.100.1"
CONFIG_NET_SOCKETS_POLL_MAX=4
# Memories
CONFIG_MAIN_STACK_SIZE=4096
CONFIG_SHELL_STACK_SIZE=4096
CONFIG_SYSTEM_WORKQUEUE_STACK_SIZE=2048
CONFIG_NET_TX_STACK_SIZE=2048
CONFIG_NET_RX_STACK_SIZE=2048
CONFIG_WPA_SUPP_THREAD_STACK_SIZE=6144
CONFIG_NET_MGMT_EVENT_STACK_SIZE=2048
CONFIG_SHELL_CMD_BUFF_SIZE=300

# Debugging
CONFIG_STACK_SENTINEL=y
CONFIG_DEBUG_COREDUMP=y
CONFIG_DEBUG_COREDUMP_BACKEND_LOGGING=y
CONFIG_DEBUG_COREDUMP_MEMORY_DUMP_MIN=y
CONFIG_SHELL_CMDS_RESIZE=n
#CONFIG_DEBUG=y
CONFIG_WPA_SUPP_LOG_LEVEL_INF=y

# Kernel options
CONFIG_ENTROPY_GENERATOR=y

# Logging
CONFIG_LOG=y
CONFIG_PRINTK=y
CONFIG_SHELL=y
CONFIG_SHELL_GETOPT=y
CONFIG_DEVICE_SHELL=y
CONFIG_POSIX_CLOCK=y
CONFIG_DATE_SHELL=y
CONFIG_NET_CONFIG_AUTO_INIT=n

CONFIG_WIFI_MGMT_EXT=n
CONFIG_WIFI_CREDENTIALS=n
CONFIG_WIFI_CREDENTIALS_BACKEND_SETTINGS=y
CONFIG_FLASH=y
CONFIG_FLASH_PAGE_LAYOUT=y
CONFIG_FLASH_MAP=y
CONFIG_NVS=y
CONFIG_SETTINGS=y
CONFIG_SETTINGS_NVS=y

CONFIG_NET_MGMT_EVENT_QUEUE_SIZE=150
CONFIG_NRF700X_WORKQ_MAX_ITEMS=1000
CONFIG_NRF_WIFI_LOW_POWER=n
CONFIG_NET_CONTEXT_DSCP_ECN=y

CONFIG_NRF700X_IRQ_WQ_PRIORITY=0
CONFIG_NRF700X_BH_WQ_PRIORITY=0

CONFIG_SHELL_BACKEND_SERIAL_RX_RING_BUFFER_SIZE=512
CONFIG_NRF700X_UTIL=y
# Some tests have > MTU size packets
CONFIG_NET_IPV4_FRAGMENT=y
CONFIG_NET_IPV4_FRAGMENT_MAX_COUNT=2
# Some tests have payload of 20K
CONFIG_NET_IPV4_FRAGMENT_MAX_PKT=20
CONFIG_WFA_WMM_THREAD_PRIO_RX=15
CONFIG_WPA_SUPP_EAPOL=y
CONFIG_NET_ZPERF_MAX_PACKET_SIZE=1500
CONFIG_SYS_HEAP_RUNTIME_STATS=y
```

## overlay-loopback.conf
```kconfig
CONFIG_NET_DRIVERS=y
CONFIG_NET_LOOPBACK=y
CONFIG_NET_LOOPBACK_MTU=1200
# Enable for testing TX only
CONFIG_NET_LOOPBACK_SIMULATE_PACKET_DROP=y

CONFIG_NET_BUF_DATA_SIZE=1100
# Optimized networking settings for performance
CONFIG_NET_PKT_RX_COUNT=32
CONFIG_NET_PKT_TX_COUNT=48
CONFIG_NET_BUF_RX_COUNT=32
CONFIG_NET_BUF_TX_COUNT=96
```

## overlay-tracing.conf
```kconfig
CONFIG_TRACING=y
CONFIG_PERCEPIO_TRACERECORDER=y

CONFIG_TRACING_ASYNC=y
CONFIG_TRACING_THREAD_STACK_SIZE=1024
CONFIG_TRACING_THREAD_WAIT_THRESHOLD=100
CONFIG_TRACING_BUFFER_SIZE=2048
CONFIG_TRACING_PACKET_MAX_SIZE=32
CONFIG_TRACING_BACKEND_UART=y
CONFIG_TRACING_CMD_BUFFER_SIZE=32


CONFIG_TRACING_SYSCALL=y
CONFIG_TRACING_THREAD=y
CONFIG_TRACING_WORK=y
CONFIG_TRACING_ISR=y
CONFIG_TRACING_SEMAPHORE=y
CONFIG_TRACING_MUTEX=y
CONFIG_TRACING_CONDVAR=y
CONFIG_TRACING_QUEUE=y
CONFIG_TRACING_FIFO=y
CONFIG_TRACING_LIFO=y
CONFIG_TRACING_STACK=y
CONFIG_TRACING_MESSAGE_QUEUE=y
CONFIG_TRACING_MAILBOX=y
CONFIG_TRACING_PIPE=y
CONFIG_TRACING_HEAP=y
CONFIG_TRACING_MEMORY_SLAB=y
CONFIG_TRACING_TIMER=y
CONFIG_TRACING_EVENT=y
```

## overlay-zperf-netusb.conf
```kconfig
CONFIG_NET_ZPERF=y
# Optimized networking settings for performance
CONFIG_NET_PKT_RX_COUNT=20
CONFIG_NET_PKT_TX_COUNT=17
CONFIG_NET_BUF_RX_COUNT=20
CONFIG_NET_BUF_TX_COUNT=34
CONFIG_HEAP_MEM_POOL_SIZE=170000
CONFIG_NET_BUF_DATA_SIZE=1500

CONFIG_NRF700X_QSPI_LOW_POWER=n
CONFIG_SPEED_OPTIMIZATIONS=y

# For netusb WFA_THREADS_NUM
CONFIG_MAX_PTHREAD_COUNT=5
# Every pthread_create needs a mutex, and WFA DUT needs an extra mutex/thread
# CONFIG_MAX_PTHREAD_COUNT * 2
CONFIG_MAX_PTHREAD_MUTEX_COUNT=10
# Same as above: CONFIG_MAX_PTHREAD_COUNT * 2
CONFIG_MAX_PTHREAD_COND_COUNT=10
# Consumes more memory
CONFIG_WIFI_CREDENTIALS=n
CONFIG_FLASH=n
CONFIG_NVS=n
CONFIG_SETTINGS=n
```

## overlay-zperf.conf
```kconfig
CONFIG_NET_ZPERF=y
# Optimized networking settings for performance
CONFIG_NET_PKT_RX_COUNT=24
CONFIG_NET_PKT_TX_COUNT=20
CONFIG_NET_BUF_RX_COUNT=24
CONFIG_NET_BUF_TX_COUNT=40
CONFIG_HEAP_MEM_POOL_SIZE=170000
CONFIG_NET_BUF_DATA_SIZE=1500

CONFIG_NRF700X_QSPI_LOW_POWER=n
#CONFIG_SPEED_OPTIMIZATIONS=y
CONFIG_NRF700X_RX_NUM_BUFS=24

# Consumes more memory
CONFIG_WIFI_CREDENTIALS=n
CONFIG_FLASH=n
CONFIG_NVS=n
CONFIG_SETTINGS=n
```

## inc/wfa_main.h
```c
/****************************************************************************
*
* Copyright (c) 2016 Wi-Fi Alliance
*
* Permission to use, copy, modify, and/or distribute this software for any
* purpose with or without fee is hereby granted, provided that the above
* copyright notice and this permission notice appear in all copies.
*
* THE SOFTWARE IS PROVIDED "AS IS" AND THE AUTHOR DISCLAIMS ALL WARRANTIES
* WITH REGARD TO THIS SOFTWARE INCLUDING ALL IMPLIED WARRANTIES OF
* MERCHANTABILITY AND FITNESS. IN NO EVENT SHALL THE AUTHOR BE LIABLE FOR ANY
* SPECIAL, DIRECT, INDIRECT, OR CONSEQUENTIAL DAMAGES OR ANY DAMAGES WHATSOEVER
* RESULTING FROM LOSS OF USE, DATA OR PROFITS, WHETHER IN AN ACTION OF CONTRACT,
* NEGLIGENCE OR OTHER TORTIOUS ACTION, ARISING OUT OF OR IN CONNECTION WITH THE
* USE OR PERFORMANCE OF THIS SOFTWARE.
*
*****************************************************************************/


#ifndef _WFA_MAIN_H
#define _WFA_MAIN_H

#ifdef WFA_PC_CONSOLE
#define WFA_MAX_TRAFFIC_STREAMS           32

/* WMM THREADS NUMBER */
#define WFA_THREADS_NUM   32
#else /* for STAION */
#define WFA_MAX_TRAFFIC_STREAMS           8

/* WMM THREADS NUMBER */
#define WFA_THREADS_NUM   4
#endif

#define MAX_CMD_BUFF        1024
#define MAX_PARMS_BUFF      1024 //IMG

#define MAX_TRAFFIC_BUF_SZ  1536

#define WFA_BUFF_32         32
#define WFA_BUFF_64         64
#define WFA_BUFF_128        128
#define WFA_BUFF_512        512
#define WFA_BUFF_1K         1024
#define WFA_BUFF_4K         4096

#ifdef WFA_PC_CONSOLE
#define WFA_RESP_BUF_SZ    WFA_BUFF_4K
#else
#define WFA_RESP_BUF_SZ    WFA_BUFF_4K
#endif

#define WFA_CMD_STR_SZ      512

#include <zephyr/net/wifi_mgmt.h>

#define WFA_SHELL_MGMT_EVENTS (NET_EVENT_WIFI_SCAN_RESULT | NET_EVENT_WIFI_SCAN_DONE)

enum tg_port
{
    UDP_PORT_BE1 = 0,
    UDP_PORT_BE2 = 1,
    UDP_PORT_BK1 = 2,
    UDP_PORT_BK2 = 3,
    UDP_PORT_VI1 = 4,
    UDP_PORT_VI2 = 5,
    UDP_PORT_VO1 = 6,
    UDP_PORT_VO2 = 7,
    UDP_PORT_ND1 = 8,
    UDP_PORT_ND2 = 9
};

#ifndef _WINDOWS
#define min(a,b)        ((a) < (b) ? (a) : (b))
#define max(a,b)        ((a) > (b) ? (a) : (b))

#endif
#endif
```

## inc/wfa_miscs.h
```c
/****************************************************************************
*
* Copyright (c) 2016 Wi-Fi Alliance
*
* Permission to use, copy, modify, and/or distribute this software for any
* purpose with or without fee is hereby granted, provided that the above
* copyright notice and this permission notice appear in all copies.
*
* THE SOFTWARE IS PROVIDED "AS IS" AND THE AUTHOR DISCLAIMS ALL WARRANTIES
* WITH REGARD TO THIS SOFTWARE INCLUDING ALL IMPLIED WARRANTIES OF
* MERCHANTABILITY AND FITNESS. IN NO EVENT SHALL THE AUTHOR BE LIABLE FOR ANY
* SPECIAL, DIRECT, INDIRECT, OR CONSEQUENTIAL DAMAGES OR ANY DAMAGES WHATSOEVER
* RESULTING FROM LOSS OF USE, DATA OR PROFITS, WHETHER IN AN ACTION OF CONTRACT,
* NEGLIGENCE OR OTHER TORTIOUS ACTION, ARISING OUT OF OR IN CONNECTION WITH THE
* USE OR PERFORMANCE OF THIS SOFTWARE.
*
*****************************************************************************/


#ifndef _WFA_MISCS_H_
#define _WFA_MISCS_H_

extern int isString(char *);
extern int isNumber(char *);
extern int isIpV4Addr(char *);
extern inline double wfa_timeval2double(struct timeval *tval);
extern inline void wfa_double2timeval(struct timeval *tval, double dval);
extern inline double wfa_ftime_diff(struct timeval *t1, struct timeval *t2);
extern int wfa_itime_diff(struct timeval *t1, struct timeval *t2);
extern void int2BuffBigEndian(int val, char *buf);
extern inline int bigEndianBuff2Int(char *buff);

#endif
```

## inc/wfa_portall.h
```c
/****************************************************************************
*
* Copyright (c) 2016 Wi-Fi Alliance
*
* Permission to use, copy, modify, and/or distribute this software for any
* purpose with or without fee is hereby granted, provided that the above
* copyright notice and this permission notice appear in all copies.
*
* THE SOFTWARE IS PROVIDED "AS IS" AND THE AUTHOR DISCLAIMS ALL WARRANTIES
* WITH REGARD TO THIS SOFTWARE INCLUDING ALL IMPLIED WARRANTIES OF
* MERCHANTABILITY AND FITNESS. IN NO EVENT SHALL THE AUTHOR BE LIABLE FOR ANY
* SPECIAL, DIRECT, INDIRECT, OR CONSEQUENTIAL DAMAGES OR ANY DAMAGES WHATSOEVER
* RESULTING FROM LOSS OF USE, DATA OR PROFITS, WHETHER IN AN ACTION OF CONTRACT,
* NEGLIGENCE OR OTHER TORTIOUS ACTION, ARISING OUT OF OR IN CONNECTION WITH THE
* USE OR PERFORMANCE OF THIS SOFTWARE.
*
*****************************************************************************/

/* The fixed definition for the device interface name */
/* For different OSes or your platforms, you may not  */
/* need to use fixed definition                       */
#define WFA_STAUT_IF        "wlan0"

/* the path to store EAP certificates. This is used   */
/* for Linux-like OS for wpa_supplicant               */
#define CERTIFICATES_PATH    "/etc/wpa_supplicant"


#define wSTRNCPY(dstr, sstr, len) \
                           strncpy(dstr, sstr, len)

#define wSTRCPY(dstr, sstr) \
                           strcpy(dstr, sstr)

#define wSTRNCPY(dstr, sstr, len) \
                           strncpy(dstr, sstr, len)

#define wSTRNCMP(str1, str2, size) \
                           strncmp(str1, str2, size)

#define wSTRLEN(str)     \
                           strlen(str)

#define wSOCKET(family, type, protocol) \
                           socket(family, type, protocol)

#define wSELECT(maxfdn, rsockSet, wsockSet, exceptSet, timer)  \
                           select(maxfdn, rsockSet, wsockSet, exceptSet, timer)

#define wSETSOCKOPT(sock, level, optname, optval, optlen) \
                           setsockopt(sock, level, optname, optval, optlen)

#define wBIND(sock, sockaddr, sizeaddr) \
                           bind(sock, sockaddr, sizeaddr)

#define wLISTEN(sock, maxnumpending)  \
                           listen(sock, maxnumpending)

#define wBZERO(ap, memsize) \
                           bzero(ap, memsize)

#define wCONNECT(sock, peeraddr, sizeaddr) \
                           connect(sock, peeraddr, sizeaddr)

#define wACCEPT(sock, addr, sizeaddr) \
                           accept(sock, addr, sizeaddr)

#define wSEND(sock, buf, len, flag) \
                           send(sock, buf, len, flag)

#define wSENDTO(sock, buf, len, flag, toaddr, sizeaddr) \
                           sendto(sock, buf, len, flag, toaddr, sizeaddr)

#define wRECV(sock, buf, len, flag) \
                           recv(sock, buf, len, flag)

#define wRECVFROM(sock, buf, len, flag, fromaddr, sizeaddr) \
                           recvfrom(sock, buf, len, flag, fromaddr, sizeaddr)


#define wFCNTL(fd, cmd, args) \
                           fcntl(fd, cmd, args)

#define wSYSTEM(cmd) \
			   system(cmd)

#define wSPRINTF(buf, format...) \
			   sprintf(buf, ## format)

#define wIOCTL(fd, cmd, intf) \
                           ioctl(fd, cmd, intf)

#define wMALLOC(size)  \
                           k_malloc(size)

#define wMEMCPY(dp, sp, size) \
                           memcpy(dp, sp, size)

#define wMEMSET(memp, val, size)  \
                           memset(memp, val, size)

#define wFREE(memp)      \
                           k_free(memp);

#define wGETTIMEOFDAY(tmval, zone) \
                           gettimeofday(tmval, zone)

#define wSETTIMEOFDAY(tmval, zone) \
                           settimeofday(tmval, zone)

#define wSIGNAL(signum, sighandler) \
                           signal(signum, sighandler)

#define wALARM(duration) \
                           alarm(duration)

#define wCLOSE(fd)       \
                           close(fd);

#define wUSLEEP(usecs)   \
                           usleep(usecs)


#define wSLEEP(secs)   \
                           sleep(secs)

#define wEXIT(num)     \
                           exit(num)

#define wATOI(c)       \
                           atoi(c)

#define wSHUTDOWN(fd, type)      \
                           shutdown(fd, type)

#define wGETSOFD(sockfd, proto, tosval, ptosval, psize) \
                           getsockopt(sockfd, proto, tosval, ptosval, psize)

#define wPT_ATTR_INIT(ptattr) \
                           pthread_attr_init(ptattr)

#define wPT_ATTR_SETSCH(ptattr, policy) \
                           pthread_attr_setschedpolicy(ptattr, policy)

#define wPT_ATTR_SETSCHPARAM(ptattr, param) \
                           pthread_attr_setschedparam(ptattr, param)

#define wPT_MUTEX_LOCK(lock) \
                           pthread_mutex_lock(lock)

#define wPT_MUTEX_UNLOCK(lock) \
                           pthread_mutex_unlock(lock)

#define wFFLUSH(out) \
                           fflush(out)

#define wPT_COND_SIGNAL(signal) \
                           pthread_cond_signal(signal)

#define wPT_COND_WAIT(pcond, pmlock) \
                           pthread_cond_wait(pcond, pmlock)

#define wPT_MUTEX_INIT(pmlock, initval) \
                           pthread_mutex_init(pmlock, initval)

#define wPT_COND_INIT(pcond, initval) \
                           pthread_cond_init(pcond, initval)

#define wPT_CREATE(t, ptattr, func, pdata) \
                           pthread_create(t, ptattr, func, pdata)


typedef struct _memblock
{
    int id;
    int size;    /* number of blocks 512 byte/block */
    void *mem;
} wfaMemBlk_t;
```

## inc/wfa_rsp.h
```c
/****************************************************************************
*
* Copyright (c) 2016 Wi-Fi Alliance
*
* Permission to use, copy, modify, and/or distribute this software for any
* purpose with or without fee is hereby granted, provided that the above
* copyright notice and this permission notice appear in all copies.
*
* THE SOFTWARE IS PROVIDED "AS IS" AND THE AUTHOR DISCLAIMS ALL WARRANTIES
* WITH REGARD TO THIS SOFTWARE INCLUDING ALL IMPLIED WARRANTIES OF
* MERCHANTABILITY AND FITNESS. IN NO EVENT SHALL THE AUTHOR BE LIABLE FOR ANY
* SPECIAL, DIRECT, INDIRECT, OR CONSEQUENTIAL DAMAGES OR ANY DAMAGES WHATSOEVER
* RESULTING FROM LOSS OF USE, DATA OR PROFITS, WHETHER IN AN ACTION OF CONTRACT,
* NEGLIGENCE OR OTHER TORTIOUS ACTION, ARISING OUT OF OR IN CONNECTION WITH THE
* USE OR PERFORMANCE OF THIS SOFTWARE.
*
*****************************************************************************/


#ifndef WFA_RSP_H
#define WFA_RSP_H

#include "wfa_ver.h"

#ifdef WFA_WMM_VOICE
#define WFA_INFO_BUFSIZE       128   /* used to upload test data */
#else
#define WFA_INFO_BUFSIZE       128   /* used to upload test data */
#endif

typedef struct _tg_ping_stop_resp
{
    int sendCnt;
    int repliedCnt;
} tgPingStopResp_t;

typedef struct ca_sta_get_ipconfig_resp
{
    int isDhcp;
    char ipaddr[WFA_IP_ADDR_STR_LEN];
    char mask[WFA_IP_MASK_STR_LEN];
    char dns[WFA_MAX_DNS_NUM][WFA_IP_ADDR_STR_LEN];
    char mac[WFA_MAC_ADDR_STR_LEN];

} caStaGetIpConfigResp_t;

typedef struct ca_sta_get_stats_resp
{
    int status;
    int txFrames;
    int rxFrames;
    int txMulticast;
    int rxMulticast;
    int fcsErrors ;
    int txRetries;
} caStaGetStatsResp_t;

typedef struct ca_device_get_info_resp
{
    char vendor[16];
    char model[16];
    char version[WFA_VERNAM_LEN];
    char firmware[16];
} caDeviceGetInfoResp_t;

typedef struct ca_sta_upload_resp
{
    short seqnum;
    short nbytes;
    char bytes[256];
} caStaUploadResp_t;

typedef struct ca_device_list_if_resp
{
    int status;
#define IF_80211   1
#define IF_ETH     2
    int iftype;
    char ifs[3][16];
} caDeviceListIFResp_t;

typedef struct ca_sta_cli_command_resp
{
    int status;
    short resFlag;
    char result[WFA_CLI_CMD_RESP_LEN];
} caStaCliCmdResp_t;
/* P2P */
typedef struct ca_P2p_sta_get_psk_resp
{
    char ssid[WFA_SSID_NAME_LEN];
    char passPhrase[WFA_PSK_PP_LEN];
} caP2pStaGetPskResp_t;

typedef struct ca_P2p_start_grp_form_resp
{
    char result[8];
    char grpId[WFA_P2P_GRP_ID_LEN];
} caP2pStartGrpFormResp_t;
/* P2P */

/* WFD */
typedef struct ca_sta_start_wfd_conn_resp
{
    char result[8];
    char wfdSessionId[WFA_WFD_SESSION_ID_LEN];
    char p2pGrpId[WFA_P2P_GRP_ID_LEN];
} caStaStartWfdConnResp_t;

typedef struct ca_sta_get_parameter_resp
{

    BYTE getParamType;
    char devList[128];
    char masterPref[8];
    char rssi[8];
} caStaGetParameterResp_t;

/* WFD */

/* NFC */

typedef struct ca_sta_nfc_action_resp
{
   char result[8];
   char grpId[WFA_P2P_GRP_ID_LEN];
   int peerRole;   
} caStaNfcActionResp_t;
/* NFC */

/* WFDS */

typedef struct wfds_serviceAdv_info
{
	char servName[32];
	long int advtID;
	char serviceMac[WFA_P2P_DEVID_LEN];	
} wfdsServAdvInfo_t;


typedef struct ca_sta_ConnSess_cmd_resp
{
	long int sessionID;
	char result[8];
	char grpId[WFA_P2P_GRP_ID_LEN];

} caStaConnSessCmdResp_t;



enum {
	eServiceAvilable= 0,
	eServiceNotAvailable=1,
};

typedef struct ca_sta_SearchResult_Event
{
	long int searchID;
	char serviceMac[WFA_MAC_ADDR_STR_LEN];	 
	long int advID; 
	char serviceName[32];	 
	WORD serviceStatus;
} caStaSearchResultEvent_t;

typedef struct ca_sta_SearchTerminated_Event
{
	long int searchID;
} caStaSearchTerminatedEvent_t;

enum {
	eAdvertised= 1,
	eNotAdvertised,
};

typedef struct ca_sta_AdvStatus_Event
{
	long int advID; 
	WORD status;
} caStaAdvertiseStatusEvent_t;


typedef struct ca_sta_SessionRequest_Event
{
	long int advID; 
	char sessionMac[WFA_MAC_ADDR_STR_LEN];	 
	long int sessionID;
} caStaSessionRequestEvent_t;

enum {
	eSessionStateOpen= 1,
	eSessionStateInitiated,
	eSessionStateRequested,
	eSessionStateClosed,	
};

typedef struct ca_sta_SessionStatus_Event
{
	long int sessionID; 
	char sessionMac[WFA_MAC_ADDR_STR_LEN];	 
	WORD state;
} caStaSessionStatusEvent_t;
enum {
	eNetworkRoleRejected= 1,
	eServiceRequestReceived,
	eServiceRequestDifferred,
	eServiceRequestAccepted,
	eServiceRequestFailed,
	eGroupFormationStarted,
	eGroupFormationComplete,
	eGroupFormationFailed,
};

typedef struct ca_sta_ConnectStatus_Event
{
	long int sessionID; 
	char sessionMac[WFA_MAC_ADDR_STR_LEN];	 
	WORD status;
} caStaConnectStatusEvent_t;

enum {
	eLocalPortAllowed= 1,
	eLocalPortBlocked,
	eFailure,
	eRemotePortAllowed,	
};

typedef struct ca_sta_PortStatus_Event
{
	long int sessionID; 
	char sessionMac[WFA_MAC_ADDR_STR_LEN];	 
	WORD port;
	WORD status;
} caStaPortStatusEvent_t;


typedef struct ca_sta_GetEventDetails_cmd_resp
{
	WORD eventID;
	union _EventType
	{
		caStaSearchResultEvent_t searchResult;
		caStaSearchTerminatedEvent_t searchTerminated;
		caStaAdvertiseStatusEvent_t advStatus;
		caStaSessionRequestEvent_t sessionReq;
		caStaSessionStatusEvent_t sessionStatus;
		caStaConnectStatusEvent_t connStatus;
		caStaPortStatusEvent_t portStatus;
	}getEventDetails;

} caStaGetEventDetailsCmdResp_t;


typedef struct ca_sta_GetEvents_cmd_resp
{
	char result[512];
} caStaGetEventListCmdResp_t;


typedef struct ca_sta_invoke_Seek_cmd_resp
{
	long int searchID;
} caStaInvokeSeekCmdResp_t;
typedef struct ca_sta_invoke_Advrt_cmd_resp
{
	int numServInfo;
	wfdsServAdvInfo_t servAdvInfo[5];
} caStaInvokeAdvrtCmdResp_t;

typedef struct ca_sta_invoke_cmd_resp
{
	int invokeCmdRspType;
	union _wfdsInvokeCmd
	{
		caStaInvokeAdvrtCmdResp_t advRsp;
		caStaInvokeSeekCmdResp_t seekRsp;
		caStaConnSessCmdResp_t connSessResp;

	}invokeCmdResp;
 
} caStaInvokeCmdResp_t;
/* WFDS */

#define MAX_SCAN_RESULT_SIZE 1024
typedef struct ca_sta_exec_action_resp
{
	char scan_res_buf[MAX_SCAN_RESULT_SIZE];
} caStaExecActionResp_t;

typedef struct ca_sta_get_events_resp
{
	char eventName[64];
	unsigned int remoteInstanceID;
	unsigned int localInstanceID;
	char mac[18];
} caStaGetEventsResp_t;

typedef struct dut_cmd_response
{
    int status;
    int streamId;
    union _cmdru
    {
        tgStats_t stats;
        tgPingStopResp_t pingStp;
        caStaGetIpConfigResp_t getIfconfig;
        caStaGetStatsResp_t ifStats;
        caDeviceGetInfoResp_t devInfo;
        caDeviceListIFResp_t ifList;
        caStaUploadResp_t  uld;
	   caStaGetEventsResp_t getEvents;
	   caStaExecActionResp_t execAction;
        char version[WFA_VERSION_LEN];
        char info[WFA_INFO_BUFSIZE];
        char bssid[WFA_MAC_ADDR_STR_LEN];
        char mac[WFA_MAC_ADDR_STR_LEN];
        /* P2P */
        char devid[WFA_P2P_DEVID_LEN];
        char grpid[WFA_P2P_GRP_ID_LEN];
        char p2presult[8];
        char wpsPin[WFA_WPS_PIN_LEN];
		caStaGetParameterResp_t getParamValue;
       int connected;
#ifndef WFA_DUT_UART
        caP2pStaGetPskResp_t pskInfo;
        caP2pStartGrpFormResp_t grpFormInfo;
        /* P2P */
        /* WFD */
        caStaStartWfdConnResp_t        wfdConnInfo;

/* WFD */
/* NFC */
          caStaNfcActionResp_t staNfcAction;
/* NFC */
/* WFDS */
          caStaInvokeCmdResp_t staInvokeCmd;
          caStaConnSessCmdResp_t staManageServ;
          caStaGetEventListCmdResp_t staGetEvents;        
          caStaGetEventDetailsCmdResp_t staGetEventDetails;       
#endif /* !WFA_DUT_UART */
/* WFDS */
   } cmdru;
}dutCmdResponse_t;

#endif
```

## inc/wfa_sock.h
```c
/****************************************************************************
*
* Copyright (c) 2016 Wi-Fi Alliance
*
* Permission to use, copy, modify, and/or distribute this software for any
* purpose with or without fee is hereby granted, provided that the above
* copyright notice and this permission notice appear in all copies.
*
* THE SOFTWARE IS PROVIDED "AS IS" AND THE AUTHOR DISCLAIMS ALL WARRANTIES
* WITH REGARD TO THIS SOFTWARE INCLUDING ALL IMPLIED WARRANTIES OF
* MERCHANTABILITY AND FITNESS. IN NO EVENT SHALL THE AUTHOR BE LIABLE FOR ANY
* SPECIAL, DIRECT, INDIRECT, OR CONSEQUENTIAL DAMAGES OR ANY DAMAGES WHATSOEVER
* RESULTING FROM LOSS OF USE, DATA OR PROFITS, WHETHER IN AN ACTION OF CONTRACT,
* NEGLIGENCE OR OTHER TORTIOUS ACTION, ARISING OUT OF OR IN CONNECTION WITH THE
* USE OR PERFORMANCE OF THIS SOFTWARE.
*
*****************************************************************************/


#ifndef _WFA_SOCK_H
#define _WFA_SOCK_H

#include <stdio.h>		/* for printf() and fprintf() */

#ifdef _WINDOWS
#include <winsock.h>    /* for socket(), bind(), and connect() */
#else
#include <sys/socket.h> /* for socket(), bind(), and connect() */
#include <arpa/inet.h>  /* for sockaddr_in and inet_ntoa() */
#include <stdlib.h>		/* for atoi() and exit() */
#include <string.h>		/* for memset() */
#include <unistd.h>		/* for close() */
#include <sys/time.h>   /* for struct timeval {} */
#endif
#include <stdlib.h>		/* for atoi() and exit() */
#include <string.h>		/* for memset() */
#include <fcntl.h>		/* for fcntl() */
#include <errno.h>

#define MAX_UDP_LEN       1470
#define MAX_RCV_BUF_LEN   (8*1024)
//#define MAX_RCV_BUF_LEN   (12*1024)

struct sockfds
{
    int *agtfd;      /* dut agent main socket fd */
    int *cafd;       /* sock fd to control agent */
    int *tgfd;       /* traffic agent fd         */
    int *wmmfds;     /* wmm stream ids           */
    int *psfd;       /* wmm-ps socket id         */
};

extern int wfaCreateTCPServSock(unsigned short sport);
extern int wfaCreateUDPSock(char *sipaddr, unsigned short sport);
extern int wfaAcceptTCPConn(int servSock);
extern int wfaConnectUDPPeer(int sock, char *dipaddr, int dport);
extern void wfaSetSockFiDesc(zsock_fd_set *sockset, int *, struct sockfds *);
#ifdef _WINDOWS
extern int wfaCtrlSend(SOCKET sock, unsigned char *buf, int bufLen);
#else
extern int wfaCtrlSend(int sock, unsigned char *buf, int bufLen);
#endif
extern int wfaCtrlRecv(int sock, unsigned char *buf);
extern int wfaTrafficSendTo(int sock, char *buf, int bufLen, struct sockaddr *to);
extern int wfaTrafficRecv(int sock, void*, char *buf, struct sockaddr *from);
extern int wfaGetifAddr(char *ifname, struct sockaddr_in *sa);
extern struct timeval *wfaSetTimer(int, int, struct timeval *);
extern int wfaSetSockMcastRecvOpt(int, char*);
//extern int wfaSetSockMcastSendOpt(int);
extern int wfaSetProcPriority(int);

#endif /* _WFA_SOCK_H */
```

## inc/wfa_stdincs.h
```c
/****************************************************************************
*
* Copyright (c) 2016 Wi-Fi Alliance
*
* Permission to use, copy, modify, and/or distribute this software for any
* purpose with or without fee is hereby granted, provided that the above
* copyright notice and this permission notice appear in all copies.
*
* THE SOFTWARE IS PROVIDED "AS IS" AND THE AUTHOR DISCLAIMS ALL WARRANTIES
* WITH REGARD TO THIS SOFTWARE INCLUDING ALL IMPLIED WARRANTIES OF
* MERCHANTABILITY AND FITNESS. IN NO EVENT SHALL THE AUTHOR BE LIABLE FOR ANY
* SPECIAL, DIRECT, INDIRECT, OR CONSEQUENTIAL DAMAGES OR ANY DAMAGES WHATSOEVER
* RESULTING FROM LOSS OF USE, DATA OR PROFITS, WHETHER IN AN ACTION OF CONTRACT,
* NEGLIGENCE OR OTHER TORTIOUS ACTION, ARISING OUT OF OR IN CONNECTION WITH THE
* USE OR PERFORMANCE OF THIS SOFTWARE.
*
*****************************************************************************/

#include <stdio.h>
#include <pthread.h>
#include <unistd.h>
#include <string.h>
#include <stdlib.h>
#include <sys/time.h>
#include <time.h>
#include <signal.h>
#include <fcntl.h>
#include <netdb.h>
#include <sys/socket.h>
#include <arpa/inet.h>
#include <zephyr/types.h>
#include <sys/socket.h>
#include <sys/select.h>
#include <poll.h>
//#include <linux/if.h>
#include <sys/ioctl.h>
//#include <sys/mman.h>
//#include <sched.h>
#include <math.h>
#include <errno.h>
```

## inc/wfa_tg.h
```c
/****************************************************************************
*
* Copyright (c) 2016 Wi-Fi Alliance
*
* Permission to use, copy, modify, and/or distribute this software for any
* purpose with or without fee is hereby granted, provided that the above
* copyright notice and this permission notice appear in all copies.
*
* THE SOFTWARE IS PROVIDED "AS IS" AND THE AUTHOR DISCLAIMS ALL WARRANTIES
* WITH REGARD TO THIS SOFTWARE INCLUDING ALL IMPLIED WARRANTIES OF
* MERCHANTABILITY AND FITNESS. IN NO EVENT SHALL THE AUTHOR BE LIABLE FOR ANY
* SPECIAL, DIRECT, INDIRECT, OR CONSEQUENTIAL DAMAGES OR ANY DAMAGES WHATSOEVER
* RESULTING FROM LOSS OF USE, DATA OR PROFITS, WHETHER IN AN ACTION OF CONTRACT,
* NEGLIGENCE OR OTHER TORTIOUS ACTION, ARISING OUT OF OR IN CONNECTION WITH THE
* USE OR PERFORMANCE OF THIS SOFTWARE.
*
*****************************************************************************/


/*
 * wfa_tg.h:
 *   Definitions used in Traffic Generator Modules
 */
#ifndef _WFA_TG_H
#define _WFA_TG_H

#include <sys/time.h>
#include <pthread.h>

/* maximum number of streams to support */
#define IPV4_ADDRESS_STRING_LEN    16
#define IPV6_ADDRESS_STRING_LEN    40

#define  MINISECONDS            1000
#define  MICROSECONDS           1000000
#define  NANOSECONDS            1000000000
#define  LINUX_TIMER_RES        20000000      /* 20 MINSECONDS */
#define  CA_RESPONSE_BUF_SIZE   128

/* Limited bit rate generator related constant or threshold values defined here   */
#define WFA_SEND_FIX_BITRATE_MAX             25*1024*1024  /* 25 Mbits per sec per stream */
#define WFA_SEND_FIX_BITRATE_SLEEP_PER_SEND  1             /* mil-sec per sending sending*/

/* Profile Key words */
#define KW_PROFILE                 1
#define KW_DIRECTION               2
#define KW_DIPADDR                 3
#define KW_DPORT                   4
#define KW_SIPADDR                 5
#define KW_SPORT                   6
#define KW_FRATE                   7
#define KW_DURATION                8
#define KW_PLOAD                   9
#define KW_TCLASS                  10
#define KW_STREAMID                11
#define KW_COMPLETE                12
#define KW_ERROR                   13
#define KW_STARTDELAY              14
#define KW_NUMFRAME                15
#define KW_USESYNCCLOCK            16
#define KW_USERPRIORITY            17
#define KW_MAXCNT                  18
#define KW_TAGNAME                 19

/* Profile Types */
#define PROF_FILE_TX               1
#define PROF_MCAST                 2
#define PROF_IPTV                  3
#define PROF_TRANSC                4
#define PROF_START_SYNC            5      /* this will be outdated */
#define PROF_CALI_RTD              5
#define PROF_UAPSD                 6
#define PROF_LAST                  7

/* stream state */
#define WFA_STREAM_INACTIVE        0
#define WFA_STREAM_ACTIVE          1

/* Traffic Directions */
#define DIRECT_SEND                1
#define DIRECT_RECV                2

#define TG_PROTO_TCP               0
#define TG_PROTO_UDP               1

#define TG_WMM_AC_UP0         12     /* User Priority 0 */
#define TG_WMM_AC_UP1         13     /*               1 */
#define TG_WMM_AC_UP2         14     /*               2 */
#define TG_WMM_AC_UP3         15     /*               3 */
#define TG_WMM_AC_UP4         16     /*               4 */
#define TG_WMM_AC_UP5         17     /*               5 */
#define TG_WMM_AC_UP6         18     /*               6 */
#define TG_WMM_AC_UP7         19     /*               7 */

#define TG_WMM_AC_BE          1      /* Best Effort */
#define TG_WMM_AC_BK          2      /* Background  */
#define TG_WMM_AC_VI          3      /* Video       */
#define TG_WMM_AC_VO          4      /* Voice       */
#define TG_WMM_AC_UAPSD       5      /* UAPSD        */
#define TG_WMM_AC_RX          6      /* RX           */


#if 0
/* For wireless station, 802.11 defines 8 priority queues and 2 for each
 *  four catergories
 */
#define TG_WMM_AC_BE2       0x0a
#define TG_WMM_AC_BK2       0x0b
#define TG_WMM_AC_VI2       0x0c
#define TG_WMM_AC_VO2       0x0d
#endif

/* wmm defs */
#define TOS_VO      0xD0         // 110 1  0000 (6)  AC_VO tos/dscp values
#define TOS_VI      0xA0         // 101 0  0000 (5)  AC_VI
#define TOS_BE      0x00         // 000 0  0000 (0)  AC_BE
#define TOS_BK      0x20         // 001 0  0000 (1)  AC_BK

#define WFA_UDP_ECHO_STREAM_ID    0xFFFF
#define WFA_UDP_ECHO_PORT         07

#define WFA_PING_ICMP_ECHO         0
#define WFA_PING_UDP_ECHO          1

#define WFA_UPLOAD_VHSO_RPT        1

#define WFA_MCAST_FRATE            50       /* Multicast test rate is fixed at 50 frames/sec */

#define WFA_G_CODEC_RATE            50       /* G.729 50 pkt per second  = 20 ms interval */
#define WFA_DSCP_TABLE_SIZE         15

typedef struct _tg_stats
{
    unsigned int txFrames;
    unsigned int rxFrames;
    unsigned long long txPayloadBytes;
    unsigned long long rxPayloadBytes;
    unsigned int outOfSequenceFrames;
    unsigned int lostPkts;        /* voice over wi-fi */
    unsigned long jitter;         /* voice over wi-fi */
} tgStats_t;

typedef struct _e2e_stats
{
    int seqnum;
    int lsec;
    int lusec;
    int rsec;
    int rusec;
} tgE2EStats_t;

typedef struct _tg_profile
{
    int  profile;                           /* profile id                    */
    int  direction;
    char dipaddr[IPV4_ADDRESS_STRING_LEN];  /* destination/remote ip address */
    int  dport;
    char sipaddr[IPV4_ADDRESS_STRING_LEN];  /* source/local ip address       */
    int  sport;
    int  rate;
    int  duration;
    int  pksize;
    short trafficClass;      /* VO, VI, BK, BE */
    int  startdelay;
    int  maxcnt;
    char WmmpsTagName[10];//Aaron's//Store the test case name
} tgProfile_t;

typedef struct _tg_stream
{
    int id;
    int sockfd;
    int tblidx;
    int lastPktSN;        /* use for Jitter calculation */
    int fmInterval;
    int rxTimeLast;       /* use for pkLost             */
    int state;            /* indicate if the stream being active */
    tgProfile_t profile;
    tgStats_t stats;
} tgStream_t;

typedef struct _traffic_header
{
    char hdr[20];   /* always wfa */
} tgHeader_t;

typedef struct _tg_wmm
{
    int thr_flag;    /* this is used to indicate stream id */
    int stop_flag;    /* this is used to indicate stream id */
#ifndef _WINDOWS
    pthread_t thr;
    int thr_id;
    pthread_cond_t thr_flag_cond;
    pthread_cond_t thr_stop_cond;
    pthread_mutex_t thr_flag_mutex;
    pthread_mutex_t thr_stop_mutex;
    pthread_attr_t attr;
#else
    HANDLE thr;
    DWORD thr_id;
    int timerid;
    HANDLE thr_flag_mutex;
    HANDLE thr_stop_mutex;
#endif
} tgWMM_t;

typedef int (*StationStateFunctionPtr)( char, int,int *); //PS,sleep period,state

typedef struct station_state_table
{
    StationStateFunctionPtr statefunc;
    char                    pw_offon;
    int                     sleep_period;
} StationProcStatetbl_t;

typedef int (*stationRecvStateFunctionPtr)(unsigned int *, int,int * ); //Recieved message buffer, length,state

typedef struct console_rcv_state_table
{
    stationRecvStateFunctionPtr statefunc;
} StationRecvProcStatetbl_t;

typedef struct _tg_thr_data
{
    int tid;
    StationProcStatetbl_t  *state;
    int state_num;
} tgThrData_t;

extern int wfaTGConfig(int len, BYTE *buf, int *respLen, BYTE *respBuf);
extern int wfaSendLongFile(int fromSockfd, int streamId, BYTE *respBuf, int *respLen);
extern int wfaRecvFile(int mySockfi, int profId, char *buf);
extern int wfaTGRecvStart(int len, BYTE *parms, int *respLen, BYTE *respBuf);
extern int wfaTGRecvStop(int len, BYTE *parms, int *respLen, BYTE *respBuf);
extern int wfaTGSendStart(int len, BYTE *parms, int *respLen, BYTE *respBuf);
extern int wfaTGReset(int len, BYTE *parms, int *respLen, BYTE *respBuf);
extern int wfaSendShortFile(int fromSockfd, int profId, BYTE *buf, int size, BYTE *respBuf, int *respLen);
extern int wfaFlushSockQueue(int profId);
extern int wfaTGSendPing(int len, BYTE *caCmdBuf, int *respLen, BYTE *respBuf);
extern int wfaTGStopPing(int len, BYTE *caCmdBuf, int *respLen, BYTE *respBuf);

extern int wfaSendBitrateData(int mySockfd, int streamId, BYTE *pRespBuf, int *aRespLen);
extern int wfaSendBitrateDataVI(int mySockfd, int streamId, BYTE *pRespBuf, int *aRespLen);
tgStream_t *findStreamProfile(int streamId);
tgProfile_t *findTGProfile(int streamId);
int convertDscpToTos(int dscp); // return >=0 as TOS, otherwise error.

#endif
```

## inc/wfa_tlv.h
```c
/****************************************************************************
*
* Copyright (c) 2016 Wi-Fi Alliance
*
* Permission to use, copy, modify, and/or distribute this software for any
* purpose with or without fee is hereby granted, provided that the above
* copyright notice and this permission notice appear in all copies.
*
* THE SOFTWARE IS PROVIDED "AS IS" AND THE AUTHOR DISCLAIMS ALL WARRANTIES
* WITH REGARD TO THIS SOFTWARE INCLUDING ALL IMPLIED WARRANTIES OF
* MERCHANTABILITY AND FITNESS. IN NO EVENT SHALL THE AUTHOR BE LIABLE FOR ANY
* SPECIAL, DIRECT, INDIRECT, OR CONSEQUENTIAL DAMAGES OR ANY DAMAGES WHATSOEVER
* RESULTING FROM LOSS OF USE, DATA OR PROFITS, WHETHER IN AN ACTION OF CONTRACT,
* NEGLIGENCE OR OTHER TORTIOUS ACTION, ARISING OUT OF OR IN CONNECTION WITH THE
* USE OR PERFORMANCE OF THIS SOFTWARE.
*
*****************************************************************************/



/*
 * File: wfa_tlv.h
 *  definitions for each of command types.
 *  format:
 *  ---------------------------------------------------
 *  |  tag   | length |   value
 *  ---------------------------------------------------
 *   2 bytes   2bytes    defined by length
 */
#ifndef _WFA_TLV_H
#define _WFA_TLV_H

#include "wfa_types.h"

#define INTEGER_1 0x0001            /* byte */
#define INTEGER_2 0x0002            /* word */
#define OCTET_STRING 0x0003         /* string */

typedef struct _wfatlvHdr
{
    WORD tag;   /* tag/type */
    WORD len;   /* value length */
} wfaTLV;

#define WFA_TLV_HDR_LEN sizeof(wfaTLV)

enum cmd_tags
{
    /* Commands */
    WFA_GET_VERSION_TLV =                 0x01,

    /* Generic TRAFFIC GENERATOR Commands */
    WFA_TRAFFIC_SEND_PING_TLV,            /* 2 */
    WFA_TRAFFIC_STOP_PING_TLV,            /* 3 */
    WFA_TRAFFIC_AGENT_CONFIG_TLV,         /* 4 */
    WFA_TRAFFIC_AGENT_SEND_TLV,           /* 5 */
    WFA_TRAFFIC_AGENT_RECV_START_TLV,     /* 6 */
    WFA_TRAFFIC_AGENT_RECV_STOP_TLV,      /* 7 */
    WFA_TRAFFIC_AGENT_RESET_TLV,          /* 8 */
    WFA_TRAFFIC_AGENT_STATUS_TLV,         /* 9 */

    /* STATION/DUT Commands */
    WFA_STA_GET_IP_CONFIG_TLV,            /* 10 */
    WFA_STA_SET_IP_CONFIG_TLV,            /* 11 */
    WFA_STA_GET_MAC_ADDRESS_TLV,          /* 12 */
    WFA_STA_SET_MAC_ADDRESS_TLV,          /* 13 */
    WFA_STA_IS_CONNECTED_TLV,             /* 14 */
    WFA_STA_VERIFY_IP_CONNECTION_TLV,     /* 15 */
    WFA_STA_GET_BSSID_TLV,                /* 16 */
    WFA_STA_GET_STATS_TLV,                /* 17 */
    WFA_STA_SET_ENCRYPTION_TLV,           /* 18 */
    WFA_STA_SET_PSK_TLV,                  /* 19 */
    WFA_STA_SET_EAPTLS_TLV,               /* 20 */
    WFA_STA_SET_UAPSD_TLV,                /* 21 */
    WFA_STA_ASSOCIATE_TLV,                /* 22 */
    WFA_STA_SET_EAPTTLS_TLV,              /* 23 */
    WFA_STA_SET_EAPSIM_TLV,               /* 24 */
    WFA_STA_SET_PEAP_TLV,                 /* 25 */
    WFA_STA_SET_IBSS_TLV,                 /* 26 */
    WFA_STA_GET_INFO_TLV,                 /* 27 */
    WFA_DEVICE_GET_INFO_TLV,              /* 28 */
    WFA_DEVICE_LIST_IF_TLV,               /* 29 */

    WFA_STA_DEBUG_SET_TLV,                /* 30 */
    WFA_STA_SET_MODE_TLV,                 /* 31 */
    WFA_STA_UPLOAD_TLV,                   /* 32 */
    WFA_STA_SET_WMM_TLV,                  /* 33 */
    WFA_STA_REASSOCIATE_TLV,              /* 34 */
    WFA_STA_SET_PWRSAVE_TLV,              /* 35 */
    WFA_STA_SEND_NEIGREQ_TLV,             /* 36 */

    WFA_STA_PRESET_PARAMETERS_TLV,        /* 37 */
    WFA_STA_SET_EAPFAST_TLV,              /* 38 */
    WFA_STA_SET_EAPAKA_TLV,               /* 39 */
    WFA_STA_SET_SYSTIME_TLV,              /* 40 */

    WFA_STA_SET_11N_TLV,                  /* 41 */
    WFA_STA_SET_WIRELESS_TLV,             /* 42 */
    WFA_STA_SEND_ADDBA_TLV,               /* 43 */

    WFA_STA_SEND_COEXIST_MGMT_TLV,        /* 44 */
    WFA_STA_SET_RIFS_TEST_TLV,            /* 45 */
    WFA_STA_RESET_DEFAULT_TLV,            /* 46 */
    WFA_STA_DISCONNECT_TLV,               /* 47 */
    WFA_STA_DEV_SEND_FRAME_TLV,           /* 48 */
    WFA_STA_SET_SECURITY_TLV,             /* 49 */
    /* P2P */
    WFA_STA_P2P_GET_DEV_ADDRESS_TLV,      /* 50 */
    WFA_STA_P2P_SETP2P_TLV,               /* 51 */
    WFA_STA_P2P_CONNECT_TLV,              /* 52 */
    WFA_STA_P2P_START_AUTO_GO_TLV,        /* 53 */
    WFA_STA_P2P_START_GRP_FORMATION_TLV,  /* 54 */
    WFA_STA_P2P_DISSOLVE_TLV,             /* 55 */
    WFA_STA_P2P_SEND_INV_REQ_TLV,         /* 56 */
    WFA_STA_P2P_ACCEPT_INV_REQ_TLV,       /* 57 */
    WFA_STA_P2P_SEND_PROV_DIS_REQ_TLV,    /* 58 */
    WFA_STA_WPS_SETWPS_PBC_TLV,           /* 59 */
    WFA_STA_WPS_READ_PIN_TLV,             /* 60 */
    WFA_STA_WPS_ENTER_PIN_TLV,            /* 61 */
    WFA_STA_P2P_GET_PSK_TLV,              /* 62 */
    WFA_STA_P2P_RESET_TLV,                /* 63 */
    WFA_STA_WPS_READ_LABEL_TLV,           /* 64 */
    WFA_STA_P2P_GET_IP_CONFIG_TLV,        /* 65 */
    WFA_STA_P2P_SEND_SERVICE_DISCOVERY_REQ_TLV, /* 66 */
    WFA_STA_P2P_SEND_PRESENCE_REQ_TLV,    /* 67 */
    WFA_STA_P2P_SET_SLEEP_TLV,            /* 68 */
    WFA_STA_P2P_SET_OPPORTUNISTIC_PS_TLV, /* 69 */

    WFA_STA_P2P_ADD_ARP_TABLE_ENTRY_TLV,      /* 70 */
    WFA_STA_P2P_BLOCK_ICMP_RESPONSE_TLV,      /* 71 */

/*TDLS or PMF */
   	WFA_STA_SET_RADIO_TLV,                /* 72 */
   	WFA_STA_SET_RFEATURE_TLV,             /* 73 */
/*Display */
   	WFA_STA_START_WFD_CONNECTION_TLV,	/* 74 */
   	WFA_STA_CLI_CMD_TLV,					/* 75 */
   	WFA_STA_CONNECT_GO_START_WFD_TLV,	 /* 76 */
   	WFA_STA_GENERATE_EVENT_TLV,	 		/* 77 */
   	WFA_STA_REINVOKE_WFD_SESSION_TLV,	/* 78 */
   	WFA_STA_GET_PARAMETER_TLV,	/* 79 */
/*P2P NFC*/
   	WFA_STA_NFC_ACTION_TLV,	/* 80 */

/*WFDS*/
	WFA_STA_INVOKE_COMMAND_TLV, /* 81 */
	WFA_STA_MANAGE_SERVICE_TLV, /* 82 */
	WFA_STA_GET_EVENTS_TLV, /* 83 */
	WFA_STA_GET_EVENT_DETAILS_TLV, /* 84 */
	

  
   WFA_STA_EXEC_ACTION_TLV,			/* 85 */
   WFA_STA_SCAN_TLV, /* 86 */
   WFA_STA_COMMANDS_END,                  /* 87 */
};


enum resp_tags
{
    /* Version response */
    WFA_GET_VERSION_RESP_TLV = 0x01,            /* 01 */

    /* Generic Traffic Generator Responses */
    WFA_TRAFFIC_SEND_PING_RESP_TLV,             /* 02 */
    WFA_TRAFFIC_STOP_PING_RESP_TLV,             /* 03 */
    WFA_TRAFFIC_AGENT_CONFIG_RESP_TLV,          /* 04 */
    WFA_TRAFFIC_AGENT_SEND_RESP_TLV,            /* 05 */
    WFA_TRAFFIC_AGENT_RECV_START_RESP_TLV,      /* 06 */
    WFA_TRAFFIC_AGENT_RECV_STOP_RESP_TLV,       /* 07 */
    WFA_TRAFFIC_AGENT_RESET_RESP_TLV,           /* 08 */
    WFA_TRAFFIC_AGENT_STATUS_RESP_TLV,          /* 09 */

    /* STATION/DUT Responses */
    WFA_STA_GET_IP_CONFIG_RESP_TLV,             /* 10 */
    WFA_STA_SET_IP_CONFIG_RESP_TLV,             /* 11 */
    WFA_STA_GET_MAC_ADDRESS_RESP_TLV,           /* 12 */
    WFA_STA_SET_MAC_ADDRESS_RESP_TLV,           /* 13 */
    WFA_STA_IS_CONNECTED_RESP_TLV,              /* 14 */
    WFA_STA_VERIFY_IP_CONNECTION_RESP_TLV,      /* 15 */
    WFA_STA_GET_BSSID_RESP_TLV,                 /* 16 */
    WFA_STA_GET_STATS_RESP_TLV,                 /* 17 */
    WFA_STA_SET_ENCRYPTION_RESP_TLV,            /* 18 */
    WFA_STA_SET_PSK_RESP_TLV,                   /* 19 */
    WFA_STA_SET_EAPTLS_RESP_TLV,                /* 20 */
    WFA_STA_SET_UAPSD_RESP_TLV,                 /* 21 */
    WFA_STA_ASSOCIATE_RESP_TLV,                 /* 22 */
    WFA_STA_SET_EAPTTLS_RESP_TLV,               /* 23 */
    WFA_STA_SET_EAPSIM_RESP_TLV,                /* 24 */
    WFA_STA_SET_PEAP_RESP_TLV,                  /* 25 */
    WFA_STA_SET_IBSS_RESP_TLV,                  /* 26 */
    WFA_STA_GET_INFO_RESP_TLV,                  /* 27 */
    WFA_DEVICE_GET_INFO_RESP_TLV,               /* 28 */
    WFA_DEVICE_LIST_IF_RESP_TLV,                /* 29 */

    WFA_STA_DEBUG_SET_RESP_TLV,                 /* 30 */
    WFA_STA_SET_MODE_RESP_TLV,                  /* 31 */
    WFA_STA_UPLOAD_RESP_TLV,                    /* 32 */
    WFA_STA_SET_WMM_RESP_TLV,                   /* 33 */
    WFA_STA_REASSOCIATE_RESP_TLV,               /* 34 */
    WFA_STA_SET_PWRSAVE_RESP_TLV,               /* 35 */
    WFA_STA_SEND_NEIGREQ_RESP_TLV,              /* 36 */

    WFA_STA_PRESET_PARAMETERS_RESP_TLV,         /* 37 */
    WFA_STA_SET_EAPFAST_RESP_TLV,               /* 38 */
    WFA_STA_SET_EAPAKA_RESP_TLV,	               /* 39 */
    WFA_STA_SET_SYSTIME_RESP_TLV,               /* 40 */

    WFA_STA_SET_11N_RESP_TLV,                   /* 41 */
    WFA_STA_SET_WIRELESS_RESP_TLV,              /* 42 */
    WFA_STA_SET_SEND_ADDBA_RESP_TLV,            /* 43 */

    WFA_STA_SEND_COEXIST_MGMT_RESP_TLV,         /* 44 */
    WFA_STA_SET_RIFS_TEST_RESP_TLV,             /* 45 */
    WFA_STA_RESET_DEFAULT_RESP_TLV,             /* 46 */
    WFA_STA_DISCONNECT_RESP_TLV,                /* 47 */
    WFA_STA_DEV_SEND_FRAME_RESP_TLV,            /* 48 */
    WFA_STA_SET_SECURITY_RESP_TLV,              /* 49 */
    /* P2P */
    WFA_STA_P2P_GET_DEV_ADDRESS_RESP_TLV,      /* 50 */
    WFA_STA_P2P_SETP2P_RESP_TLV,               /* 51 */
    WFA_STA_P2P_CONNECT_RESP_TLV,              /* 52 */
    WFA_STA_P2P_START_AUTO_GO_RESP_TLV,        /* 53 */
    WFA_STA_P2P_START_GRP_FORMATION_RESP_TLV,  /* 54 */
    WFA_STA_P2P_DISSOLVE_RESP_TLV,             /* 55 */
    WFA_STA_P2P_SEND_INV_REQ_RESP_TLV,         /* 56 */
    WFA_STA_P2P_ACCEPT_INV_REQ_RESP_TLV,       /* 57 */
    WFA_STA_P2P_SEND_PROV_DIS_REQ_RESP_TLV,    /* 58 */
    WFA_STA_WPS_SETWPS_PBC_RESP_TLV,           /* 59 */
    WFA_STA_WPS_READ_PIN_RESP_TLV,             /* 60 */
    WFA_STA_WPS_ENTER_PIN_RESP_TLV,            /* 61 */
    WFA_STA_P2P_GET_PSK_RESP_TLV,              /* 62 */
    WFA_STA_P2P_RESET_RESP_TLV,                /* 63 */
    WFA_STA_WPS_READ_LABEL_RESP_TLV,           /* 64 */
    WFA_STA_P2P_GET_IP_CONFIG_RESP_TLV,        /* 65 */
    WFA_STA_P2P_SEND_SERVICE_DISCOVERY_REQ_RESP_TLV, /* 66 */
    WFA_STA_P2P_SEND_PRESENCE_REQ_RESP_TLV,    /* 67 */
    WFA_STA_P2P_SET_SLEEP_RESP_TLV,            /* 68 */
    WFA_STA_P2P_SET_OPPORTUNISTIC_PS_RESP_TLV, /* 69 */

    WFA_STA_P2P_ADD_ARP_TABLE_ENTRY_RESP_TLV,  /* 70 */
    WFA_STA_P2P_BLOCK_ICMP_RESPONSE_RESP_TLV,  /* 71 */
    WFA_STA_SET_RADIO_RESP_TLV,                 /* 72 */
    WFA_STA_SET_RFEATURE_RESP_TLV,              /* 73 */

    WFA_STA_START_WFD_CONNECTION_RESP_TLV,      /* 74 */
    WFA_STA_CLI_CMD_RESP_TLV,					/* 75 */
    WFA_STA_CONNECT_GO_START_WFD_RESP_TLV,      /* 76 */
	WFA_STA_GENERATE_EVENT_RESP_TLV,			/* 77 */
	WFA_STA_REINVOKE_WFD_SESSION_RESP_TLV,		/* 78 */
	WFA_STA_GET_PARAMETER_RESP_TLV,		/* 79 */
	
	WFA_STA_NFC_ACTION_RESP_TLV,		/* 80 */
	
	WFA_STA_INVOKE_CMD_RESP_TLV,		/* 81 */
	WFA_STA_MANAGE_SERVICE_RESP_TLV,		/* 82 */
	WFA_STA_GET_EVENTS_RESP_TLV,		/* 83 */
	WFA_STA_GET_EVENT_DETAILS_RESP_TLV,		/* 84 */

	WFA_STA_EXEC_ACTION_RESP_TLV,					/* 85 */
	WFA_STA_SCAN_RESP_TLV, 					/* 86 */
    WFA_STA_RESPONSE_END,                        /* 87 */
};

#define WFA_TLV_HEAD_LEN 1+2

extern WORD wfaGetTag(BYTE *tlv_data);
extern void wfaSetTag(BYTE *tlv_data, BYTE new_tag);
extern WORD wfaGetTLVLen(BYTE *tlv_data);
extern WORD wfaGetValueLen(BYTE *tlv_data);
extern BOOL wfaGetValue(BYTE *pstr, int value_len, BYTE *tlv_data);
extern BOOL wfaIsValidTag(BYTE the_tag);
extern void wfaAliasByTag(BYTE the_tag, char *aliasStr);
extern BOOL wfaDecodeTLV(BYTE *tlv_data, int tlv_len, WORD *ptlv_tag, int *ptlv_val_len, BYTE *ptlv_value);
extern BOOL wfaEncodeTLV(WORD the_tag, WORD the_len, BYTE *the_value, BYTE *tlv_data);

extern WORD wfaGetValueType(BYTE the_tag, BYTE *tlv_data);

#endif
```

## inc/wfa_ver.h
```c
/****************************************************************************
*
* Copyright (c) 2016 Wi-Fi Alliance
*
* Permission to use, copy, modify, and/or distribute this software for any
* purpose with or without fee is hereby granted, provided that the above
* copyright notice and this permission notice appear in all copies.
*
* THE SOFTWARE IS PROVIDED "AS IS" AND THE AUTHOR DISCLAIMS ALL WARRANTIES
* WITH REGARD TO THIS SOFTWARE INCLUDING ALL IMPLIED WARRANTIES OF
* MERCHANTABILITY AND FITNESS. IN NO EVENT SHALL THE AUTHOR BE LIABLE FOR ANY
* SPECIAL, DIRECT, INDIRECT, OR CONSEQUENTIAL DAMAGES OR ANY DAMAGES WHATSOEVER
* RESULTING FROM LOSS OF USE, DATA OR PROFITS, WHETHER IN AN ACTION OF CONTRACT,
* NEGLIGENCE OR OTHER TORTIOUS ACTION, ARISING OUT OF OR IN CONNECTION WITH THE
* USE OR PERFORMANCE OF THIS SOFTWARE.
*
*****************************************************************************/


#ifndef WFA_VER_H
#define WFA_VER_H

#define WFA_VERNAM_LEN      32
#define WFA_SYSTEM_VER      "WTS-1.0.0-HE"

#endif
```
