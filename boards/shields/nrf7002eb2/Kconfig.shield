## dts/bindings/wifi/nordic,wifi-pcb.yaml
```yaml
# Copyright (c) 2024 Nordic Semiconductor ASA
# SPDX-License-Identifier: Apache-2.0

description: Nordic Wi-Fi chip PCB/antenna configuration

properties:
  wifi-ant-gain-2g:
    type: int
    description: Antenna gain for 2.4 GHz band
    required: true

  wifi-ant-gain-5g-band1:
    type: int
    description: Antenna gain for 5 GHz band1 (5150-5350 MHz)
    required: true

  wifi-ant-gain-5g-band2:
    type: int
    description: Antenna gain for 5 GHz band2 (5470-5730 MHz)
    required: true

  wifi-ant-gain-5g-band3:
    type: int
    description: Antenna gain for 5 GHz band3 (5730-5895 MHz)
    required: true

  wifi-band-edge-2g-lo-dss:
    type: int
    description: DSSS Transmit power backoff (in dB) for lower edge of 2.4 GHz band
    required: true

  wifi-band-edge-2g-lo-ht:
    type: int
    description: HT/VHT Transmit power backoff (in dB) for lower edge of 2.4 GHz band
    required: true

  wifi-band-edge-2g-lo-he:
    type: int
    description: HE Transmit power backoff (in dB) for lower edge of 2.4 GHz band
    required: true

  wifi-band-edge-2g-hi-dsss:
    type: int
    description: DSSS Transmit power backoff (in dB) for upper edge of 2.4 GHz band
    required: true

  wifi-band-edge-2g-hi-ht:
    type: int
    description: HT/VHT Transmit power backoff (in dB) for upper edge of 2.4 GHz band
    required: true

  wifi-band-edge-2g-hi-he:
    type: int
    description: HE Transmit power backoff (in dB) for upper edge of 2.4 GHz band
    required: true

  wifi-band-edge-5g-unii-1-lo-ht:
    type: int
    description: HT Transmit power backoff (in dB) for lower edge of UNII-1 band
    required: true

  wifi-band-edge-5g-unii-1-lo-he:
    type: int
    description: HE Transmit power backoff (in dB) for lower edge of UNII-1 band
    required: true

  wifi-band-edge-5g-unii-1-hi-ht:
    type: int
    description: HT/VHT Transmit power backoff (in dB) for upper edge of UNII-1 band
    required: true

  wifi-band-edge-5g-unii-1-hi-he:
    type: int
    description: HE Transmit power backoff (in dB) for upper edge of UNII-1 band
    required: true

  wifi-band-edge-5g-unii-2a-lo-ht:
    type: int
    description: HT/VHT Transmit power backoff (in dB) for lower edge of UNII-2A band
    required: true

  wifi-band-edge-5g-unii-2a-lo-he:
    type: int
    description: HE Transmit power backoff (in dB) for lower edge of UNII-2A band
    required: true

  wifi-band-edge-5g-unii-2a-hi-ht:
    type: int
    description: HT/VHT Transmit power backoff (in dB) for upper edge of UNII-2A band
    required: true

  wifi-band-edge-5g-unii-2a-hi-he:
    type: int
    description: HE Transmit power backoff (in dB) for upper edge of UNII-2A band
    required: true

  wifi-band-edge-5g-unii-2c-lo-ht:
    type: int
    description: HT/VHT Transmit power backoff (in dB) for lower edge of UNII-2C band
    required: true

  wifi-band-edge-5g-unii-2c-lo-he:
    type: int
    description: HE Transmit power backoff (in dB) for lower edge of UNII-2C band
    required: true

  wifi-band-edge-5g-unii-2c-hi-ht:
    type: int
    description: HT/VHT Transmit power backoff (in dB) for upper edge of UNII-2C band
    required: true

  wifi-band-edge-5g-unii-2c-hi-he:
    type: int
    description: HE Transmit power backoff (in dB) for upper edge of UNII-2C band
    required: true

  wifi-band-edge-5g-unii-3-lo-ht:
    type: int
    description: HT/VHT Transmit power backoff (in dB) for lower edge of UNII-3 band
    required: true

  wifi-band-edge-5g-unii-3-lo-he:
    type: int
    description: HE Transmit power backoff (in dB) for lower edge of UNII-3 band
    required: true

  wifi-band-edge-5g-unii-3-hi-ht:
    type: int
    description: HT/VHT Transmit power backoff (in dB) for upper edge of UNII-3 band
    required: true

  wifi-band-edge-5g-unii-3-hi-he:
    type: int
    description: HE Transmit power backoff (in dB) for upper edge of UNII-3 band
    required: true

  wifi-band-edge-5g-unii-4-lo-ht:
    type: int
    description: HT/VHT Transmit power backoff (in dB) for lower edge of UNII-4 band
    required: true

  wifi-band-edge-5g-unii-4-lo-he:
    type: int
    description: HE Transmit power backoff (in dB) for lower edge of UNII-4 band
    required: true

  wifi-band-edge-5g-unii-4-hi-ht:
    type: int
    description: HT/VHT Transmit power backoff (in dB) for upper edge of UNII-4 band
    required: true

  wifi-band-edge-5g-unii-4-hi-he:
    type: int
    description: HE Transmit power backoff (in dB) for upper edge of UNII-4 band
    required: true

  wifi-pcb-loss-2g:
    type: int
    description: PCB loss for 2.4 GHz band
    required: true

  wifi-pcb-loss-5g-band1:
    type: int
    description: PCB loss for 5 GHz band (5150 MHz - 5350 MHz)
    required: true

  wifi-pcb-loss-5g-band2:
    type: int
    description: PCB loss for 5 GHz band (5470 MHz - 5730 MHz)
    required: true

  wifi-pcb-loss-5g-band3:
    type: int
    description: PCB loss for 5 GHz band (5730 MHz - 5895 MHz)
    required: true
```

## samples/benchmarks/power_consumption/Kconfig
```kconfig
#
# Copyright (c) 2026 Nordic Semiconductor ASA
#
# SPDX-License-Identifier: LicenseRef-Nordic-5-Clause
#

mainmenu "nRF7120 System ON idle power consumption demo"

config POWER_CONSUMPTION_IDLE_SECONDS
	int "System ON idle duration in seconds"
	range 1 3600
	default 10
	help
	  How long the sample sleeps (via k_sleep(), on this SoC's default
	  GRTC-backed system timer) before waking up, printing the wake
	  counter, and sleeping again.

choice POWER_CONSUMPTION_RAM_RETAIN
	prompt "RAM retention level during System ON idle"
	default POWER_CONSUMPTION_RAM_RETAIN_FULL
	help
	  Controls how much application RAM stays powered during System ON
	  idle, using the ram_pwrdn library (see
	  nrf/doc/nrf/libraries/others/ram_pwrdn.rst). Real physical SRAM on
	  nrf7120dk/nrf7120/cpuapp is 1016 KiB, not 1024 KiB -- keep this in
	  mind when reading the option names below.

config POWER_CONSUMPTION_RAM_RETAIN_64K
	bool "Retain only the first 64 KiB of RAM, power down the rest"
	select RAM_POWER_DOWN_LIBRARY
	help
	  Calls power_down_ram() once at boot to power down everything past
	  the first 64 KiB of application RAM (out of 1016 KiB total).

config POWER_CONSUMPTION_RAM_RETAIN_128K
	bool "Retain only the first 128 KiB of RAM, power down the rest"
	select RAM_POWER_DOWN_LIBRARY
	help
	  Calls power_down_ram() once at boot to power down everything past
	  the first 128 KiB of application RAM (out of 1016 KiB total).

config POWER_CONSUMPTION_RAM_RETAIN_256K
	bool "Retain only the first 256 KiB of RAM, power down the rest"
	select RAM_POWER_DOWN_LIBRARY
	help
	  Calls power_down_ram() once at boot to power down everything past
	  the first 256 KiB of application RAM (out of 1016 KiB total).

config POWER_CONSUMPTION_RAM_RETAIN_512K
	bool "Retain only the first 512 KiB of RAM, power down the rest"
	select RAM_POWER_DOWN_LIBRARY
	help
	  Calls power_down_ram() once at boot to power down everything past
	  the first 512 KiB of application RAM (out of 1016 KiB total, so
	  this leaves slightly more than half of RAM powered down, not
	  exactly half).

config POWER_CONSUMPTION_RAM_RETAIN_FULL
	bool "Retain all RAM (default) -- nothing is powered down"
	help
	  No RAM power-down call is made at all. This is the default: by
	  default, all RAM must stay retained.

config POWER_CONSUMPTION_RAM_RETAIN_UNUSED_ONLY
	bool "Power down whatever this image itself does not use"
	select RAM_POWER_DOWN_LIBRARY
	help
	  Calls power_down_unused_ram() instead of a fixed KiB boundary --
	  the ram_pwrdn library computes the unused range itself, from the
	  end of the running image to the end of application RAM. Whichever
	  RAM section still holds live image/stack data is left powered,
	  same as every other tier above.

endchoice

source "Kconfig.zephyr"
```

## samples/benchmarks/power_consumption/sample.yaml
```yaml
sample:
  name: Power consumption (System ON idle)
common:
  build_only: true
  tags: power
  platform_allow: nrf7120dk/nrf7120/cpuapp
  integration_platforms:
    - nrf7120dk/nrf7120/cpuapp
tests:
  sample.benchmarks.power_consumption.ram_retain_full:
    extra_configs:
      - CONFIG_POWER_CONSUMPTION_RAM_RETAIN_FULL=y
  sample.benchmarks.power_consumption.ram_retain_64k:
    extra_configs:
      - CONFIG_POWER_CONSUMPTION_RAM_RETAIN_64K=y
  sample.benchmarks.power_consumption.ram_retain_128k:
    extra_configs:
      - CONFIG_POWER_CONSUMPTION_RAM_RETAIN_128K=y
  sample.benchmarks.power_consumption.ram_retain_256k:
    extra_configs:
      - CONFIG_POWER_CONSUMPTION_RAM_RETAIN_256K=y
  sample.benchmarks.power_consumption.ram_retain_512k:
    extra_configs:
      - CONFIG_POWER_CONSUMPTION_RAM_RETAIN_512K=y
  sample.benchmarks.power_consumption.ram_powerdown_unused:
    extra_configs:
      - CONFIG_POWER_CONSUMPTION_RAM_RETAIN_UNUSED_ONLY=y
```

## samples/wifi/radio_test/single_domain/Kconfig
```kconfig
#
# Copyright (c) 2024 Nordic Semiconductor
#
# SPDX-License-Identifier: LicenseRef-Nordic-5-Clause
#

mainmenu "Nordic Wi-Fi Bluetooth LE Radio test sample"

config SAMPLE_WIFI_RADIO_TEST_WIFI_ONLY
	bool "Wi-Fi only mode"
	help
	  Enable Wi-Fi only radio test mode, excluding peripheral BLE radio test
	  functionality. WiFi radio test shell is available via the WiFi driver
	  for nRF71. Works on both nRF70 and nRF71 (BLE radio test not available).

rsource "../../../../samples/peripheral/radio_test/Kconfig"
```

## subsys/mpsl/antsw/Kconfig
```kconfig
#
# Copyright (c) 2026 Nordic Semiconductor ASA
#
# SPDX-License-Identifier: LicenseRef-Nordic-5-Clause
#

config MPSL_NRF71_ANTSW
	bool "nRF71 antenna switch control for Wi-Fi and BLE"
	depends on SOC_SERIES_NRF71
	depends on MPSL
	depends on DT_HAS_NORDIC_NRF71_ANTSW_ENABLED
	depends on DT_HAS_NORDIC_NRF_PWR_ANTSWC_ENABLED
	depends on !TRUSTED_EXECUTION_NONSECURE
	depends on !MPSL_DYNAMIC_INTERRUPTS
	default y
	help
	  Use the ANTSWC peripheral to arbitrate access for the shared 2.4GHz
	  antenna between Wi-Fi and BLE.
```

## subsys/net/lib/wifi_keys/Kconfig
```kconfig
#
# Copyright (c) 2026 Nordic Semiconductor
#
# SPDX-License-Identifier: LicenseRef-Nordic-5-Clause
#

config HAS_HW_NRF_WIFI_KEYS
	def_bool SOC_SERIES_NRF71

config WIFI_KEYS_KMU_HW_PRESENT
	def_bool SOC_SERIES_NRF71

config WIFI_KEYS_KMU_VERIFY_COPY
	bool "Verify KMU key copy to a readable buffer (test)"
	help
	  When enabled, the first 16-byte key push is also done to a k_malloc'd
	  buffer so the host can read back and log the bytes KMU wrote. Use to
	  verify byte order (no reverse). Secure RAM (0x28400000) is not readable
	  from the host. Requires KMU to accept the test destination address.

# Configure WIFI_KEYS_LOG_LEVEL
module = WIFI_KEYS
module-str = Log level for Wi-Fi Keys PSA driver
module-help = Sets log level for Wi-Fi Keys PSA driver
source "$(ZEPHYR_BASE)/subsys/logging/Kconfig.template.log_config"

config WIFI_KEYS_LOG_LEVEL
	default 4 # DEBUG
```

## subsys/nrf_security/src/drivers/wifi_crypto/Kconfig
```kconfig
module = WIFI_CRYPTO_DRIVER
module-dep = LOG
module-str = Log level for Wi-Fi Crypto driver
module-help = Sets log level for Wi-Fi Crypto driver
source "$(ZEPHYR_BASE)/subsys/logging/Kconfig.template.log_config"


config WIFI_CRYPTO_DRIVER_LOG_LEVEL
	default 4 # DEBUG

rsource 'psa_driver.Kconfig'

#endif # PSA_CRYPTO_DRIVER_CRACEN
```

## tests/crypto/wpa3_psa/testcase.yaml
```yaml
tests:
  crypto.wpa3_psa:
    tags: crypto psa wpa3-sae
    platform_allow: nrf7002dk/nrf5340/cpuapp
    integration_platforms:
      - nrf7002dk/nrf5340/cpuapp
    filter: CONFIG_PSA_WANT_ALG_WPA3_SAE
```
