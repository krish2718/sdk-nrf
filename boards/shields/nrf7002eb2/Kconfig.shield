## boards/shields/nrf7002eb2/Kconfig.shield
```kconfig
# Copyright (c) 2025 Nordic Semiconductor ASA
# SPDX-License-Identifier: LicenseRef-Nordic-5-Clause

config SHIELD_NRF7002EB2_NRF54L
	def_bool $(shields_list_contains,nrf7002eb2_nrf54l)

config SHIELD_NRF7002EB2_NRF54H
	def_bool $(shields_list_contains,nrf7002eb2_nrf54h)

config SHIELD_NRF7002EB2_NRF7001_NRF54L
	def_bool $(shields_list_contains,nrf7002eb2_nrf7001_nrf54l)

config SHIELD_NRF7002EB2_NRF7001_NRF54H
	def_bool $(shields_list_contains,nrf7002eb2_nrf7001_nrf54h)

config SHIELD_NRF7002EB2_NRF7000_NRF54L
	def_bool $(shields_list_contains,nrf7002eb2_nrf7000_nrf54l)

config SHIELD_NRF7002EB2_NRF7000_NRF54H
	def_bool $(shields_list_contains,nrf7002eb2_nrf7000_nrf54H)

config SHIELD_NRF7002EB2_COEX
	def_bool $(shields_list_contains,nrf7002eb2_coex)
```

## boards/shields/nrf7002eb2_sqspi/Kconfig.shield
```kconfig
# Copyright (c) 2025 Nordic Semiconductor ASA
# SPDX-License-Identifier: LicenseRef-Nordic-5-Clause

config SHIELD_NRF7002EB2_SQSPI
	def_bool $(shields_list_contains,nrf7002eb2_sqspi)
```
