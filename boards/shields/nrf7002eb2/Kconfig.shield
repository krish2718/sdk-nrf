## drivers/nrf_wifi71/Kconfig.nrfwifi
```kconfig
# Nordic Wi-Fi driver for nRF71 series SoCs
#
# Copyright (c) 2025 Nordic Semiconductor
#
# SPDX-License-Identifier: Apache-2.0
#
menuconfig WIFI_NRF71
	bool "nRF71 driver"
	select NET_L2_WIFI_MGMT if NETWORKING
	select NET_L2_ETHERNET_MGMT if NETWORKING && NET_L2_ETHERNET
	select WIFI_USE_NATIVE_NETWORKING if NETWORKING
	select EXPERIMENTAL if !SOC_SERIES_NRF53X && !SOC_SERIES_NRF91X
	default y
	depends on DT_HAS_NORDIC_WIFI71_ENABLED
	help
	  Nordic Wi-Fi Driver

if WIFI_NRF71
choice NRF71_OPER_MODES
	bool "nRF71 operating modes"
	default NRF71_SCAN_ONLY
	help
	  Select the operating mode of the nRF71 driver

config NRF71_SCAN_ONLY
	bool "Scan only mode of the nRF71 driver"
	help
	  Select this option to enable scan only mode of the nRF71 driver

config NRF71_SYSTEM_MODE
	bool "System mode of the nRF71 driver"
	help
	  Select this option to enable system mode of the nRF71 driver

config NRF71_RADIO_TEST
	bool "Radio test mode of the nRF71 driver"

endchoice

config NET_L2_ETHERNET
	default y if (!NRF71_RADIO_TEST && !NRF71_OFFLOADED_RAW_TX)

if NRF71_SYSTEM_MODE
config NRF71_STA_MODE
	bool "nRF71 STA mode"
	default y
	depends on WIFI_NRF7102 || WIFI_NRF7101
	select WIFI_NM_WPA_SUPPLICANT
	select NRF71_DATA_TX
	help
	  Select this option to enable STA mode of the nRF71 driver.
config NRF71_AP_MODE
	bool "Access point mode"
	depends on WIFI_NRF7102 || WIFI_NRF7101
	select NRF71_DATA_TX
	depends on WIFI_NM_WPA_SUPPLICANT_AP
	default y if WIFI_NM_WPA_SUPPLICANT_AP

config NRF71_P2P_MODE
	bool "P2P support in driver"

config NRF71_RAW_DATA_TX
	bool "RAW TX data path in the driver"
	select EXPERIMENTAL

config NRF71_RAW_DATA_RX
	bool "RAW RX sniffer operation in the driver"
	select EXPERIMENTAL

config NRF71_PROMISC_DATA_RX
	bool "Promiscuous RX sniffer operation in the driver"
	select WIFI_NM_WPA_SUPPLICANT
	select EXPERIMENTAL
	select NET_PROMISCUOUS_MODE

config NRF71_DATA_TX
	bool
endif # NRF71_SYSTEM_MODE

config NRF_WIFI_IF_AUTO_START
	bool "Wi-Fi interface auto start on boot"
	default y

config NRF_WIFI_LOW_POWER
	bool "Low power mode in nRF Wi-Fi chipsets"
	default y

config NRF71_TCP_IP_CHECKSUM_OFFLOAD
	bool "TCP/IP checksum offload"
	default y

config NRF71_REG_DOMAIN
	string "The ISO/IEC alpha2 country code for the country in which this device is currently operating. Default 00 (World regulatory)"
	# 00 is used for World regulatory
	default "00"

# Making calls to RPU from net_mgmt callbacks.
#
# If WPA supplicant is enabled, then don't override as it has higher
# stack requirements.
config NET_MGMT_EVENT_STACK_SIZE
	default 2048 if !WIFI_NM_WPA_SUPPLICANT
	default 4600

config NRF71_LOG_VERBOSE
	bool "Maintains the verbosity of information in logs"
	default y

module = WIFI_NRF71
module-dep = LOG
module-str = Log level for Wi-Fi nRF71 driver
module-help = Sets log level for Wi-Fi nRF71 driver
source "subsys/logging/Kconfig.template.log_config"

config WIFI_NRF71_LOG_LEVEL
	# Enable error by default
	default 1

config NRF71_WORKQ_STACK_SIZE
	int "Stack size for workqueue"
	default 4096

config NRF71_WORKQ_MAX_ITEMS
	int "Maximum work items for all workqueues"
	default 100

config NRF71_MAX_TX_PENDING_QLEN
	int "Maximum number of pending TX packets"
	default 18

# Performance fine tuning options
config NRF71_RX_NUM_BUFS
	int "Number of RX buffers"
	default 48

config NRF71_MAX_TX_AGGREGATION
	int "Maximum number of TX packets to aggregate"
	default 12

config NRF71_MAX_TX_TOKENS
	int "Maximum number of TX tokens"
	range 5 12 if !NRF71_RADIO_TEST
	default 10

config NRF71_TX_MAX_DATA_SIZE
	int "Maximum size of TX data"
	default 1600

config NRF71_RX_MAX_DATA_SIZE
	int "Maximum size of RX data"
	default 1600

config NRF71_TX_DONE_WQ_ENABLED
	bool "TX done workqueue (impacts performance negatively)"

config NRF71_RX_WQ_ENABLED
	bool "RX workqueue"

# Use for IRQ processing (TODO: using for BH processing causes issues)
config NUM_METAIRQ_PRIORITIES
	default 1

config NRF71_IRQ_WQ_PRIORITY
	int "Priority of the workqueue for handling IRQs"
	default -15

config NRF71_BH_WQ_PRIORITY
	int "Priority of the workqueue for handling bottom half"
	default 0

config NRF71_IRQ_WQ_STACK_SIZE
	int "Stack size of the workqueue for handling IRQs"
	default 2048

config NRF71_BH_WQ_STACK_SIZE
	int "Stack size of the workqueue for handling bottom half"
	default 2048

if NRF71_TX_DONE_WQ_ENABLED
config NRF71_TX_DONE_WQ_PRIORITY
	int "Priority of the workqueue for handling TX done"
	default 0

config NRF71_TX_DONE_WQ_STACK_SIZE
	int "Stack size of the workqueue for handling TX done"
	default 2048
endif # NRF71_TX_DONE_WQ_ENABLED
if NRF71_RX_WQ_ENABLED
config NRF71_RX_WQ_PRIORITY
	int "Priority of the workqueue for handling RX"
	default 0

config NRF71_RX_WQ_STACK_SIZE
	int "Stack size of the workqueue for handling RX"
	default 2048
endif # NRF71_RX_WQ_ENABLED

if NRF_WIFI_LOW_POWER
config NRF71_RPU_PS_IDLE_TIMEOUT_MS
	int "RPU power save idle timeout in milliseconds"
	default 10

config NRF71_RPU_EXTEND_TWT_SP
	bool "extending TWT service period"
	help
	  In case frames accepted before the beginning of SP are not
	  transmitted before the SP completes, then typically they are
	  dropped to conform to the SP window as per the specification that is, no
	  transmission outside SP window.
	  This feature mitigates frame loss by transmitting even after SP
	  completion by using a standard contention mechanism, which is allowed
	  in specification but not recommended. As the device is actively transmitting
	  beyond SP, the power consumption increases depending on the amount
	  of traffic available at the start of the SP.
	  Note that if a frame is sent after the SP starts, it will be queued, and this
	  mechanism is not used.
endif # NRF_WIFI_LOW_POWER

config WIFI_FIXED_MAC_ADDRESS
	string "Wi-Fi Fixed MAC address in format XX:XX:XX:XX:XX:XX"
	help
	  This option overrides the MAC address read from OTP. It is strictly for testing purposes only.

choice
	prompt "Wi-Fi MAC address type"
	default NRF71_FIXED_MAC_ADDRESS_ENABLED if WIFI_FIXED_MAC_ADDRESS != ""
	default NRF71_WIFI_OTP_MAC_ADDRESS
	help
	  Select the type of MAC address to be used by the Wi-Fi driver

config NRF71_WIFI_OTP_MAC_ADDRESS
	bool "Use MAC address from OTP"
	help
	  This option uses the MAC address stored in the OTP memory of the nRF71.

config NRF71_FIXED_MAC_ADDRESS_ENABLED
	bool "fixed MAC address"
	help
	  Enable fixed MAC address

config NRF71_WIFI_RANDOM_MAC_ADDRESS
	bool "Random MAC address generation at runtime"
	depends on ENTROPY_GENERATOR
	help
	  This option enables random MAC address generation at runtime.
	  The random MAC address is generated using the entropy device random generator.

endchoice

config NRF71_RSSI_STALE_TIMEOUT_MS
	int "RSSI stale timeout in milliseconds"
	default 1000
	help
	  RSSI stale timeout is the period after which the driver queries
	  RPU to get the RSSI value.
	  If data is active (for example, ping), the driver stores the RSSI value from
	  the received frames and provides this stored information
	  to wpa_supplicant. In this case, a higher value will be suitable
	  as the stored RSSI value at the driver will be updated regularly.
	  If data is not active or after the stale timeout duration,
	  the driver queries the RPU to get the RSSI value
	  and provides it to wpa_supplicant. The value should be set to a lower
	  value as the driver does not store it and requires RPU to provide the
	  information.

config NRF_WIFI_CTRL_HEAP_SIZE
	int "Dedicated memory pool for control plane"
	default 20000

config NRF_WIFI_DATA_HEAP_SIZE
	int "Dedicated memory pool for data plane"
	default 0 if NRF71_RADIO_TEST || NRF71_OFFLOADED_RAW_TX
	default 8000 if NRF71_SCAN_ONLY
	default 110000 if !SOC_FAMILY_NORDIC_NRF
	default 130000

if NETWORKING
# Finetune defaults for certain system components used by the driver

config SYSTEM_WORKQUEUE_STACK_SIZE
	default 4096

config NET_TX_STACK_SIZE
	default 4096

config NET_RX_STACK_SIZE
	default 4096

config NET_TC_TX_COUNT
	default 1

endif # NETWORKING

# nRF71 now uses variable buffers as default to optimize RAM usage. Default pool sizes are used, samples/apps can override
# for higher performance.
choice NET_PKT_DATA_ALLOC_TYPE
	default NET_BUF_VARIABLE_DATA_SIZE
endchoice

config MAIN_STACK_SIZE
	default 4096

config SHELL_STACK_SIZE
	default 4096

# Override the Wi-Fi subsystems WIFI_MGMT_SCAN_SSID_FILT_MAX parameter,
# since we support a maximum of 2 SSIDs for scan result filtering.
config WIFI_MGMT_SCAN_SSID_FILT_MAX
	default 2

config NRF_WIFI_SCAN_MAX_BSS_CNT
	int "Maximum number of scan results to return."
	default 0
	range 0 65535
	help
	  Maximum number of scan results to return. 0 represents unlimited number of BSSes.

config NRF_WIFI_BEAMFORMING
	bool "Wi-Fi beamforming. Enabling beamforming can provide a slight improvement in performance, whereas disabling it can provide better power savings in low network activity applications"
	default y

config WIFI_NRF71_SCAN_TIMEOUT_S
	int "Scan timeout in seconds"
	default 30

menu "nRF Wi-Fi operation band(s)"
	visible if !NRF71_2_4G_ONLY

config NRF_WIFI_2G_BAND
	bool "Set operation band to 2.4GHz"
	default y if NRF71_2_4G_ONLY

config NRF_WIFI_5G_BAND
	bool "Set operation band to 5GHz"
	depends on !NRF71_2_4G_ONLY

config NRF_WIFI_OP_BAND
	int "Options to set operation band"
	default 1 if NRF_WIFI_2G_BAND
	default 2 if NRF_WIFI_5G_BAND
	default 3
	help
	  Set this option to select frequency band
	  1 - 2.4GHz
	  2 - 5GHz
	  3 - All ( 2.4GHz and 5GHz )
endmenu

config NRF_WIFI_IFACE_MTU
	int "MTU for Wi-Fi interface"
	range 576 2304 if NET_IPV4
	range 1280 2304 if NET_IPV6
	default 1500

config WIFI_NRF71_SKIP_LOCAL_ADMIN_MAC
	bool "Suppress networks with non-individual MAC addresses as BSSID in the scan results"
	help
	  Wi-Fi access points use locally administered MAC addresses to manage
	  multiple virtual interfaces. For geo-location use cases, these networks
	  from the virtual interfaces do not help in any way as they are co-located with the primary interface
	  that has a globally unique MAC address.
	  So, to save resources, this option drops such networks from the scan results.

config WIFI_NRF71_SCAN_DISABLE_DFS_CHANNELS
	bool "Disables DFS channels in scan operation"
	help
	  This option disables inclusion of the DFS channels in the scan operation.
	  This is useful to reduce the scan time, as DFS channels are seldom used.

config NET_INTERFACE_NAME_LEN
	# nordic_wlanN
	default 15

config NRF_WIFI_AP_DEAD_DETECT_TIMEOUT
	int "Access point dead detection timeout in seconds"
	range 1 30
	default 20
	help
		The number of seconds after which the AP is declared dead if no beacons
		are received from the AP. This is used to detect AP silently going down, for example, due to power off.

config NRF_WIFI_FEAT_WMM
	bool "WMM/QoS support"
	default y
	help
	  This option controls disable/enable of the WMM (Wireless Multi-Media) feature.

choice NRF_WIFI_PS_DATA_RETRIEVAL_MECHANISM
	prompt "Power save data retrieval mechanism"
	default NRF_WIFI_PS_POLL_BASED_RETRIEVAL
	help
	  Select the mechanism to retrieve buffered data from AP.

config NRF_WIFI_PS_POLL_BASED_RETRIEVAL
	bool "PS-Poll frame-based mechanism to retrieve buffered data from AP"
	help
	  When the AP notifies about the availability of buffered data, the STA stays in power save
	  and retrieves the frames one-by-one. This conserves more power but adds latency
	  to the traffic. It is ideal for minimum number of frames.

config NRF_WIFI_QOS_NULL_BASED_RETRIEVAL
	bool "QoS null frame-based mechanism to retrieve buffered data from AP"
	help
	  When the AP notifies about the availability of buffered data, the STA comes out of
	  power save, and then AP can deliver all buffered frames without any additional
	  overhead or latency, but STA enters power save after a delay costing more power
	  depending on the delay. It is ideal for heavy buffered traffic.
endchoice

config NRF_WIFI_MGMT_BUFF_OFFLOAD
	bool "Management buffer offload"
	# Raw scan results need host based refilling
	depends on !WIFI_MGMT_RAW_SCAN_RESULTS
	default y
	help
	  This option offloads the refilling of management buffers to the UMAC, saving the host
	  from having to exchange commands and events for every management packet even if it is
	  consumed by UMAC.

config NRF_WIFI_FEAT_KEEPALIVE
	bool "Wi-Fi keepalive feature for connection maintenance"
	depends on NRF71_STA_MODE
	help
	  Enable the Wi-Fi keepalive feature to keep the connection alive by sending
	  keepalive packets to the AP. This feature is primarily intended to interoperate with APs
	  that disconnect idle clients without any explicit checks. It slightly increases
	  power consumption.

if NRF_WIFI_FEAT_KEEPALIVE
config NRF_WIFI_KEEPALIVE_PERIOD_S
	int "Keepalive period in seconds"
	range 30 3600
	default 60
	help
	  Keepalive period in seconds to send keepalive packets to the AP.
endif

choice NRF_WIFI_PS_EXIT_STRATEGY
	prompt "Power save exit strategy"
	default NRF_WIFI_PS_INT_PS
	help
	  Select the power save exit strategy to retrieve buffered data from AP.

config NRF_WIFI_PS_EXIT_EVERY_TIM
	bool "Exit power save every time to retrieve buffered data from AP"
	help
	  Exit power save every time to retrieve buffered data from AP. Entering back to
	  power save mode might take some time and power.

config NRF_WIFI_PS_INT_PS
	bool "Exit power save based on an intelligent algorithm"
	help
	  Exit power save based on an intelligent algorithm to retrieve buffered data from the AP.
	  The algorithm tracks the buffered data at the AP and then dynamically decides
	  whether to stay in PS (for a lower amount of buffered data) or exit PS (for a higher
	  amount of buffered data).
endchoice

config NRF71_PASSIVE_SCAN_ONLY
	bool "Forced Passive scan"
	depends on NRF71_SCAN_ONLY
	help
	  Enable this configuration to force passive scan on all channels.
	  This will override application-specified scan type.

config NRF_WIFI_DISPLAY_SCAN_BSS_LIMIT
	# Display scan BSS entries limit
	# By default, the limit is 250 in scan-only mode and 150 in regular mode.
	int "Display scan bss limit"
	range 1 450 if NRF71_SCAN_ONLY
	def_int 250 if NRF71_SCAN_ONLY
	range 1 160
	def_int 150
	help
	  Number of BSS entries in scan result.

config NRF_WIFI_COEX_DISABLE_PRIORITY_WINDOW_FOR_SCAN
	bool "Force disable priority window for scan in the case of coexistence with Short Range radio"
	help
	  Enable this configuration to disable priority window for scan
	  in the case of coexistence with Short Range radio.

if NETWORKING
config NRF_WIFI_ZERO_COPY_TX
	bool "Zero copy Transmit path [EXPERIMENTAL]"
	select NET_L2_ETHERNET_RESERVE_HEADER
	select EXPERIMENTAL
	# 54L has lower RAM
	default y if SOC_SERIES_NRF54LX
	help
	  Enable this configuration to use zero copy Transmit path.
	  The driver will use the network buffer directly for transmission
	  without copying the data to the driver's buffer. This reduces the
	  driver heap memory usage without much impact on the performance.

	  The application should configure the network buffers to ensure that
	  the whole packet fits in a single buffer, else the driver will fallback
	  to the normal copy path, but the memory requirements would still match
	  to the zero copy path and may be sub-optimal for the normal copy path.

endif # NETWORKING

config NRF_WIFI_MAX_PS_POLL_FAIL_CNT
	int "Maximum number of PS-Poll failures"
	default 10
	range 10 4294967295
	help
	  Maximum number of PS-Poll failures before entering qos null-based power save.

config NRF_WIFI_RX_STBC_HT
	bool "Receive packets encoded with STBC in HT (Wi-Fi4) mode"
	default y
	help
	  Receive packets encoded with STBC (Space-Time Block Coding)
	  in HT (Wi-Fi4) mode.
endif # WIFI_NRF71
```
