/*
 * Copyright (c) 2025 Nordic Semiconductor ASA
 *
 * SPDX-License-Identifier: LicenseRef-Nordic-5-Clause
 */
#include <freq.h>

/ {
	chosen {
		zephyr,wifi = &wlan0;
	};
};

&wifi_spi {
	status = "okay";

	nrf70: nrf7001-spi@0 {
		compatible = "nordic,nrf7001-spi";
		status = "okay";

		/* Include common nRF70 overlays */
		#include "nrf7002eb2_common.dtsi"
	};
};
