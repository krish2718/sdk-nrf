/*
 * Copyright (c) 2024 Nordic Semiconductor ASA
 *
 * SPDX-License-Identifier: Apache-2.0
 */
#include <freq.h>

&spi130 {
	status = "okay";
	
	nrf70: nrf7002-spi@0 {
		compatible = "nordic,nrf7002-spi";
		status = "okay";
		reg = <0>;
		spi-max-frequency = <DT_FREQ_M(8)>;
		
		/* Include common nRF70 overlays */
		#include "nrf7002eb2_common.dtsi"
		#include "nrf7002eb2_common_5g.dtsi"
	};
};

&gpio1 {
	status = "okay";
};

