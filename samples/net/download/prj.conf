## Kconfig
```
menu "Download sample"

config SAMPLE_SECURE_SOCKET
	bool "Use TLS/DTLS"
	default y

if SAMPLE_SECURE_SOCKET

config SAMPLE_SEC_TAG
	int "Security tag"
	default 42

config SAMPLE_PROVISION_CERT
	bool "Provision root CA certificate"
	default y
	help
	  Provision the root CA certificate for the server to the modem. This is needed for secure
	  connections.
	  Disable this option to avoid overwriting an existing root CA certificate already stored in
	  the modem.

config SAMPLE_CERT_FILE
	string "Certificate file name"
	default "cert/file-example.pem"
	depends on SAMPLE_PROVISION_CERT

config SAMPLE_TLS_DIAG
	bool "Print TLS verification hints on download errors"
	default y
	help
	  On secure-socket download errors, print short hints for
	  MBEDTLS_ERR_X509_CERT_VERIFY_FAILED (-0x2700) and verify flags.

endif

choice SAMPLE_FILE
	prompt "Test file"

config SAMPLE_FILE_HTTP
	bool "HTTP test file"
	depends on !SAMPLE_SECURE_SOCKET
config SAMPLE_FILE_HTTPS
	bool "HTTPS test file"
	depends on SAMPLE_SECURE_SOCKET
config SAMPLE_FILE_CUSTOM
	bool "Custom test file"

endchoice

config SAMPLE_FILE_URL
	string "URL of resource to download" if SAMPLE_FILE_CUSTOM
	default "http://speedtest.ftp.otenet.gr/files/test100k.db" if SAMPLE_FILE_HTTP
	default "https://nrfconnectsdk.s3.eu-central-1.amazonaws.com/sample-img-100kb.png" if SAMPLE_FILE_HTTPS

config SAMPLE_COMPUTE_HASH
	bool "Compute sha256 hash"
	select PSA_CRYPTO
	select PSA_WANT_ALG_SHA_256

config SAMPLE_COMPARE_HASH
	bool "Compare hash"
	depends on SAMPLE_COMPUTE_HASH

config SAMPLE_SHA256_HASH
	string "sha256 hash"
	depends on SAMPLE_COMPARE_HASH
	default "f627ca4c2c322f15db26152df306bd4f983f0146409b81a4341b9b340c365a16" if SAMPLE_FILE_HTTP
	default "344577d739dc0e9f9498c13be2fbc7fb947abd291e9e57db9e9ca4a89ccd5f63" if SAMPLE_FILE_HTTPS

endmenu

menu "Zephyr Kernel"
source "Kconfig.zephyr"
endmenu
```

## prj.conf
```kconfig
#
# Copyright (c) 2021 Nordic Semiconductor ASA
#
# SPDX-License-Identifier: LicenseRef-Nordic-5-Clause
#

CONFIG_DOWNLOADER=y
CONFIG_DOWNLOADER_STACK_SIZE=6144

# Networking
CONFIG_NETWORKING=y
CONFIG_NET_CONNECTION_MANAGER=y
CONFIG_NET_SOCKETS=y
CONFIG_POSIX_API=y
CONFIG_NET_IPV4=y
CONFIG_HEAP_MEM_POOL_SIZE=1280


CONFIG_MBEDTLS_DEBUG=y
CONFIG_MBEDTLS_DEBUG_C=y
CONFIG_MBEDTLS_DEBUG_LEVEL=4
CONFIG_MBEDTLS_LOG_LEVEL_DBG=y
```

## boards/nrf54h20dk_nrf54h20_cpuapp.conf
```kconfig
#
# Copyright (c) 2024 Nordic Semiconductor ASA
#
# SPDX-License-Identifier: LicenseRef-Nordic-5-Clause
#

# Logging
CONFIG_LOG=y
CONFIG_LOG_MODE_IMMEDIATE=y

# Wi-Fi
CONFIG_WIFI=y
CONFIG_WIFI_NRF70=y
CONFIG_WIFI_CREDENTIALS=y
# Needed for Wi-Fi credentials
CONFIG_FLASH=y
CONFIG_FLASH_PAGE_LAYOUT=y
CONFIG_FLASH_MAP=y
CONFIG_ZMS=y
CONFIG_SETTINGS=y

# WPA supplicant
CONFIG_WIFI_NM_WPA_SUPPLICANT=y
CONFIG_WIFI_NM_WPA_SUPPLICANT_LOG_LEVEL_INF=y

# Networking
CONFIG_NET_L2_ETHERNET=y
CONFIG_NET_SOCKETS=y
CONFIG_NET_IPV6=y
CONFIG_NET_UDP=y
CONFIG_NET_TCP=y
CONFIG_NET_DHCPV4=y
CONFIG_DNS_RESOLVER=y
CONFIG_DNS_RESOLVER_AI_MAX_ENTRIES=4

# NET sockets
CONFIG_NET_UDP=y
CONFIG_NET_TCP=y
CONFIG_NET_MAX_CONN=6
CONFIG_NET_MAX_CONTEXTS=5
CONFIG_NET_SOCKETS_POLL_MAX=8
CONFIG_NET_SOCKETS_OFFLOAD=n
CONFIG_NET_DHCPV4=y
CONFIG_NET_CONTEXT_SNDTIMEO=y
CONFIG_NET_CONTEXT_RCVTIMEO=y
CONFIG_NET_MAX_CONTEXTS=3

# NET buffers
CONFIG_NET_PKT_TX_COUNT=6
CONFIG_NET_PKT_RX_COUNT=6
CONFIG_NET_BUF_TX_COUNT=12
CONFIG_NET_BUF_RX_COUNT=6
CONFIG_NRF70_RX_NUM_BUFS=6
CONFIG_NET_PKT_BUF_RX_DATA_POOL_SIZE=4096
CONFIG_NET_PKT_BUF_TX_DATA_POOL_SIZE=4096
CONFIG_NRF70_MAX_TX_AGGREGATION=1

# Kernel options
CONFIG_POSIX_NETWORKING=y
CONFIG_ZVFS_OPEN_MAX=21

# Shell
CONFIG_SHELL=y
CONFIG_SHELL_CMDS_RESIZE=n
CONFIG_NET_L2_WIFI_SHELL=y

# TLS
CONFIG_NET_SOCKETS_SOCKOPT_TLS=y
CONFIG_NET_SOCKETS_TLS_MAX_CONTEXTS=1
CONFIG_NRF_SECURITY=y
CONFIG_MBEDTLS=y
CONFIG_MBEDTLS_ENABLE_HEAP=y
CONFIG_MBEDTLS_SSL_KEEP_PEER_CERTIFICATE=n
CONFIG_MBEDTLS_SSL_SERVER_NAME_INDICATION=y
CONFIG_TLS_CREDENTIALS=y
CONFIG_TLS_CREDENTIALS_BACKEND_VOLATILE=y
# Legacy API is required for RSA
CONFIG_MBEDTLS_LEGACY_CRYPTO_C=y
CONFIG_MBEDTLS_RSA_C=y
CONFIG_PSA_WANT_KEY_TYPE_RSA_KEY_PAIR_IMPORT=y
CONFIG_PSA_WANT_KEY_TYPE_RSA_KEY_PAIR_EXPORT=y
CONFIG_PSA_WANT_KEY_TYPE_RSA_KEY_PAIR_GENERATE=y
# RSA PKCS#1 v1.5 verify for X.509 (nRF54H Cracen/PSA; nRF5340 path differs)
CONFIG_PSA_WANT_ALG_RSA_PKCS1V15_SIGN=y
CONFIG_PSA_WANT_ALG_RSA_PKCS1V15_SIGN_RAW=y
# Set MPI (Multiple Precision Integer) size limit to 512 bytes for handling of 4 kb certificates
# in cryptographic operations.
CONFIG_MBEDTLS_MPI_MAX_SIZE=512
# ECDH/ECDSA are needed for TLS handshake
CONFIG_PSA_WANT_ALG_ECDH=y
CONFIG_PSA_WANT_ALG_ECDSA=y

# Zephyr NET Connection Manager Connectivity layer.
CONFIG_L2_WIFI_CONNECTIVITY=y
CONFIG_L2_WIFI_CONNECTIVITY_AUTO_CONNECT=y
CONFIG_L2_WIFI_CONNECTIVITY_AUTO_DOWN=n

# Stack sizes
CONFIG_NET_CONNECTION_MANAGER_MONITOR_STACK_SIZE=5000
CONFIG_MAIN_STACK_SIZE=6144
CONFIG_NET_TX_STACK_SIZE=2048
CONFIG_NET_RX_STACK_SIZE=2048
CONFIG_NET_MGMT_EVENT_STACK_SIZE=4096
CONFIG_SYSTEM_WORKQUEUE_STACK_SIZE=3100
CONFIG_NRF70_IRQ_WQ_STACK_SIZE=1024
CONFIG_NRF70_BH_WQ_STACK_SIZE=2300
CONFIG_SHELL_STACK_SIZE=4400
CONFIG_ISR_STACK_SIZE=512

# Heap sizes
CONFIG_HEAP_MEM_POOL_IGNORE_MIN=y
CONFIG_MBEDTLS_HEAP_SIZE=65000
CONFIG_HEAP_MEM_POOL_SIZE=32000
CONFIG_NRF_WIFI_CTRL_HEAP_SIZE=20000
CONFIG_NRF_WIFI_DATA_HEAP_SIZE=40000
# POSIX API memory optimizations
CONFIG_POSIX_FD_MGMT=n
CONFIG_POSIX_MESSAGE_PASSING=n
CONFIG_POSIX_THREAD_THREADS_MAX=0

# Floating-point printf support
CONFIG_CBPRINTF_FP_SUPPORT=y
```

## src/main.c
```c
/*
 * Copyright (c) 2020 Nordic Semiconductor ASA
 *
 * SPDX-License-Identifier: LicenseRef-Nordic-5-Clause
 */

#include <errno.h>
#include <string.h>
#include <stdlib.h>
#include <zephyr/kernel.h>
#include <zephyr/net/socket.h>
#include <zephyr/net/net_if.h>
#include <zephyr/net/conn_mgr_connectivity.h>
#include <zephyr/net/conn_mgr_monitor.h>
#include <net/downloader.h>

#include <zephyr/logging/log.h>
LOG_MODULE_REGISTER(download, LOG_LEVEL_INF);


#if CONFIG_MODEM_KEY_MGMT
#include <modem/modem_key_mgmt.h>
#else
#include <zephyr/net/tls_credentials.h>
#endif

#define URL CONFIG_SAMPLE_FILE_URL
#define SEC_TAG CONFIG_SAMPLE_SEC_TAG

/* Macros used to subscribe to specific Zephyr NET management events. */
#define L4_EVENT_MASK (NET_EVENT_L4_CONNECTED | NET_EVENT_L4_DISCONNECTED)
#define CONN_LAYER_EVENT_MASK (NET_EVENT_CONN_IF_FATAL_ERROR)

#define PROGRESS_WIDTH 50
#define STARTING_OFFSET 0

/* Zephyr NET management event callback structures. */
static struct net_mgmt_event_callback l4_cb;
static struct net_mgmt_event_callback conn_cb;
static struct net_if *net_if;

static K_SEM_DEFINE(network_connected_sem, 0, 1);

#if CONFIG_SAMPLE_SECURE_SOCKET
static int sec_tag_list[] = { SEC_TAG };
#if CONFIG_SAMPLE_PROVISION_CERT
static const char cert[] = {
	#include SAMPLE_CERT_FILE_INC

	/* Null terminate certificate if running Mbed TLS on the application core.
	 * Required by TLS credentials API.
	 */
	IF_ENABLED(CONFIG_TLS_CREDENTIALS, (0x00))
};
BUILD_ASSERT(sizeof(cert) < KB(4), "Certificate too large");
#endif /* CONFIG_SAMPLE_PROVISION_CERT */
#endif /* CONFIG_SAMPLE_SECURE_SOCKET */

static char dl_buf[2048];

static int callback(const struct downloader_evt *event);

static struct downloader downloader;
static struct downloader_cfg dl_cfg = {
	.callback = callback,
	.buf = dl_buf,
	.buf_size = sizeof(dl_buf),
};
static struct downloader_host_cfg host_dl_cfg = {
#if CONFIG_SAMPLE_SECURE_SOCKET
	.sec_tag_list = sec_tag_list,
	.sec_tag_count = ARRAY_SIZE(sec_tag_list),
#endif
	.range_override = 0,
};

#if CONFIG_SAMPLE_COMPUTE_HASH
#include <psa/crypto.h>
static psa_hash_operation_t hash_ctx;
#endif

static int64_t ref_time;

#if CONFIG_SAMPLE_PROVISION_CERT
static int cert_provision(void)
{
	int err;

	printk("Provisioning certificate\n");

#if CONFIG_MODEM_KEY_MGMT
	bool exists;

	err = modem_key_mgmt_exists(SEC_TAG,
				    MODEM_KEY_MGMT_CRED_TYPE_CA_CHAIN,
				    &exists);
	if (err) {
		printk("Failed to check for certificates err %d\n", err);
		return err;
	}

	if (exists) {
		printk("Certificate ");
		/* Let's compare the existing credential */
		err = modem_key_mgmt_cmp(SEC_TAG,
					 MODEM_KEY_MGMT_CRED_TYPE_CA_CHAIN,
					 cert, sizeof(cert));

		printk("%s\n", err ? "mismatch" : "match");

		if (!err) {
			return 0;
		}
	}

	/*  Provision certificate to the modem */
	err = modem_key_mgmt_write(SEC_TAG,
				   MODEM_KEY_MGMT_CRED_TYPE_CA_CHAIN,
				   cert, sizeof(cert));
	if (err) {
		printk("Failed to provision certificate, err %d\n", err);
		return err;
	}
#else /* CONFIG_MODEM_KEY_MGMT */
	/* Replace stale credentials (e.g. protected storage). Skipping update on
	 * -EEXIST can leave wrong PEM; verify then fails with NOT_TRUSTED (flags 0x08).
	 */
	err = tls_credential_delete(SEC_TAG, TLS_CREDENTIAL_CA_CERTIFICATE);
	if (err < 0 && err != -ENOENT) {
		printk("Failed to delete existing CA certificate: %d\n", err);
		return err;
	}

	err = tls_credential_add(SEC_TAG,
				 TLS_CREDENTIAL_CA_CERTIFICATE,
				 cert,
				 sizeof(cert));
	if (err < 0) {
		printk("Failed to register CA certificate: %d\n", err);
		return err;
	}
#endif /* !CONFIG_MODEM_KEY_MGMT */

	return 0;
}
#endif

#if CONFIG_SAMPLE_TLS_DIAG
static void tls_diag_print_mbedtls_hint(void)
{
	printk("TLS diag: mbedTLS -9984 (-0x2700) is MBEDTLS_ERR_X509_CERT_VERIFY_FAILED\n");
	printk("TLS diag: flags 0x08 => NOT_TRUSTED: CA in sec tag does not anchor the chain\n");
	printk("TLS diag: (compare PEM to host: openssl s_client -connect <host>:443 -showcerts).\n");
	printk("TLS diag: Other flags: 0x04 CN/SAN; 0x200 FUTURE; 0x01 EXPIRED.\n");
}
#endif

static void on_net_event_l4_disconnected(void)
{
	printk("Disconnected from network\n");
}

static void on_net_event_l4_connected(void)
{
	k_sem_give(&network_connected_sem);
}

static void l4_event_handler(struct net_mgmt_event_callback *cb,
			     uint64_t event,
			     struct net_if *iface)
{
	switch (event) {
	case NET_EVENT_L4_CONNECTED:
		printk("IP Up\n");
		on_net_event_l4_connected();
		break;
	case NET_EVENT_L4_DISCONNECTED:
		printk("IP down\n");
		on_net_event_l4_disconnected();
		break;
	default:
		break;
	}
}

static void connectivity_event_handler(struct net_mgmt_event_callback *cb,
				       uint64_t event,
				       struct net_if *iface)
{
	int err;
	if (event == NET_EVENT_CONN_IF_FATAL_ERROR) {
		printk("Fatal error received from the connectivity layer, "
		       "rebooting network interface\n");

		(void)conn_mgr_if_disconnect(net_if);
		(void)conn_mgr_all_if_down(true);

		err = conn_mgr_all_if_up(true);
		if (err) {
			printk("conn_mgr_all_if_up, error: %d\n", err);
			return;
		}

		printk("Reconnecting to network\n");

		err = conn_mgr_all_if_connect(true);
		if (err) {
			printk("conn_mgr_all_if_connect, error: %d\n", err);
			return;
		}

		return;
	}
}

static void progress_print(size_t downloaded, size_t file_size)
{
	static int prev_percent;
	const int percent = (downloaded * 100) / file_size;

	if (percent == prev_percent) {
		return;
	}

	prev_percent = percent;

	printk("[ %3d%% ] (%d/%d bytes)\r", percent, downloaded, file_size);
}

static int callback(const struct downloader_evt *event)
{
	static size_t downloaded;
	static size_t file_size;
	uint32_t speed;
	int64_t ms_elapsed;
#if CONFIG_SAMPLE_COMPUTE_HASH
	psa_status_t status;
#endif
	if (downloaded == 0) {
		downloader_file_size_get(&downloader, &file_size);
		downloaded += STARTING_OFFSET;
	}

	switch (event->id) {
	case DOWNLOADER_EVT_FRAGMENT:
		downloaded += event->fragment.len;
		if (file_size) {
			progress_print(downloaded, file_size);
		} else {
			printk("\r[ %d bytes ]\n", downloaded);
		}

#if CONFIG_SAMPLE_COMPUTE_HASH
		status = psa_hash_update(&hash_ctx, event->fragment.buf, event->fragment.len);
		if (status != PSA_SUCCESS) {
			printk("Error during hash update: %d\n", status);
			return status;
		}
#endif
		return 0;

	case DOWNLOADER_EVT_DONE:
		ms_elapsed = k_uptime_delta(&ref_time);
		speed = ((float)file_size / ms_elapsed) * MSEC_PER_SEC;
		printk("\nDownload completed in %lld ms @ %d bytes per sec, total %d bytes\n",
		       ms_elapsed, speed, downloaded);

#if CONFIG_SAMPLE_COMPUTE_HASH
		uint8_t hash[32];
		uint8_t hash_str[64 + 1];
		size_t hash_length;

		status = psa_hash_finish(&hash_ctx, hash, sizeof(hash), &hash_length);
		if (status != PSA_SUCCESS) {
			printk("Error during hash finish: %d\n", status);
			return status;
		}

		bin2hex(hash, sizeof(hash), hash_str, sizeof(hash_str));

		printk("SHA256: %s\n", hash_str);

#if CONFIG_SAMPLE_COMPARE_HASH
		if (strcmp(hash_str, CONFIG_SAMPLE_SHA256_HASH)) {
			printk("Expect: %s\n", CONFIG_SAMPLE_SHA256_HASH);
			printk("SHA256 mismatch!\n");
		}
#endif /* CONFIG_SAMPLE_COMPARE_HASH */
#endif /* CONFIG_SAMPLE_COMPUTE_HASH */

		(void)conn_mgr_if_disconnect(net_if);
		(void)conn_mgr_all_if_down(true);
		printk("Bye\n");
		return 0;

	case DOWNLOADER_EVT_ERROR:
		if (event->error == -ECONNRESET) {
			/* With ECONNRESET, allow library to attempt a reconnect by returning 0 */
		} else {
			printk("Error %d during download\n", event->error);
#if CONFIG_SAMPLE_TLS_DIAG
			if (IS_ENABLED(CONFIG_SAMPLE_SECURE_SOCKET)) {
				if (event->error == -ECONNABORTED) {
					printk("TLS diag: -ECONNABORTED often follows TLS handshake failure\n");
				}
				tls_diag_print_mbedtls_hint();
			}
#endif
			/* Stop download */
			return -1;
		}
		break;
	case DOWNLOADER_EVT_STOPPED:
		printk("Download canceled\n");
		break;
	case DOWNLOADER_EVT_DEINITIALIZED:
		printk("Client deinitialized\n");
		break;
	}

	return 0;
}

int main(void)
{
	int err;

	printk("Download client sample started\n");

	/* Setup handler for Zephyr NET Connection Manager events. */
	net_mgmt_init_event_callback(&l4_cb, l4_event_handler, L4_EVENT_MASK);
	net_mgmt_add_event_callback(&l4_cb);

	/* Setup handler for Zephyr NET Connection Manager Connectivity layer. */
	net_mgmt_init_event_callback(&conn_cb, connectivity_event_handler, CONN_LAYER_EVENT_MASK);
	net_mgmt_add_event_callback(&conn_cb);

	err = conn_mgr_all_if_up(true);
	if (err) {
		printk("conn_mgr_all_if_up, error: %d\n", err);
		return err;
	}

#if CONFIG_SAMPLE_PROVISION_CERT
	/* Provision certificates before connecting to the network */
	err = cert_provision();
	if (err) {
		return 0;
	}
#endif
#if CONFIG_SAMPLE_COMPUTE_HASH
	psa_status_t status = psa_hash_setup(&hash_ctx, PSA_ALG_SHA_256);

	if (status != PSA_SUCCESS) {
		printk("psa_hash_setup, error: %d\n", status);
		return status;
	}
#endif
	printk("Connecting to network\n");

	err = conn_mgr_all_if_connect(true);
	if (err) {
		printk("conn_mgr_all_if_connect, error: %d\n", err);
		return err;
	}

	/* Resend connection status if the sample is built for NATIVE_SIM.
	 * This is necessary because the network interface is automatically brought up
	 * at SYS_INIT() before main() is called.
	 * This means that NET_EVENT_L4_CONNECTED fires before the
	 * appropriate handler l4_event_handler() is registered.
	 */
	if (IS_ENABLED(CONFIG_BOARD_NATIVE_SIM)) {
		conn_mgr_mon_resend_status();
	}

	k_sem_take(&network_connected_sem, K_FOREVER);

	printk("Network connected\n");

	err = downloader_init(&downloader, &dl_cfg);
	if (err) {
		printk("Failed to initialize the client, err %d", err);
		return 0;
	}


	ref_time = k_uptime_get();

	err = downloader_get(&downloader, &host_dl_cfg, URL, STARTING_OFFSET);
	if (err) {
		printk("Failed to start the downloader, err %d", err);
		return 0;
	}

	printk("Downloading %s\n", URL);

	return 0;
}
```
