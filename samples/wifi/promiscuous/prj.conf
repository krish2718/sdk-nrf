## CMakeLists.txt
```
#
# Copyright (c) 2024 Nordic Semiconductor ASA
#
# SPDX-License-Identifier: LicenseRef-Nordic-5-Clause
#

cmake_minimum_required(VERSION 3.20.0)

find_package(Zephyr REQUIRED HINTS $ENV{ZEPHYR_BASE})
project(nrf_wifi_promiscuous)

target_include_directories(app PUBLIC ${ZEPHYR_BASE}/subsys/net/ip)

include(${ZEPHYR_BASE}/samples/subsys/usb/common/common.cmake)

target_sources(app PRIVATE
	src/main.c
	src/wifi_connection.c)
```

## Kconfig
```
#
# Copyright (c) 2024 Nordic Semiconductor
#
# SPDX-License-Identifier: LicenseRef-Nordic-5-Clause
#

source "${ZEPHYR_BASE}/samples/subsys/usb/common/Kconfig.sample_usbd"

source "Kconfig.zephyr"

menu "Nordic Raw Tx Packet sample"

config PROMISCUOUS_SAMPLE_CONNECTION_TIMEOUT_S
	int "Wi-Fi connection timeout in seconds"
	default 30

config PROMISCUOUS_SAMPLE_DHCP_TIMEOUT_S
	int "DHCP timeout in seconds"
	default 20

config PROMISCUOUS_SAMPLE_RX_THREAD_STACK_SIZE
	int "Thread stack size"
	default 4096
	help
	  This option sets the stack size for the threads used in the sample.

config PROMISCUOUS_SAMPLE_STATS_PRINT_TIMEOUT
	int "Periodic statistics print timeout"
	default 5
	help
	  This option sets the timeout for periodic statistics print in seconds.

config PROMISCUOUS_SAMPLE_RECV_BUFFER_SIZE
	int "Size of the receive buffer"
	default 1024
	help
	  This option sets the size of the receive buffer in bytes.

endmenu
```

## sample.yaml
```
sample:
  description: Wi-Fi Promiscuous sample application
  name: Wi-Fi Promiscuous sample
tests:
  sample.nrf7002.promiscuous:
    sysbuild: true
    build_only: true
    integration_platforms:
      - nrf7002dk/nrf5340/cpuapp
    platform_allow: nrf7002dk/nrf5340/cpuapp
    tags:
      - ci_build
      - sysbuild
      - ci_samples_wifi
  sample.nrf7002_eks.promiscuous:
    sysbuild: true
    build_only: true
    extra_args: SHIELD=nrf7002ek
    integration_platforms:
      - nrf5340dk/nrf5340/cpuapp
    platform_allow: nrf5340dk/nrf5340/cpuapp
    tags:
      - ci_build
      - sysbuild
      - ci_samples_wifi
  sample.nrf7001.promiscuous:
    sysbuild: true
    build_only: true
    integration_platforms:
      - nrf7002dk/nrf5340/cpuapp/nrf7001
    platform_allow: nrf7002dk/nrf5340/cpuapp/nrf7001
    tags:
      - ci_build
      - sysbuild
      - ci_samples_wifi
    skip: true
  sample.nrf7002eb_interposer_p1.nrf7002eb.promiscuous:
    sysbuild: true
    build_only: true
    extra_args:
      - promiscuous_SHIELD="nrf7002eb_interposer_p1;nrf7002eb"
      - promiscuous_SNIPPET=nrf70-wifi
    integration_platforms:
      - nrf54h20dk/nrf54h20/cpuapp
    platform_allow:
      - nrf54h20dk/nrf54h20/cpuapp
    tags:
      - ci_build
      - sysbuild
      - ci_samples_wifi
  sample.promisc.nrf54h20.netusb:
    sysbuild: true
    build_only: true
    extra_args:
      - promiscuous_SHIELD="nrf7002eb_interposer_p1;nrf7002eb"
      - promiscuous_SNIPPET=nrf70-wifi
      - EXTRA_CONF_FILE="overlay-net-capture.conf;overlay-usb-next.conf"
      - EXTRA_DTC_OVERLAY_FILE="usbd_next_ecm.overlay"
    integration_platforms:
      - nrf54h20dk/nrf54h20/cpuapp
    platform_allow:
      - nrf54h20dk/nrf54h20/cpuapp
    tags:
      - ci_build
      - sysbuild
      - ci_samples_wifi
```

## prj.conf
```kconfig
#
# Copyright (c) 2024 Nordic Semiconductor ASA
#
# SPDX-License-Identifier: LicenseRef-Nordic-5-Clause
#
CONFIG_WIFI=y
CONFIG_WIFI_NRF70=y

# WPA supplicant
CONFIG_WIFI_NM_WPA_SUPPLICANT=y

# Promiscuous mode
CONFIG_NET_PROMISCUOUS_MODE=y
CONFIG_NRF70_PROMISC_DATA_RX=y

CONFIG_WIFI_MGMT_EXT=y
CONFIG_WIFI_CREDENTIALS=y
CONFIG_WIFI_CREDENTIALS_STATIC=y
CONFIG_WIFI_CREDENTIALS_STATIC_SSID="Myssid"
CONFIG_WIFI_CREDENTIALS_STATIC_PASSWORD="Mypassword"

CONFIG_NET_CONFIG_SETTINGS=y
CONFIG_NET_CONFIG_AUTO_INIT=y
CONFIG_NET_CONFIG_INIT_TIMEOUT=0

CONFIG_NET_CONFIG_MY_IPV4_ADDR="192.168.1.99"
CONFIG_NET_CONFIG_MY_IPV4_NETMASK="255.255.255.0"
CONFIG_NET_CONFIG_MY_IPV4_GW="192.168.1.1"

# Networking
CONFIG_NETWORKING=y
CONFIG_NET_SOCKETS=y
CONFIG_NET_LOG=y
CONFIG_NET_IPV4=y
CONFIG_NET_UDP=y
CONFIG_NET_TCP=y
CONFIG_NET_DHCPV4=n

CONFIG_NET_PKT_RX_COUNT=60
CONFIG_NET_PKT_TX_COUNT=3

# Below section is the primary contributor to SRAM and is currently
# tuned for performance, but this will be revisited in the future.
CONFIG_NET_BUF_RX_COUNT=60
CONFIG_NET_BUF_TX_COUNT=6
CONFIG_HEAP_MEM_POOL_SIZE=230000
CONFIG_NET_TC_TX_COUNT=1

CONFIG_NET_IF_UNICAST_IPV4_ADDR_COUNT=1
CONFIG_NET_MAX_CONTEXTS=5
CONFIG_NET_CONTEXT_SYNC_RECV=y

CONFIG_INIT_STACKS=y

CONFIG_NET_L2_ETHERNET=y

CONFIG_NET_SOCKETS_POLL_MAX=10

# Memories
CONFIG_MAIN_STACK_SIZE=5200
CONFIG_NET_TX_STACK_SIZE=4096
CONFIG_NET_RX_STACK_SIZE=4096

# Debugging
CONFIG_STACK_SENTINEL=y
CONFIG_DEBUG_COREDUMP=y
CONFIG_DEBUG_COREDUMP_BACKEND_LOGGING=y
CONFIG_DEBUG_COREDUMP_MEMORY_DUMP_MIN=y
CONFIG_SHELL_CMDS_RESIZE=n

# Kernel options
CONFIG_ENTROPY_GENERATOR=y

# Logging
CONFIG_LOG=y
CONFIG_LOG_BUFFER_SIZE=2048
CONFIG_POSIX_CLOCK=y

# printing of scan results puts pressure on queues in new locking
# design in net_mgmt. So, use a higher timeout for a crowded
# environment.
CONFIG_NET_MGMT_EVENT_QUEUE_TIMEOUT=5000

CONFIG_POSIX_API=y
CONFIG_NET_CONTEXT_RCVTIMEO=y


CONFIG_SHELL=y
CONFIG_SHELL_STACK_SIZE=4600
CONFIG_NET_SHELL=y
CONFIG_SHELL_GETOPT=y
CONFIG_SHELL_CMDS_RESIZE=n
CONFIG_NRF70_UTIL=y
CONFIG_NET_L2_WIFI_SHELL=y
CONFIG_NET_STATISTICS=y
CONFIG_NET_STATISTICS_WIFI=y
CONFIG_NET_STATISTICS_USER_API=y
CONFIG_SYS_HEAP_RUNTIME_STATS=y
CONFIG_LOG=y
CONFIG_LOG_MODE_IMMEDIATE=y
CONFIG_PRINTK=y
```

## overlay-usb-next.conf
```kconfig
CONFIG_USB_DEVICE_STACK_NEXT=y
CONFIG_USBD_CDC_ECM_CLASS=y

CONFIG_LOG=y
CONFIG_USBD_LOG_LEVEL_WRN=y
CONFIG_UDC_DRIVER_LOG_LEVEL_WRN=y
CONFIG_USBD_CDC_ECM_LOG_LEVEL_ERR=y
CONFIG_USBD_THREAD_STACK_SIZE=4096

CONFIG_SAMPLE_USBD_PID=0x0001
CONFIG_SAMPLE_USBD_PRODUCT="USBD CDC ECM sample"
```

## src/main.c
```c
/*
 * Copyright (c) 2024 Nordic Semiconductor ASA
 *
 * SPDX-License-Identifier: LicenseRef-Nordic-5-Clause
 */

/** @file
 * @brief Wi-Fi Promiscuous sample
 */

#include <zephyr/logging/log.h>
LOG_MODULE_REGISTER(promiscuous, CONFIG_LOG_DEFAULT_LEVEL);

#ifdef CONFIG_NET_CONFIG_SETTINGS
#include <zephyr/net/net_config.h>
#endif

#include <zephyr/net/ethernet.h>
#include <zephyr/posix/unistd.h>
#include <zephyr/posix/sys/socket.h>
#include "wifi_connection.h"

#define THREAD_PRIORITY K_PRIO_COOP(CONFIG_NUM_COOP_PRIORITIES - 1)
#define RAW_PKT_HDR 6

/* Enumeration for Wi-Fi frame types and subtypes */
enum frame_type {
	MANAGEMENT_FRAME = 0x00,
	CONTROL_FRAME = 0x01,
	DATA_FRAME = 0x02,
	RESERVED_FRAME = 0x03,
	UNKNOWN_FRAME = 0xFF
};

enum control_subtype {
	CF_END_SUBTYPE = 0x0E,
	ACK_SUBTYPE = 0x0D,
	RTS_SUBTYPE = 0x0B,
	CTS_SUBTYPE = 0x0C,
	BLOCK_ACK_SUBTYPE = 0x09,
	BLOCK_ACK_REQ_SUBTYPE = 0x08
};

enum data_subtype {
	DATA_SUBTYPE = 0x00,
	QOS_DATA_SUBTYPE = 0x08,
	NULL_SUBTYPE = 0x04,
	QOS_NULL_SUBTYPE = 0x0C
};

enum management_subtype {
	PROBE_REQ_SUBTYPE = 0x04,
	BEACON_SUBTYPE = 0x08,
	PROBE_RESPONSE_SUBTYPE = 0x05,
	ACTION_SUBTYPE = 0x0D
	/* Add more subtypes as needed */
};

struct packet_data {
	int send_sock;
	int recv_sock;
	char recv_buffer[CONFIG_PROMISCUOUS_SAMPLE_RECV_BUFFER_SIZE];
};

/* Structure for the Frame Control */
typedef struct {
	uint16_t protocolVersion : 2;
	uint16_t type            : 2;
	uint16_t subtype         : 4;
	uint16_t toDS            : 1;
	uint16_t fromDS          : 1;
	uint16_t moreFragments   : 1;
	uint16_t retry           : 1;
	uint16_t powerManagement : 1;
	uint16_t moreData        : 1;
	uint16_t protectedFrame  : 1;
	uint16_t order           : 1;
} frame_control;

/* Structure for wifi packet stats */
typedef struct {
	int ack_count;
	int rts_count;
	int cts_count;
	int block_ack_count;
	int block_ack_req_count;
	int probe_req_count;
	int beacon_count;
	int probe_response_count;
	int data_count;
	int qos_data_count;
	int null_count;
	int qos_null_count;
	int action_count;
	int cf_end_count;
	int unknown_mgmt_count;
	int unknown_ctrl_count;
	int unknown_data_count;
	int reserved_frame_count;
	int unknown_frame_count;
	/* Add more counters for other types as needed */
} packet_stats;

packet_stats stats = {0};

/* Structure for the MAC header */
static void create_rx_thread(void);

K_THREAD_DEFINE(receiver_thread_id, CONFIG_PROMISCUOUS_SAMPLE_RX_THREAD_STACK_SIZE,
		create_rx_thread, NULL, NULL, NULL,
		THREAD_PRIORITY, 0, -1);

#ifdef CONFIG_NET_CAPTURE
static const struct device *capture_dev;
#endif

#ifdef CONFIG_USB_DEVICE_STACK
#include <zephyr/usb/usb_device.h>

static struct in_addr addr = { { { 192, 0, 2, 1 } } };
static struct in_addr mask = { { { 255, 255, 255, 0 } } };

int init_usb(void)
{
	int ret;

	ret = usb_enable(NULL);
	if (ret != 0) {
		printk("Cannot enable USB (%d)", ret);
		return ret;
	}

	return 0;
}
#endif

/* Function to parse and update statistics for Wi-Fi packets */
static void parse_and_update_stats(unsigned char *packet, packet_stats *stats)
{
	uint16_t *FrameControlField = (uint16_t *)packet;
	frame_control *fc = (frame_control *)FrameControlField;

	/* Extract the frame type and subtype from the frame control field */
	unsigned char frame_type = fc->type;
	unsigned char frame_subtype = fc->subtype;

	/* Update statistics based on the frame type and subtype */
	switch (frame_type) {
	case CONTROL_FRAME:
		switch (frame_subtype) {
		case ACK_SUBTYPE:
			stats->ack_count++;
			break;
		case RTS_SUBTYPE:
			stats->rts_count++;
			break;
		case CTS_SUBTYPE:
			stats->cts_count++;
			break;
		case BLOCK_ACK_SUBTYPE:
			stats->block_ack_count++;
			break;
		case BLOCK_ACK_REQ_SUBTYPE:
			stats->block_ack_req_count++;
			break;
		case CF_END_SUBTYPE:
			stats->cf_end_count++;
			/* Add more cases for other Data frame subtypes as needed */
		default:
			stats->unknown_ctrl_count++;
			LOG_DBG("Unknown Control frame subtype: %d", frame_subtype);
		}
		break;
	case DATA_FRAME:
		switch (frame_subtype) {
		case DATA_SUBTYPE:
			stats->data_count++;
			break;
		case QOS_DATA_SUBTYPE:
			stats->qos_data_count++;
			break;
		case NULL_SUBTYPE:
			stats->null_count++;
			break;
		case QOS_NULL_SUBTYPE:
			stats->qos_null_count++;
			break;
		/* Add more cases for other Data frame subtypes as needed */
		default:
			stats->unknown_data_count++;
			LOG_DBG("Unknown Data frame subtype: %d", frame_subtype);
		}
		break;
	case MANAGEMENT_FRAME:
		switch (frame_subtype) {
		case PROBE_REQ_SUBTYPE:
			stats->probe_req_count++;
			break;
		case BEACON_SUBTYPE:
			stats->beacon_count++;
			break;
		case PROBE_RESPONSE_SUBTYPE:
			stats->probe_response_count++;
			break;
		case ACTION_SUBTYPE:
			stats->action_count++;
			break;
		/* Add more cases for other Management frame subtypes as needed */
		default:
			stats->unknown_mgmt_count++;
			LOG_DBG("Unknown Management frame subtype: %d", frame_subtype);
		}
		break;
	case RESERVED_FRAME:
		/* Handle reserved frame types as needed */
		stats->reserved_frame_count++;
		LOG_DBG("Reserved frame type: %d", frame_type);
		break;
	default:
		/* Handle unknown frame types as needed */
		stats->unknown_frame_count++;
		LOG_DBG("Unknown frame type: %d", frame_type);
		break;
	}
}

static void print_stats(void)
{
	/* Print the updated statistics */
	LOG_INF("Management Frames:");
	LOG_INF("\tBeacon Count: %d", stats.beacon_count);
	LOG_INF("\tProbe Request Count: %d", stats.probe_req_count);
	LOG_INF("\tProbe Response Count: %d", stats.probe_response_count);
	LOG_INF("\tAction Count: %d", stats.action_count);
	LOG_INF("Control Frames:");
	LOG_INF("\t ACK Count %d", stats.ack_count);
	LOG_INF("\t RTS Count %d", stats.rts_count);
	LOG_INF("\t CTS Count %d", stats.cts_count);
	LOG_INF("\t Block Ack Count %d", stats.block_ack_count);
	LOG_INF("\t Block Ack Req Count %d", stats.block_ack_req_count);
	LOG_INF("\t CF End Count %d", stats.cf_end_count);
	LOG_INF("Data Frames:");
	LOG_INF("\tData Count: %d", stats.data_count);
	LOG_INF("\tQoS Data Count: %d", stats.qos_data_count);
	LOG_INF("\tNull Count: %d", stats.null_count);
	LOG_INF("\tQoS Null Count: %d", stats.qos_null_count);
	LOG_INF("Unknown Frames:");
	LOG_INF("\tUnknown Management Frame Count: %d", stats.unknown_mgmt_count);
	LOG_INF("\tUnknown Control Frame Count: %d", stats.unknown_ctrl_count);
	LOG_INF("\tUnknown Data Frame Count: %d", stats.unknown_data_count);
	LOG_INF("\tReserved Frame Count: %d", stats.reserved_frame_count);
	LOG_INF("\tUnknown Frame Count: %d", stats.unknown_frame_count);
	LOG_INF("\n");
}

static int process_rx_packet(struct packet_data *packet)
{
	uint32_t start_time;
	int ret = 0;
	int received;
	int stats_print_period =
		CONFIG_PROMISCUOUS_SAMPLE_STATS_PRINT_TIMEOUT * 1000; /* Converting to ms */

	LOG_INF("Wi-Fi promiscuous mode RX thread started");
	start_time = k_uptime_get_32();

	do {
		received = recv(packet->recv_sock, packet->recv_buffer,
				sizeof(packet->recv_buffer), 0);
		if (received <= 0) {
			if (errno == EAGAIN) {
				continue;
			}

			if (received < 0) {
				LOG_ERR("recv error %s", strerror(errno));
				ret = -errno;
			}
			break;
		}

		parse_and_update_stats(&packet->recv_buffer[RAW_PKT_HDR], &stats);

		if ((k_uptime_get_32() - start_time) >= stats_print_period)	{
			print_stats();
			start_time = k_uptime_get_32();
		}
	} while (true);

	return ret;
}

static int setup_raw_socket(int *sock)
{
	struct sockaddr_ll dst = { 0 };
	int ret;

	*sock = socket(AF_PACKET, SOCK_RAW, htons(ETH_P_ALL));
	if (*sock < 0) {
		LOG_ERR("Failed to create RAW socket : %d",
				errno);
		return -errno;
	}

	dst.sll_ifindex = net_if_get_by_iface(net_if_get_first_wifi());
	dst.sll_family = AF_PACKET;

	ret = bind(*sock, (const struct sockaddr *)&dst,
			sizeof(struct sockaddr_ll));
	if (ret < 0) {
		LOG_ERR("Failed to bind packet socket : %s", strerror(errno));
		return -errno;
	}

	return 0;
}

/* handle incoming wifi packets in promiscuous mode */
static void create_rx_thread(void)
{
	int ret;
	struct timeval timeo_optval = {
		.tv_sec = 1,
		.tv_usec = 0,
	};
	struct packet_data sock_packet;

	ret = setup_raw_socket(&sock_packet.recv_sock);
	if (ret < 0) {
		return;
	}

	ret = setsockopt(sock_packet.recv_sock, SOL_SOCKET, SO_RCVTIMEO,
			&timeo_optval, sizeof(timeo_optval));
	if (ret < 0) {
		LOG_ERR("Failed to set socket options : %s", strerror(errno));
		return;
	}

	while (!ret) {
		ret = process_rx_packet(&sock_packet);
		if (ret < 0) {
			return;
		}
	}

	close(sock_packet.recv_sock);

#ifdef CONFIG_NET_CAPTURE
	ret = net_capture_disable(capture_dev);
	if (ret < 0) {
		LOG_ERR("Failed to disable network capture : %d", ret);
	}
#endif
}

static int wifi_set_mode(int mode_val)
{
	struct net_if *iface = NULL;

	iface = net_if_get_first_wifi();
	if (iface == NULL) {
		LOG_ERR("No Wi-Fi interface found");
		return -1;
	}

	if (net_eth_promisc_mode(iface, true)) {
		LOG_ERR("Promiscuous mode enable failed");
		return -1;
	}

	LOG_INF("Promiscuous mode enabled");
	return 0;
}

#ifdef CONFIG_NET_CAPTURE
static int wifi_setup_net_capture(void)
{
	struct net_if *iface;
	const char *remote, *local, *peer;
	int ret;

	/* For now hardcode these addresses, as they never change */
	remote = "192.0.2.2";
	local = "2001:db8:200::1";
	peer = "2001:db8:200::2";

	ret = net_capture_setup(remote, local, peer, &capture_dev);
	if (ret < 0) {
		LOG_ERR("Failed to setup network capture : %d", ret);
		return ret;
	}

	/* Wi-Fi is the capture interface */
	iface = net_if_get_first_wifi();
	if (iface == NULL) {
		LOG_ERR("No Wi-Fi interface found");
		return -1;
	}

	ret = net_capture_enable(capture_dev, iface);
	if (ret < 0) {
		LOG_ERR("Failed to enable network capture : %d", ret);
		return ret;
	}

	return 0;
}
#endif

static void wait_for_debugger(void)
{
	volatile int wait = 1;

	LOG_INF("Waiting for debugger to attach...");
	while (wait) {
		/* Spin forever */
	}
}


#if defined(CONFIG_USB_DEVICE_STACK_NEXT)
#include <sample_usbd.h>

static int enable_usb_device_next(void)
{
	struct usbd_context *sample_usbd = sample_usbd_init_device(NULL);

	if (sample_usbd == NULL) {
		printk("Failed to initialize USB device");
		return -ENODEV;
	}

	return usbd_enable(sample_usbd);
}
#endif /* CONFIG_USB_DEVICE_STACK_NEXT */

int main(void)
{
	int ret;

//	wait_for_debugger();
#ifdef CONFIG_USB_DEVICE_STACK
	init_usb();

	/* Redirect static IP address to netusb*/
	const struct device *usb_dev = device_get_binding("eth_netusb");
	struct net_if *iface = net_if_lookup_by_dev(usb_dev);

	if (!iface) {
		printk("Cannot find network interface: %s", "eth_netusb");
		return -1;
	}

	net_if_ipv4_addr_add(iface, &addr, NET_ADDR_MANUAL, 0);
	net_if_ipv4_set_netmask_by_addr(iface, &addr, &mask);
#endif

#if defined(CONFIG_USB_DEVICE_STACK_NEXT)
	ret = enable_usb_device_next();
#else
	ret = usb_enable(NULL);
#endif
	if (ret != 0) {
		printk("Failed to enable USB");
		return 0;
	}
#ifdef CONFIG_NET_CONFIG_SETTINGS
	// AUTO INIT doesn't with USB
	net_config_init_app(NULL, "Initializing network");
#endif
#if 0
	if (wifi_set_mode(true)) {
		return -1;
	}

	/* TODO: Implement waiting for WPA supplicant to manage the Wi-Fi interface.*/
	ret = try_wifi_connect();
	if (ret < 0) {
		return ret;
	}

#ifdef CONFIG_NET_CAPTURE
	ret = wifi_setup_net_capture();
	if (ret) {
		return -1;
	}
	LOG_INF("Network capture of Wi-Fi traffic enabled");
#endif

	k_thread_start(receiver_thread_id);
#endif
	return 0;
}
```

## src/wifi_connection.c
```c
/*
 * Copyright (c) 2024 Nordic Semiconductor ASA
 *
 * SPDX-License-Identifier: LicenseRef-Nordic-5-Clause
 */

/** @file
 * @brief Wi-Fi connection helper file
 */

#include <zephyr/logging/log.h>
LOG_MODULE_REGISTER(wifi_connect, CONFIG_LOG_DEFAULT_LEVEL);

#include <stdlib.h>
#include <zephyr/net/wifi_mgmt.h>
#include <zephyr/net/wifi.h>
#include "net_private.h"

#include <net/wifi_mgmt_ext.h>

#define WIFI_SHELL_MGMT_EVENTS (NET_EVENT_WIFI_CONNECT_RESULT |		\
				NET_EVENT_WIFI_DISCONNECT_RESULT)

K_SEM_DEFINE(wait_for_wifi_connection, 0, 1);
#ifdef CONFIG_NET_DHCPV4
K_SEM_DEFINE(wait_for_dhcp, 0, 1);
static struct net_mgmt_event_callback net_shell_mgmt_cb;
#endif /* CONFIG_NET_DHCPV4 */
static struct net_mgmt_event_callback wifi_shell_mgmt_cb;

static struct {
	const struct shell *sh;
	union {
		struct {
			uint8_t connected	: 1;
			uint8_t connect_result	: 1;
			uint8_t disconnect_requested	: 1;
			uint8_t _unused		: 5;
		};
		uint8_t all;
	};
} context;

static int cmd_wifi_status(void)
{
	struct net_if *iface = NULL;
	struct wifi_iface_status status = { 0 };
	int ret;

	iface = net_if_get_first_wifi();
	if (!iface) {
		LOG_ERR("Failed to get Wi-Fi iface");
		return -1;
	}

	ret = net_mgmt(NET_REQUEST_WIFI_IFACE_STATUS, iface, &status,
				sizeof(struct wifi_iface_status));
	if (ret) {
		LOG_INF("Status request failed: %d\n", ret);
		return ret;
	}

	LOG_INF("==================");
	LOG_INF("State: %s", wifi_state_txt(status.state));

	if (status.state >= WIFI_STATE_ASSOCIATED) {
		uint8_t mac_string_buf[sizeof("xx:xx:xx:xx:xx:xx")];

		LOG_INF("Interface Mode: %s",
		       wifi_mode_txt(status.iface_mode));
		LOG_INF("Link Mode: %s",
		       wifi_link_mode_txt(status.link_mode));
		LOG_INF("SSID: %.32s", status.ssid);
		LOG_INF("BSSID: %s",
		       net_sprint_ll_addr_buf(
				status.bssid, WIFI_MAC_ADDR_LEN,
				mac_string_buf, sizeof(mac_string_buf)));
		LOG_INF("Band: %s", wifi_band_txt(status.band));
		LOG_INF("Channel: %d", status.channel);
		LOG_INF("Security: %s", wifi_security_txt(status.security));
		LOG_INF("MFP: %s", wifi_mfp_txt(status.mfp));
		LOG_INF("RSSI: %d", status.rssi);
		LOG_INF("TWT: %s", status.twt_capable ? "Supported" : "Not supported");
	}
	return 0;
}

static void handle_wifi_connect_result(struct net_mgmt_event_callback *cb)
{
	const struct wifi_status *status =
		(const struct wifi_status *) cb->info;

	if (context.connected) {
		return;
	}

	if (status->status) {
		LOG_ERR("Connection failed (%d)", status->status);
	} else {
		LOG_INF("Connected");
		context.connected = true;
	}

	context.connect_result = status->conn_status;
	k_sem_give(&wait_for_wifi_connection);
}

static void handle_wifi_disconnect_result(struct net_mgmt_event_callback *cb)
{
	const struct wifi_status *status =
		(const struct wifi_status *) cb->info;

	if (!context.connected) {
		return;
	}

	if (context.disconnect_requested) {
		LOG_INF("Disconnection request %s (%d)",
			 status->status ? "failed" : "done",
					status->status);
		context.disconnect_requested = false;
	} else {
		LOG_INF("Received Disconnected");
		context.connected = false;
	}

	cmd_wifi_status();
}

static void wifi_mgmt_event_handler(struct net_mgmt_event_callback *cb,
				     uint32_t mgmt_event, struct net_if *iface)
{
	switch (mgmt_event) {
	case NET_EVENT_WIFI_CONNECT_RESULT:
		handle_wifi_connect_result(cb);
		break;
	case NET_EVENT_WIFI_DISCONNECT_RESULT:
		handle_wifi_disconnect_result(cb);
		break;
	default:
		break;
	}
}

#ifdef CONFIG_NET_DHCPV4
static void print_dhcp_ip(struct net_mgmt_event_callback *cb)
{
	/* Get DHCP info from struct net_if_dhcpv4 and print */
	const struct net_if_dhcpv4 *dhcpv4 = cb->info;
	const struct in_addr *addr = &dhcpv4->requested_ip;
	char dhcp_info[128];

	net_addr_ntop(AF_INET, addr, dhcp_info, sizeof(dhcp_info));

	LOG_INF("DHCP IP address: %s", dhcp_info);
	k_sem_give(&wait_for_dhcp);
}

static void net_mgmt_event_handler(struct net_mgmt_event_callback *cb,
				    uint32_t mgmt_event, struct net_if *iface)
{
	switch (mgmt_event) {
	case NET_EVENT_IPV4_DHCP_BOUND:
		print_dhcp_ip(cb);
		break;
	default:
		break;
	}
}
#endif /* CONFIG_NET_DHCPV4 */

static int wifi_connect(void)
{
	struct net_if *iface = net_if_get_first_wifi();

	if (!iface) {
		LOG_ERR("Failed to get Wi-Fi iface");
		return -1;
	}

	context.connected = false;
	context.connect_result = WIFI_STATUS_CONN_FAIL;

	if (net_mgmt(NET_REQUEST_WIFI_CONNECT_STORED, iface, NULL, 0)) {
		LOG_ERR("Connection request failed");
		return -ENOEXEC;
	}

	LOG_INF("Connection requested");

	return 0;
}

int try_wifi_connect(void)
{
	memset(&context, 0, sizeof(context));

	net_mgmt_init_event_callback(&wifi_shell_mgmt_cb,
				     wifi_mgmt_event_handler,
				     WIFI_SHELL_MGMT_EVENTS);

	net_mgmt_add_event_callback(&wifi_shell_mgmt_cb);

#ifdef CONFIG_NET_DHCPV4
	net_mgmt_init_event_callback(&net_shell_mgmt_cb,
				     net_mgmt_event_handler,
				     NET_EVENT_IPV4_DHCP_BOUND);

	net_mgmt_add_event_callback(&net_shell_mgmt_cb);
#endif /* CONFIG_NET_DHCPV4 */
	k_sleep(K_SECONDS(1));

	LOG_INF("Static IP address (overridable): %s/%s -> %s",
		CONFIG_NET_CONFIG_MY_IPV4_ADDR,
		CONFIG_NET_CONFIG_MY_IPV4_NETMASK,
		CONFIG_NET_CONFIG_MY_IPV4_GW);

	wifi_connect();

	if (k_sem_take(&wait_for_wifi_connection,
		       K_SECONDS(CONFIG_PROMISCUOUS_SAMPLE_CONNECTION_TIMEOUT_S))) {
		LOG_ERR("Wi-Fi connection timed out");
		return -1;
	}

	if (context.connected) {
#ifdef CONFIG_NET_DHCPV4
		k_sem_take(&wait_for_dhcp,
			   K_SECONDS(CONFIG_PROMISCUOUS_SAMPLE_DHCP_TIMEOUT_S));
#endif /* CONFIG_NET_DHCPV4 */
		cmd_wifi_status();
	} else if (context.connect_result) {
		LOG_ERR("Connection unsuccessful with reason (%d)", context.connect_result);
		return -1;
	}

	return 0;
}
```
