## prj.conf
```kconfig
#
# Copyright (c) 2023 Nordic Semiconductor ASA
#
# SPDX-License-Identifier: LicenseRef-Nordic-5-Clause
#
CONFIG_WIFI=y
CONFIG_WIFI_NRF70=y

# WPA supplicant
CONFIG_WIFI_NM_WPA_SUPPLICANT=y

CONFIG_WIFI_MGMT_EXT=y
CONFIG_WIFI_CREDENTIALS=y
CONFIG_WIFI_CREDENTIALS_STATIC=y
# CONFIG_WIFI_CREDENTIALS_STATIC_SSID="EntryReady BOG"
CONFIG_WIFI_CREDENTIALS_STATIC_SSID="CORP_IOT_1"
# CONFIG_WIFI_CREDENTIALS_STATIC_SSID="EntryReady Lock Test"
CONFIG_WIFI_CREDENTIALS_STATIC_PASSWORD="EntryReady"
# CONFIG_WIFI_CREDENTIALS_STATIC_PASSWORD="L0ckT3st!"

# Networking
CONFIG_NETWORKING=y
CONFIG_NET_SOCKETS=y
CONFIG_NET_LOG=y
CONFIG_NET_IPV4=y
CONFIG_NET_UDP=y
CONFIG_NET_TCP=y
CONFIG_NET_DHCPV4=y

# Below section is the primary contributor to SRAM and is currently
# tuned for performance, but this will be revisited in the future.
CONFIG_NET_PKT_TX_COUNT=8
CONFIG_NET_PKT_RX_COUNT=16
CONFIG_NET_BUF_TX_COUNT=16
CONFIG_NET_BUF_RX_COUNT=16
CONFIG_HEAP_MEM_POOL_SIZE=210000
#CONFIG_SPEED_OPTIMIZATIONS=y
#CONFIG_NRF70_MAX_TX_AGGREGATION=9
#CONFIG_NRF70_MAX_TX_TOKENS=12
CONFIG_NET_TC_TX_COUNT=1

# Below configs will increase tcp connection timeout
CONFIG_NET_TCP_ACK_TIMEOUT=60000
CONFIG_NET_TCP_INIT_RETRANSMISSION_TIMEOUT=1000
CONFIG_NET_SOCKETS_CONNECT_TIMEOUT=10000
CONFIG_NET_TCP_RETRY_COUNT=10

CONFIG_NET_IF_UNICAST_IPV4_ADDR_COUNT=1
CONFIG_NET_MAX_CONTEXTS=5
CONFIG_NET_CONTEXT_SYNC_RECV=y

CONFIG_INIT_STACKS=y

CONFIG_NET_L2_ETHERNET=y

CONFIG_NET_CONFIG_SETTINGS=y
CONFIG_NET_CONFIG_INIT_TIMEOUT=0

CONFIG_NET_SOCKETS_POLL_MAX=10

# Memories
CONFIG_MAIN_STACK_SIZE=5200
CONFIG_NET_TX_STACK_SIZE=4096
CONFIG_NET_RX_STACK_SIZE=4096

# Debugging
CONFIG_STACK_SENTINEL=y
CONFIG_DEBUG_COREDUMP=y
CONFIG_DEBUG_COREDUMP_BACKEND_LOGGING=y
CONFIG_DEBUG_COREDUMP_MEMORY_DUMP_MIN=y
CONFIG_SHELL_CMDS_RESIZE=n


# Kernel options
CONFIG_ENTROPY_GENERATOR=y

# Logging
CONFIG_LOG=y
CONFIG_LOG_BUFFER_SIZE=2048
CONFIG_POSIX_CLOCK=y
CONFIG_POSIX_API=y

CONFIG_PM=y

CONFIG_NET_CONFIG_MY_IPV4_ADDR="192.168.1.99"
CONFIG_NET_CONFIG_MY_IPV4_NETMASK="255.255.255.0"
CONFIG_NET_CONFIG_MY_IPV4_GW="192.168.1.1"

# printing of scan results puts pressure on queues in new locking
# design in net_mgmt. So, use a higher timeout for a crowded
# environment.
CONFIG_NET_MGMT_EVENT_QUEUE_TIMEOUT=5000

CONFIG_TRAFFIC_GEN=n
# IPv4 address of the host running the traffic generator server
CONFIG_TRAFFIC_GEN_REMOTE_IPV4_ADDR="10.240.1.73"
# Needed because traffic gen uses more sockets, so, keeping an upper limit
CONFIG_ZVFS_OPEN_MAX=16

# Enable RTT backend console logging
CONFIG_USE_SEGGER_RTT=y
CONFIG_LOG_BACKEND_RTT=y
CONFIG_LOG_BACKEND_RTT_MODE_BLOCK=y

CONFIG_NRF_WIFI_TWT_SETUP_TIMEOUT=3000

CONFIG_NRF_WIFI_LOW_POWER=y

CONFIG_CONTINUOUS_TX=y
```

## src/main.c
```c
/*
 * Copyright (c) 2023 Nordic Semiconductor ASA
 *
 * SPDX-License-Identifier: LicenseRef-Nordic-5-Clause
 */

/** @file
 * @brief WiFi TWT sample
 */

#include <zephyr/logging/log.h>
LOG_MODULE_REGISTER(twt, CONFIG_LOG_DEFAULT_LEVEL);

#if defined(CONFIG_POSIX_API)
#include <zephyr/posix/arpa/inet.h>
#include <zephyr/posix/netdb.h>
#include <zephyr/posix/unistd.h>
#include <zephyr/posix/sys/socket.h>
#endif

#include <zephyr/kernel.h>
#include <stdio.h>
#include <stdlib.h>
#include <zephyr/shell/shell.h>
#include <zephyr/sys/printk.h>
#include <zephyr/init.h>

#include <zephyr/net/net_if.h>
#include <zephyr/net/wifi_mgmt.h>
#include <zephyr/net/net_event.h>
#include <zephyr/drivers/gpio.h>

#include<net/wifi_mgmt_ext.h>

#include "net_private.h"
#include "traffic_gen.h"

#define WIFI_SHELL_MODULE "wifi"

#define WIFI_SHELL_MGMT_EVENTS (NET_EVENT_WIFI_CONNECT_RESULT |		\
				NET_EVENT_WIFI_DISCONNECT_RESULT|	\
				NET_EVENT_WIFI_TWT)

#define MAX_SSID_LEN        32
#define STATUS_POLLING_MS   300
#define TWT_RESP_TIMEOUT_S    20

struct traffic_gen_config tg_config;

static struct net_mgmt_event_callback wifi_shell_mgmt_cb;
static struct net_mgmt_event_callback net_shell_mgmt_cb;

static struct {
	const struct shell *sh;
	union {
		struct {
			uint8_t connected	: 1;
			uint8_t connect_result	: 1;
			uint8_t disconnect_requested	: 1;
			uint8_t _unused		: 5;
		};
		uint8_t all;
	};
} context;

static bool twt_supported, twt_resp_received, twt_resp_accept;
static uint32_t twt_flow_id = 1;
static uint32_t dialog_token = 1;

static bool wait_for_twt_resp_received(void)
{
	int i, timeout_polls = (TWT_RESP_TIMEOUT_S * 1000) / STATUS_POLLING_MS;

	for (i = 0; i < timeout_polls; i++) {
		k_sleep(K_MSEC(STATUS_POLLING_MS));
		if (twt_resp_received) {
			return twt_resp_accept;
		}
	}

	return false;
}

static int setup_twt(void)
{
	struct net_if *iface = net_if_get_first_wifi();
	struct wifi_twt_params params = { 0 };
	int ret;

	params.operation = WIFI_TWT_SETUP;
	params.negotiation_type = WIFI_TWT_INDIVIDUAL;
	params.setup_cmd = WIFI_TWT_SETUP_CMD_REQUEST;
	params.dialog_token = dialog_token;
	params.flow_id = twt_flow_id;
	params.setup.responder = 0;
	params.setup.trigger = IS_ENABLED(CONFIG_TWT_TRIGGER_ENABLE);
	params.setup.implicit = 1;
	params.setup.announce = IS_ENABLED(CONFIG_TWT_ANNOUNCED_MODE);
	params.setup.twt_wake_interval = CONFIG_TWT_WAKE_INTERVAL;
	params.setup.twt_interval = 4 * CONFIG_TWT_INTERVAL;

	ret = net_mgmt(NET_REQUEST_WIFI_TWT, iface, &params, sizeof(params));
	if (ret) {
		LOG_INF("TWT setup failed: %d", ret);
		return ret;
	}

	LOG_INF("TWT setup requested");

	return 0;
}

static int teardown_twt(void)
{
	struct net_if *iface = net_if_get_first_wifi();
	struct wifi_twt_params params = { 0 };
	int ret;

	params.operation = WIFI_TWT_TEARDOWN;
	params.negotiation_type = WIFI_TWT_INDIVIDUAL;
	//params.setup_cmd = WIFI_TWT_SETUP_CMD_REQUEST;
	params.dialog_token = dialog_token;
	params.flow_id = twt_flow_id;

	ret = net_mgmt(NET_REQUEST_WIFI_TWT, iface, &params, sizeof(params));
	if (ret) {
		LOG_ERR("%s with %s failed, reason : %s",
			wifi_twt_operation_txt(params.operation),
			wifi_twt_negotiation_type_txt(params.negotiation_type),
			wifi_twt_get_err_code_str(params.fail_reason));
		return ret;
	}

	LOG_INF("TWT teardown success");

	return 0;
}

static int cmd_wifi_status(void)
{
	struct net_if *iface = net_if_get_default();
	struct wifi_iface_status status = { 0 };
	int ret;

	ret = net_mgmt(NET_REQUEST_WIFI_IFACE_STATUS, iface, &status,
				sizeof(struct wifi_iface_status));
	if (ret) {
		LOG_INF("Status request failed: %d\n", ret);
		return ret;
	}

	LOG_INF("==================");
	LOG_INF("State: %s", wifi_state_txt(status.state));

	if (status.state >= WIFI_STATE_ASSOCIATED) {
		uint8_t mac_string_buf[sizeof("xx:xx:xx:xx:xx:xx")];

		LOG_INF("Interface Mode: %s",
		       wifi_mode_txt(status.iface_mode));
		LOG_INF("Link Mode: %s",
		       wifi_link_mode_txt(status.link_mode));
		LOG_INF("SSID: %.32s", status.ssid);
		LOG_INF("BSSID: %s",
		       net_sprint_ll_addr_buf(
				status.bssid, WIFI_MAC_ADDR_LEN,
				mac_string_buf, sizeof(mac_string_buf)));
		LOG_INF("Band: %s", wifi_band_txt(status.band));
		LOG_INF("Channel: %d", status.channel);
		LOG_INF("Security: %s", wifi_security_txt(status.security));
		LOG_INF("MFP: %s", wifi_mfp_txt(status.mfp));
		LOG_INF("RSSI: %d", status.rssi);
		LOG_INF("TWT: %s", status.twt_capable ? "Supported" : "Not supported");

		if (status.twt_capable) {
			twt_supported = 1;
		}
	}

	return 0;
}

static void handle_wifi_connect_result(struct net_mgmt_event_callback *cb)
{
	const struct wifi_status *status =
		(const struct wifi_status *) cb->info;

	if (context.connected) {
		return;
	}

	if (status->status) {
		LOG_ERR("Connection failed (%d)", status->status);
	} else {
		LOG_INF("Connected");
		context.connected = true;
	}

	context.connect_result = true;
}

static void handle_wifi_disconnect_result(struct net_mgmt_event_callback *cb)
{
	const struct wifi_status *status =
		(const struct wifi_status *) cb->info;

	if (!context.connected) {
		return;
	}

	if (context.disconnect_requested) {
		LOG_INF("Disconnection request %s (%d)",
			 status->status ? "failed" : "done",
					status->status);
		context.disconnect_requested = false;
	} else {
		LOG_INF("Received Disconnected");
		context.connected = false;
	}

	cmd_wifi_status();
}

static void print_twt_params(uint8_t dialog_token, uint8_t flow_id,
			     enum wifi_twt_negotiation_type negotiation_type,
			     bool responder, bool implicit, bool announce,
			     bool trigger, uint32_t twt_wake_interval,
			     uint64_t twt_interval)
{
	LOG_INF("TWT Dialog token: %d",
	      dialog_token);
	LOG_INF("TWT flow ID: %d",
	      flow_id);
	LOG_INF("TWT negotiation type: %s",
	      wifi_twt_negotiation_type_txt(negotiation_type));
	LOG_INF("TWT responder: %s",
	       responder ? "true" : "false");
	LOG_INF("TWT implicit: %s",
	      implicit ? "true" : "false");
	LOG_INF("TWT announce: %s",
	      announce ? "true" : "false");
	LOG_INF("TWT trigger: %s",
	      trigger ? "true" : "false");
	LOG_INF("TWT wake interval: %d us",
	      twt_wake_interval);
	LOG_INF("TWT interval: %lld us",
	      twt_interval);
	LOG_INF("************************************************");
}

static void handle_wifi_twt_event(struct net_mgmt_event_callback *cb)
{
	const struct wifi_twt_params *resp =
		(const struct wifi_twt_params *)cb->info;

	if (resp->operation == WIFI_TWT_TEARDOWN) {
		// LOG_INF("twt event handled!!!!!!!!!!!!!!!!!!!");

		// LOG_INF("resp->dialog_token: %d\n", resp->dialog_token);
		// LOG_INF("resp->fail_reason: %d\n", resp->fail_reason);
		// LOG_INF("resp->flow_id: %d\n", resp->flow_id);
		// LOG_INF("resp->negotiation_type: %d\n", resp->negotiation_type);
		// LOG_INF("resp->operation: %d\n", resp->operation);
		// LOG_INF("resp->resp_status: %d\n", resp->resp_status);
		// LOG_INF("resp->setup.announce: %d\n", resp->setup.announce);
		// LOG_INF("resp->setup.implicit: %d\n", resp->setup.implicit);
		// LOG_INF("resp->setup.responder: %d\n", resp->setup.responder);
		// LOG_INF("resp->setup.trigger: %d\n", resp->setup.trigger);
		// LOG_INF("resp->setup.twt_interval: %d\n", resp->setup.twt_interval);
		// LOG_INF("resp->setup.twt_wake_ahead_duration: %d\n", resp->setup.twt_wake_ahead_duration);
		// LOG_INF("resp->setup.twt_wake_interval: %d\n", resp->setup.twt_wake_interval);
		// LOG_INF("resp->setup_cmd: %d\n", resp->setup_cmd);
		// LOG_INF("resp->teardown.teardown_all: %d\n", resp->teardown.teardown_all);
		// LOG_INF("resp->teardown_status: %d\n", resp->teardown_status);

		if (resp->teardown_status == WIFI_TWT_TEARDOWN_SUCCESS) {
			
			LOG_INF("TWT teardown success received for flow ID %d",
				resp->flow_id);
		} else {
			LOG_INF("TWT teardown failed for flow ID %d\n",
				resp->flow_id);
		}
		return;
	}

	if (resp->resp_status == WIFI_TWT_RESP_RECEIVED) {
		LOG_INF("TWT response: %s",
		      wifi_twt_setup_cmd_txt(resp->setup_cmd));

		if (resp->setup_cmd == WIFI_TWT_SETUP_CMD_ACCEPT) {
			twt_resp_accept = true;
		}

		twt_resp_received = true;
		twt_flow_id = resp->flow_id;

		LOG_INF("TWT negotiated parameters");
		LOG_INF("************************************************");
		print_twt_params(resp->dialog_token,
				 resp->flow_id,
				 resp->negotiation_type,
				 resp->setup.responder,
				 resp->setup.implicit,
				 resp->setup.announce,
				 resp->setup.trigger,
				 resp->setup.twt_wake_interval,
				 resp->setup.twt_interval);
	} else {
		LOG_INF("TWT response timed out\n");
	}
}

static void wifi_mgmt_event_handler(struct net_mgmt_event_callback *cb,
				     uint32_t mgmt_event, struct net_if *iface)
{
	switch (mgmt_event) {
	case NET_EVENT_WIFI_CONNECT_RESULT:
		handle_wifi_connect_result(cb);
		break;
	case NET_EVENT_WIFI_DISCONNECT_RESULT:
		handle_wifi_disconnect_result(cb);
		break;
	case NET_EVENT_WIFI_TWT:
		handle_wifi_twt_event(cb);
		break;
#ifdef CONFIG_SCHEDULED_TX
	case NET_EVENT_WIFI_TWT_SLEEP_STATE: {
		int *twt_state;

		twt_state = (int *)(cb->info);
		if (*twt_state == WIFI_TWT_STATE_SLEEP) {
			traffic_gen_pause(&tg_config);
		} else if (*twt_state == WIFI_TWT_STATE_AWAKE)  {
			traffic_gen_resume(&tg_config);
		} else {
			LOG_INF("UNKNOWN TWT STATE %d", *twt_state);
		}
	}
		break;
#endif
	default:
		break;
	}
}

static void print_dhcp_ip(struct net_mgmt_event_callback *cb)
{
	/* Get DHCP info from struct net_if_dhcpv4 and print */
	const struct net_if_dhcpv4 *dhcpv4 = cb->info;
	const struct in_addr *addr = &dhcpv4->requested_ip;
	char dhcp_info[128];

	net_addr_ntop(AF_INET, addr, dhcp_info, sizeof(dhcp_info));

	LOG_INF("DHCP IP address: %s", dhcp_info);
}

static void net_mgmt_event_handler(struct net_mgmt_event_callback *cb,
				    uint32_t mgmt_event, struct net_if *iface)
{
	switch (mgmt_event) {
	case NET_EVENT_IPV4_DHCP_BOUND:
		print_dhcp_ip(cb);
		break;
	default:
		break;
	}
}

static int wifi_connect(void)
{
	struct net_if *iface = net_if_get_first_wifi();

	context.connected = false;
	context.connect_result = false;

	if (net_mgmt(NET_REQUEST_WIFI_CONNECT_STORED, iface, NULL, 0)) {
		LOG_ERR("Connection request failed");

		return -ENOEXEC;
	}

	LOG_INF("Connection requested");

	return 0;
}

int main(void)
{
	int count = 1;

	memset(&context, 0, sizeof(context));

	net_mgmt_init_event_callback(&wifi_shell_mgmt_cb,
			wifi_mgmt_event_handler,
			WIFI_SHELL_MGMT_EVENTS);

	net_mgmt_add_event_callback(&wifi_shell_mgmt_cb);

	net_mgmt_init_event_callback(&net_shell_mgmt_cb,
			net_mgmt_event_handler,
			NET_EVENT_IPV4_DHCP_BOUND);

	net_mgmt_add_event_callback(&net_shell_mgmt_cb);

	LOG_INF("Starting %s with CPU frequency: %d MHz", CONFIG_BOARD, SystemCoreClock/MHZ(1));
	k_sleep(K_SECONDS(1));

	LOG_INF("Static IP address (overridable): %s/%s -> %s",
			CONFIG_NET_CONFIG_MY_IPV4_ADDR,
			CONFIG_NET_CONFIG_MY_IPV4_NETMASK,
			CONFIG_NET_CONFIG_MY_IPV4_GW);

	while (1) {
		if(!context.connected){
			wifi_connect();
	
			while (!context.connect_result) {
				cmd_wifi_status();
				k_sleep(K_MSEC(STATUS_POLLING_MS));
			}

			cmd_wifi_status();

			k_sleep(K_SECONDS(10));
		}

		if (context.connected) {
			int ret;

			//k_sleep(K_FOREVER);

			if (!twt_supported) {
				LOG_INF("AP is not TWT capable, exiting the sample\n");
				return -1;
			}

			LOG_INF("AP is TWT capable, establishing TWT (count: %d) flow ID %d, dialog token %d",
				count, twt_flow_id, dialog_token);

			ret = setup_twt();
			if (ret) {
				LOG_ERR("Failed to establish TWT flow: %d\n", ret);
				return -1;
			}

			if (wait_for_twt_resp_received()) {
				LOG_INF("TWT Setup success");
			} else {
				LOG_INF("TWT Setup timed out\n");
				return -1;
			}

#ifdef CONFIG_TRAFFIC_GEN
			traffic_gen_init(&tg_config);

			ret = traffic_gen_start(&tg_config);
			if (ret < 0) {
				LOG_ERR("Failed to start traffic role ");
				goto teardown;
			}

			ret = traffic_gen_wait_for_report(&tg_config);
			if (ret < 0) {
				LOG_ERR("Failed to get traffic report ");
				goto teardown;
			}
			traffic_gen_get_report(&tg_config);
#endif /* CONFIG_TRAFFIC_GEN */

			/* Wait for few service periods before tearing down */
			k_sleep(K_USEC(20 * CONFIG_TWT_INTERVAL));

teardown:
			ret = teardown_twt();
			if (ret) {
				LOG_ERR("Failed to teardown TWT flow: %d\n", ret);
				return -1;
			}

			k_sleep(K_SECONDS(10));
			twt_flow_id = (twt_flow_id + 1) % 8;
			dialog_token = (dialog_token + 1) % 256;
			count++;
			LOG_INF("================================================");
		}
	}

	return 0;
}
```
