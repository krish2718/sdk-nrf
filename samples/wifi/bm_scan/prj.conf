## CMakeLists.txt
```
#
# Copyright (c) 2024 Nordic Semiconductor ASA
#
# SPDX-License-Identifier: LicenseRef-Nordic-5-Clause
#

cmake_minimum_required(VERSION 3.20.0)

find_package(Zephyr REQUIRED HINTS $ENV{ZEPHYR_BASE})
project(nrf_wifi_bm_scan)

set(OS_AGNOSTIC_BASE ${ZEPHYR_NRFXLIB_MODULE_DIR}/nrf_wifi)

target_include_directories(app PRIVATE
  inc
  ${OS_AGNOSTIC_BASE}/utils/inc
  ${OS_AGNOSTIC_BASE}/os_if/inc
  ${OS_AGNOSTIC_BASE}/bus_if/bus/qspi/inc
  ${OS_AGNOSTIC_BASE}/bus_if/bal/inc
  ${OS_AGNOSTIC_BASE}/fw_if/umac_if/inc
  ${OS_AGNOSTIC_BASE}/fw_load/mips/fw/inc
  ${OS_AGNOSTIC_BASE}/hw_if/hal/inc
  ${OS_AGNOSTIC_BASE}/hw_if/hal/inc/fw
  ${OS_AGNOSTIC_BASE}/fw_if/umac_if/inc/fw
  ${OS_AGNOSTIC_BASE}/fw_if/umac_if/inc/default
)

target_sources(app PRIVATE
  ${OS_AGNOSTIC_BASE}/os_if/src/osal.c
  ${OS_AGNOSTIC_BASE}/utils/src/list.c
  ${OS_AGNOSTIC_BASE}/utils/src/queue.c
  ${OS_AGNOSTIC_BASE}/utils/src/util.c
  ${OS_AGNOSTIC_BASE}/hw_if/hal/src/hal_api.c
  ${OS_AGNOSTIC_BASE}/hw_if/hal/src/hal_fw_patch_loader.c
  ${OS_AGNOSTIC_BASE}/hw_if/hal/src/hal_interrupt.c
  ${OS_AGNOSTIC_BASE}/hw_if/hal/src/hal_mem.c
  ${OS_AGNOSTIC_BASE}/hw_if/hal/src/hal_reg.c
  ${OS_AGNOSTIC_BASE}/hw_if/hal/src/hpqm.c
  ${OS_AGNOSTIC_BASE}/hw_if/hal/src/pal.c
  ${OS_AGNOSTIC_BASE}/bus_if/bal/src/bal.c
  ${OS_AGNOSTIC_BASE}/bus_if/bus/qspi/src/qspi.c
  ${OS_AGNOSTIC_BASE}/fw_if/umac_if/src/cmd.c
  ${OS_AGNOSTIC_BASE}/fw_if/umac_if/src/event.c
  ${OS_AGNOSTIC_BASE}/fw_if/umac_if/src/fmac_api_common.c
  ${OS_AGNOSTIC_BASE}/fw_if/umac_if/src/default/fmac_api.c
    src/scan.c
)
```

## Kconfig
```
#
# Copyright (c) 2024 Nordic Semiconductor
#
# SPDX-License-Identifier: LicenseRef-Nordic-5-Clause
#

source "Kconfig.zephyr"

menu "Nordic Bare-metal Scan sample"

rsource "Kconfig.nrf_wifi"

endmenu
```

## Kconfig.nrf_wifi
```
#
# Copyright (c) 2024 Nordic Semiconductor
#
# SPDX-License-Identifier: LicenseRef-Nordic-5-Clause
#

config NRF700X_REG_DOMAIN
	string "The ISO/IEC alpha2 country code for the country in which this device is currently operating. Default 00 (World regulatory)"
	# 00 is used for World regulatory
	default "00"

config NRF700X_LOG_VERBOSE
	bool "Maintains the verbosity of information in logs"
	default y

module = WIFI_NRF700X
module-dep = LOG
module-str = Log level for Wi-Fi nRF700x driver
module-help = Sets log level for Wi-Fi nRF700x driver
source "subsys/logging/Kconfig.template.log_config"

config WIFI_NRF700X_LOG_LEVEL
	# Enable error by default
	default 1

config NRF700X_ON_SPI
	select SPI


config NRF700X_WORKQ_STACK_SIZE
	int "Stack size for workqueue"
	default 4096

config NRF700X_WORKQ_MAX_ITEMS
	int "Maximum work items for all workqueues"
	default 100

config NRF700X_MAX_TX_PENDING_QLEN
	int "Maximum number of pending TX packets"
	default 18

config NRF700X_UTIL
	depends on SHELL
	bool "Enable Utility shell in nRF700x driver"

config NRF700X_BT_COEX
	bool "Enable Wi-Fi Bluetooth coexistence support"
	depends on SOC_NRF5340_CPUAPP_QKAA
	default y if SOC_NRF5340_CPUAPP_QKAA

config NRF700X_QSPI_LOW_POWER
	bool "Enable low power mode in QSPI"
	default y if NRF_WIFI_LOW_POWER

config NRF700X_ANT_GAIN_2G
	int "Antenna gain for 2.4 GHz band"
	default 0
	range 0 6

config NRF700X_ANT_GAIN_5G_BAND1
	int "Antenna gain for 5 GHz band (5150 MHz - 5350 MHz)"
	default 0
	range 0 6

config NRF700X_ANT_GAIN_5G_BAND2
	int "Antenna gain for 5 GHz band (5470 MHz - 5730 MHz)"
	default 0
	range 0 6

config NRF700X_ANT_GAIN_5G_BAND3
	int "Antenna gain for 5 GHz band (5730 MHz - 5895 MHz)"
	default 0
	range 0 6

config NRF700X_BAND_2G_LOWER_EDGE_BACKOFF
	int "Transmit power backoff (in dB) for lower edge of 2.4 GHz frequency band"
	default 0
	range 0 10

config NRF700X_BAND_2G_UPPER_EDGE_BACKOFF
	int "Transmit power backoff (in dB) for upper edge of 2.4 GHz frequency band"
	default 0
	range 0 10

config NRF700X_BAND_UNII_1_LOWER_EDGE_BACKOFF
	int "Transmit power backoff (in dB) for lower edge of UNII-1 frequency band"
	default 0
	range 0 10

config NRF700X_BAND_UNII_1_UPPER_EDGE_BACKOFF
	int "Transmit power backoff (in dB) for upper edge of UNII-1 frequency band"
	default 0
	range 0 10

config NRF700X_BAND_UNII_2A_LOWER_EDGE_BACKOFF
	int "Transmit power backoff (in dB) for lower edge of UNII-2A frequency band"
	default 0
	range 0 10

config NRF700X_BAND_UNII_2A_UPPER_EDGE_BACKOFF
	int "Transmit power backoff (in dB) for upper edge of UNII-2A frequency band"
	default 0
	range 0 10

config NRF700X_BAND_UNII_2C_LOWER_EDGE_BACKOFF
	int "Transmit power backoff (in dB) for lower edge of UNII-2C frequency band"
	default 0
	range 0 10

config NRF700X_BAND_UNII_2C_UPPER_EDGE_BACKOFF
	int "Transmit power backoff (in dB) for upper edge of UNII-2C frequency band"
	default 0
	range 0 10

config NRF700X_BAND_UNII_3_LOWER_EDGE_BACKOFF
	int "Transmit power backoff (in dB) for lower edge of UNII-3 frequency band"
	default 0
	range 0 10

config NRF700X_BAND_UNII_3_UPPER_EDGE_BACKOFF
	int "Transmit power backoff (in dB) for upper edge of UNII-3 frequency band"
	default 0
	range 0 10

config NRF700X_BAND_UNII_4_LOWER_EDGE_BACKOFF
	int "Transmit power backoff (in dB) for lower edge of UNII-4 frequency band"
	default 0
	range 0 10

config NRF700X_BAND_UNII_4_UPPER_EDGE_BACKOFF
	int "Transmit power backoff (in dB) for upper edge of UNII-4 frequency band"
	default 0
	range 0 10

config WIFI_FIXED_MAC_ADDRESS
	string "WiFi Fixed MAC address in format XX:XX:XX:XX:XX:XX"
	help
		This overrides the MAC address read from OTP. Strictly for testing purposes only.

config NRF700X_RSSI_STALE_TIMEOUT_MS
	int "RSSI stale timeout in milliseconds"
	default 1000
	help
	  RSSI stale timeout is the period after which driver queries
	  RPU to get the RSSI the value.
	  If data is active (e.g. ping), driver stores the RSSI value from
	  the received frames and provides this stored information
	  to wpa_supplicant. In this case a higher value will be suitable
	  as stored RSSI value at driver will be updated regularly.
	  If data is not active or after the stale timeout duration,
	  driver queries the RPU to get the RSSI value
	  and provides it to wpa_supplicant. The value should be set to lower
	  value as driver does not store it and requires RPU to provide the
	  info.

config NRF_WIFI_SCAN_MAX_BSS_CNT
	int "Maximum number of scan results to return."
	default 0
	range 0 65535
	help
		Maximum number of scan results to return. 0 represents unlimited number of BSSes.

config WIFI_NRF700X_SCAN_TIMEOUT_S
	int "Scan timeout in seconds"
	default 30

config NRF_WIFI_2G_BAND
	bool "Set operation band to 2.4GHz"
	default y if BOARD_NRF7001

config NRF_WIFI_5G_BAND
	bool "Set operation band to 5GHz"
	depends on !BOARD_NRF7001

config NRF_WIFI_OP_BAND
	int "Options to set operation band"
	default 1 if NRF_WIFI_2G_BAND
	default 2 if NRF_WIFI_5G_BAND
	default 3
	help
		Set this option to select frequency band
		1 - 2.4GHz
		2 - 5GHz
		3 - All ( 2.4GHz and 5GHz )

config NRF_WIFI_IFACE_MTU
	int "MTU for Wi-Fi interface"
	range 576 2304 if NET_IPV4
	range 1280 2304 if NET_IPV6
	default 1500

config WIFI_NRF700X_SKIP_LOCAL_ADMIN_MAC
	bool "Suppress networks with non-individual MAC address as BSSID in the scan results"
	help
		Wi-Fi access points use locally administered MAC address to manage
		multiple virtual interfaces, for geo-location usecase these networks
		from the virtual interfaces do not help in anyway as they are co-located with the primary interface
		that has globally unique MAC address.

		So, to save resources, this option drops such networks from the scan results.
config WIFI_NRF700X_SCAN_DISABLE_DFS_CHANNELS
	bool "Disables DFS channels in scan operation"
	help
		This option disables inclusion of DFS channels in scan operation.
		This is useful to reduce the scan time, as DFS channels are seldom used.

# P
config NRF700X_RX_NUM_BUFS
	int "Number of RX buffers"
	default 48

config NRF700X_RX_MAX_DATA_SIZE
	int "Maximum size of RX data"
	default 1600
```

## sample.yaml
```
sample:
  description: Wi-Fi bare-metal scan sample
    application
  name: Wi-Fi BM scan
tests:
  sample.nrf7002.sbm_can:
    build_only: true
    integration_platforms:
      - nrf7002dk_nrf5340_cpuapp
    platform_allow: nrf7002dk_nrf5340_cpuapp
    tags: ci_build
```

## prj.conf
```kconfig
#
# Copyright (c) 2024 Nordic Semiconductor ASA
#
# SPDX-License-Identifier: LicenseRef-Nordic-5-Clause
#
# System settings
CONFIG_ASSERT=y
# Logging
CONFIG_LOG=y
CONFIG_PRINTK=y
# If below config is enabled, printk logs are
# buffered. For unbuffered messages, disable this.
CONFIG_LOG_PRINTK=n
```

## inc/scan.h
```c
/*
 * Copyright (c) 2024 Nordic Semiconductor ASA
 *
 * SPDX-License-Identifier: LicenseRef-Nordic-5-Clause
 */

/** @file
 * @brief WiFi bare-metal scan
 */

#ifndef SCAN_H_
#define SCAN_H_

#endif /* SCAN_H_ */
```

## src/scan.c
```c
/*
 * Copyright (c) 2024 Nordic Semiconductor ASA
 *
 * SPDX-License-Identifier: LicenseRef-Nordic-5-Clause
 */

/** @file
 * @brief WiFi bare-metal scan
 */

#include <stdio.h>

int main(void)
{

	printf("Hello, Metal!\n");

	return 0;
}
```
