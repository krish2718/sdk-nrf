## CMakeLists.txt
```
#
# Copyright (c) 2022 Nordic Semiconductor ASA
#
# SPDX-License-Identifier: LicenseRef-Nordic-5-Clause
#

cmake_minimum_required(VERSION 3.13.1)

find_package(Zephyr REQUIRED HINTS $ENV{ZEPHYR_BASE})
project(hello_world)

target_sources(app PRIVATE src/qspi_main.c)
target_sources(app PRIVATE src/qspi_if.c)
target_sources(app PRIVATE src/spi_if.c)
target_sources(app PRIVATE src/interrupts.c)
target_sources(app PRIVATE src/device.c)
```

## prj.conf
```kconfig
# QSPI
CONFIG_FLASH=y
CONFIG_NRFX_QSPI=y
CONFIG_HEAP_MEM_POOL_SIZE=80000

# SPIM
CONFIG_NRFX_SPIM=y
CONFIG_NRFX_SPIM3=y
CONFIG_NRFX_SPIM4=y

CONFIG_POSIX_API=y
CONFIG_CBPRINTF_FP_SUPPORT=y

# GPIO
CONFIG_GPIO=y

# Shell
CONFIG_SHELL=y
```

## src/device.c
```c
/*
 * Copyright (c) 2022 Nordic Semiconductor ASA
 *
 * SPDX-License-Identifier: LicenseRef-Nordic-5-Clause
 */

/**
 * @brief File containing QSPI device specific definitions for the
 * Zephyr OS layer of the Wi-Fi driver.
 */

#include <zephyr.h>
#include <sys/printk.h>
#include <drivers/gpio.h>
#include <stdio.h>
#include <string.h>

#include "qspi_if.h"
#include "spi_if.h"

struct qspi_config config;

struct qspi_dev qspi = { .init = qspi_init,
			 .read = qspi_read,
			 .write = qspi_write,
			 .hl_read = qspi_hl_read,
			 .hard_reset = hard_reset };

struct qspi_dev spim = { .init = spim_init,
			 .read = spim_read,
			 .write = spim_write,
			 .hl_read = spim_hl_read,
			 .hard_reset = hard_reset };

struct qspi_config *qspi_defconfig(void)
{
	memset(&config, 0, sizeof(struct qspi_config));

	config.addrmode = NRF_QSPI_ADDRMODE_24BIT;
	config.RDC4IO = 0xA0;
	config.easydma = true;
	config.quad_spi = true;
	config.addrmask = 0x800000; /* set bit23 (incr. addr mode) */

	config.freq = 16; /* 16MHz */

	config.test_name = "QSPI TEST";
	config.test_hlread = false;
	config.test_iteration = 0;

	config.qspi_slave_latency = 0;

	if (config.freq == 16) /* 16MHz */
		config.qspi_slave_latency = 1;

	config.encryption = config.CMD_CNONCE = false;

#ifdef CONFIG_BOARD_NRF5340DK_NRF5340_CPUAPP

	/*For #Bit 6 Enable below: i.e ALL Ones for QSPI Key*/
	memset(&config.p_cfg.key, 0xff, sizeof(config.p_cfg.key));

	config.p_cfg.nonce[0] = 0x16181648;
	config.p_cfg.nonce[1] = 0x0;
	config.p_cfg.nonce[2] = 0x1;

#endif /*CONFIG_BOARD_NRF5340DK_NRF5340_CPUAPP*/

	return &config;
}

struct qspi_dev *qspi_dev(bool spim_flag)
{
	/* spim_flag : 0 -> qspi, 1 -> spim */
	return (spim_flag) ? &spim : &qspi;
}
```

## src/interrupts.c
```c
/*
 * Copyright (c) 2022 Nordic Semiconductor ASA
 *
 * SPDX-License-Identifier: LicenseRef-Nordic-5-Clause
 */

/**
 * @brief File containing QSPI device interrupt handler specific definitions
 * for the Zephyr OS layer of the Wi-Fi driver.
 */

#include <zephyr.h>
#include <device.h>
#include <drivers/gpio.h>
#include <sys/util.h>
#include <sys/printk.h>
#include <inttypes.h>

#define SLEEP_TIME_MS	1

/*
 * Get button configuration from the devicetree sw0 alias. This is mandatory.
 */
#define SW1_NODE	DT_ALIAS(sw1)
#define SW2_NODE	DT_ALIAS(sw2)

#if !DT_NODE_HAS_STATUS(SW1_NODE, okay)
#error "Unsupported board: sw1 devicetree alias is not defined"
#endif

void gpio_free_irq(int pin, struct gpio_callback *button_cb_data)
{
	printk("TODO : %s\n", __func__);
}

int gpio_request_irq(int pin, struct gpio_callback *button_cb_data,
	void (*irq_handler)())
{
	int ret;
	struct gpio_dt_spec button;

#ifdef CONFIG_BOARD_NRF52840DK_NRF52840
	struct gpio_dt_spec sw2 = GPIO_DT_SPEC_GET_OR(SW2_NODE, gpios, {0});

	/* GPIO0 P0.24 is mapped to SW2 */
	button = sw2;
#elif CONFIG_BOARD_NRF5340DK_NRF5340_CPUAPP
	struct gpio_dt_spec sw1 = GPIO_DT_SPEC_GET_OR(SW1_NODE, gpios, {0});

	/* GPIO0 P0.24 is mapped to SW1 */
	button = sw1;
#endif

	if (!device_is_ready(button.port)) {
		printk("Error: button device %s is not ready\n",
			button.port->name);
		return -1;
	}

	ret = gpio_pin_configure_dt(&button, GPIO_INPUT);
	if (ret != 0) {
		printk("Error %d: failed to configure %s pin %d\n",
			ret, button.port->name, button.pin);
		return ret;
	}

	ret = gpio_pin_interrupt_configure_dt(&button,
					      GPIO_INT_EDGE_RISING);
	if (ret != 0) {
		printk("Error %d: failed to configure interrupt on %s pin %d\n",
			ret, button.port->name, button.pin);
		return ret;
	}

	gpio_init_callback(button_cb_data, irq_handler, BIT(button.pin));
	gpio_add_callback(button.port, button_cb_data);

	return 0;
}

void hard_reset(void)
{
	const struct device *port;
	unsigned int pin = 12; /* P0.12 pin on nrf5340 */

	port = device_get_binding("GPIO_0");

	gpio_pin_configure(port, pin, GPIO_OUTPUT_INACTIVE);
	k_msleep(500);

	gpio_pin_configure(port, pin, GPIO_OUTPUT_ACTIVE);
	k_msleep(500);
}
```

## src/qspi_if.h
```c
/*
 * Copyright (c) 2022 Nordic Semiconductor ASA
 *
 * SPDX-License-Identifier: LicenseRef-Nordic-5-Clause
 */

/**
 * @brief Header containing QSPI device interface specific declarations for the
 * Zephyr OS layer of the Wi-Fi driver.
 */

#ifndef __QSPI_IF_H__
#define __QSPI_IF_H__

#include <drivers/gpio.h>
#include <nrfx_qspi.h>

/* QSPI driver config */
#define CONFIG_FLASH_HAS_DRIVER_ENABLED 1
#define CONFIG_FLASH_HAS_PAGE_LAYOUT 1
#define CONFIG_FLASH_JESD216 1
#define CONFIG_FLASH 1
#define CONFIG_FLASH_PAGE_LAYOUT 1
#define CONFIG_SOC_FLASH_NRF 1
#define CONFIG_SOC_FLASH_NRF_RADIO_SYNC_NONE 1
#define CONFIG_NORDIC_QSPI_NOR 1
#define CONFIG_NORDIC_QSPI_NOR_INIT_PRIORITY 80
#define CONFIG_NORDIC_QSPI_NOR_STACK_WRITE_BUFFER_SIZE 0

#define RPU_WAKEUP_NOW BIT(0) /* WAKEUP_NOW */
#define RPU_AWAKE_BIT BIT(1)  /* RPU AWAKE FROM SLEEP */
#define RPU_READY_BIT BIT(2)  /* RPI IS READY */

struct qspi_config {
	nrf_qspi_addrmode_t addrmode;
	nrf_qspi_readoc_t readoc;
	nrf_qspi_writeoc_t writeoc;
	nrf_qspi_frequency_t sckfreq;
	unsigned int freq;
	unsigned int spimfreq;
	unsigned char RDC4IO;
	bool easydma;
	bool single_op;
	bool quad_spi;
	bool encryption;
	bool CMD_CNONCE;
	bool enc_enabled;
	struct k_sem lock;
	unsigned int addrmask;
	unsigned char qspi_slave_latency;
#ifdef CONFIG_BOARD_NRF5340DK_NRF5340_CPUAPP
	nrf_qspi_encryption_t p_cfg;
#endif /*CONFIG_BOARD_NRF5340DK_NRF5340_CPUAPP*/
	int test_hlread;
	char *test_name;
	int test_start;
	int test_end;
	int test_iterations;
	int test_timediff_read;
	int test_timediff_write;
	int test_status;
	int test_iteration;
};
struct qspi_dev {
	int (*deinit)(void);
	void *config;
	int (*init)(struct qspi_config *config);
	int (*write)(unsigned int addr, const void *data, int len);
	int (*read)(unsigned int addr, void *data, int len);
	int (*hl_read)(unsigned int addr, void *data, int len);
	void (*hard_reset)(void);
};

int qspi_cmd_wakeup_rpu(const struct device *dev, uint8_t data);

int qspi_init(struct qspi_config *config);

int qspi_write(unsigned int addr, const void *data, int len);

int qspi_read(unsigned int addr, void *data, int len);

int qspi_hl_read(unsigned int addr, void *data, int len);

int qspi_deinit(void);

void gpio_free_irq(int pin, struct gpio_callback *button_cb_data);

int gpio_request_irq(int pin, struct gpio_callback *button_cb_data,
					 void (*irq_handler)());

struct qspi_config *qspi_defconfig(void);

struct qspi_dev *qspi_dev(bool spim_flag);
//struct qspi_dev *qspi_dev(void);

int qspi_cmd_sleep_rpu(const struct device *dev);

void hard_reset(void);
void get_sleep_stats(uint32_t addr, uint32_t *buff, uint32_t wrd_len);

extern struct device qspi_perip;
int qspi_validate_rpu_wake_writecmd(const struct device *dev);
int qspi_cmd_wakeup_rpu(const struct device *dev, uint8_t data);
int qspi_wait_while_firmware_awake(const struct device *dev);
int qspi_wait_while_rpu_awake(const struct device *dev);

void func_wifi_on(void);

int func_gpio_config(void);
int func_irq_config(struct gpio_callback *irq_callback_data,
		void (*irq_handler)());

#endif /* __QSPI_IF_H__ */
```

## src/spi_context.h
```c
/*
 * Copyright (c) 2022 Nordic Semiconductor ASA
 *
 * SPDX-License-Identifier: LicenseRef-Nordic-5-Clause
 */

/**
 * @brief Header containing SPI device context declarations for the
 * Zephyr OS layer of the Wi-Fi driver.
 */

#ifndef __SPI_CONTEXT_H__
#define __SPI_CONTEXT_H__

#include <drivers/gpio.h>
#include <drivers/spi.h>

#ifdef __cplusplus
extern "C" {
#endif

enum spi_ctx_runtime_op_mode {
	SPI_CTX_RUNTIME_OP_MODE_MASTER = BIT(0),
	SPI_CTX_RUNTIME_OP_MODE_SLAVE = BIT(1),
};

struct spi_context {
	const struct spi_config *config;
	const struct spi_config *owner;

	struct k_sem lock;
	struct k_sem sync;
	int sync_status;

#ifdef CONFIG_SPI_ASYNC
	struct k_poll_signal *signal;
	bool asynchronous;
#endif /* CONFIG_SPI_ASYNC */
	const struct spi_buf *current_tx;
	size_t tx_count;
	const struct spi_buf *current_rx;
	size_t rx_count;

	const uint8_t *tx_buf;
	size_t tx_len;
	uint8_t *rx_buf;
	size_t rx_len;

#ifdef CONFIG_SPI_SLAVE
	int recv_frames;
#endif /* CONFIG_SPI_SLAVE */
};

#define SPI_CONTEXT_INIT_LOCK(_data, _ctx_name)                                                    \
	._ctx_name.lock = Z_SEM_INITIALIZER(_data._ctx_name.lock, 0, 1)

#define SPI_CONTEXT_INIT_SYNC(_data, _ctx_name)                                                    \
	._ctx_name.sync = Z_SEM_INITIALIZER(_data._ctx_name.sync, 0, 1)

static inline bool spi_context_configured(struct spi_context *ctx, const struct spi_config *config)
{
	return !!(ctx->config == config);
}

static inline bool spi_context_is_slave(struct spi_context *ctx)
{
	return (ctx->config->operation & SPI_OP_MODE_SLAVE);
}

static inline void spi_context_lock(struct spi_context *ctx, bool asynchronous,
				    struct k_poll_signal *signal, const struct spi_config *spi_cfg)
{
	if ((spi_cfg->operation & SPI_LOCK_ON) && (k_sem_count_get(&ctx->lock) == 0) &&
	    (ctx->owner == spi_cfg)) {
		return;
	}

	k_sem_take(&ctx->lock, K_FOREVER);
	ctx->owner = spi_cfg;

#ifdef CONFIG_SPI_ASYNC
	ctx->asynchronous = asynchronous;
	ctx->signal = signal;
#endif /* CONFIG_SPI_ASYNC */
}

static inline void spi_context_release(struct spi_context *ctx, int status)
{
#ifdef CONFIG_SPI_SLAVE
	if (status >= 0 && (ctx->config->operation & SPI_LOCK_ON))
		return;
#endif /* CONFIG_SPI_SLAVE */

#ifdef CONFIG_SPI_ASYNC
	if (!ctx->asynchronous || (status < 0)) {
		ctx->owner = NULL;
		k_sem_give(&ctx->lock);
	}
#else
	if (!(ctx->config->operation & SPI_LOCK_ON)) {
		ctx->owner = NULL;
		k_sem_give(&ctx->lock);
	}
#endif /* CONFIG_SPI_ASYNC */
}

static inline int spi_context_wait_for_completion(struct spi_context *ctx)
{
	int status = 0;
#ifdef CONFIG_SPI_ASYNC
	if (!ctx->asynchronous) {
		k_sem_take(&ctx->sync, K_FOREVER);
		status = ctx->sync_status;
	}
#else
	k_sem_take(&ctx->sync, K_FOREVER);
	status = ctx->sync_status;
#endif /* CONFIG_SPI_ASYNC */

#ifdef CONFIG_SPI_SLAVE
	if (spi_context_is_slave(ctx) && !status)
		return ctx->recv_frames;
#endif /* CONFIG_SPI_SLAVE */

	return status;
}

static inline void spi_context_complete(struct spi_context *ctx, int status)
{
#ifdef CONFIG_SPI_ASYNC
	if (!ctx->asynchronous) {
		ctx->sync_status = status;
		k_sem_give(&ctx->sync);
	} else {
		if (ctx->signal) {
#ifdef CONFIG_SPI_SLAVE
			if (spi_context_is_slave(ctx) && !status) {
				/* Let's update the status so it tells
				 * about number of received frames.
				 */
				status = ctx->recv_frames;
			}
#endif /* CONFIG_SPI_SLAVE */
			k_poll_signal_raise(ctx->signal, status);
		}

		if (!(ctx->config->operation & SPI_LOCK_ON)) {
			ctx->owner = NULL;
			k_sem_give(&ctx->lock);
		}
	}
#else
	ctx->sync_status = status;
	k_sem_give(&ctx->sync);
#endif /* CONFIG_SPI_ASYNC */
}

static inline gpio_dt_flags_t spi_context_cs_active_level(struct spi_context *ctx)
{
	if (ctx->config->operation & SPI_CS_ACTIVE_HIGH)
		return GPIO_ACTIVE_HIGH;

	return GPIO_ACTIVE_LOW;
}

static inline void spi_context_cs_configure(struct spi_context *ctx)
{
	if (ctx->config->cs && ctx->config->cs->gpio_dev) {
		/* Validate CS active levels are equivalent */
		__ASSERT(spi_context_cs_active_level(ctx) ==
				 (ctx->config->cs->gpio_dt_flags & GPIO_ACTIVE_LOW),
			 "Devicetree and spi_context CS levels are not equal");
		gpio_pin_configure(ctx->config->cs->gpio_dev, ctx->config->cs->gpio_pin,
				   ctx->config->cs->gpio_dt_flags | GPIO_OUTPUT_INACTIVE);
	} else {
		LOG_INF("CS control inhibited (no GPIO device)");
	}
}

static inline void _spi_context_cs_control(struct spi_context *ctx, bool on, bool force_off)
{
	if (ctx->config && ctx->config->cs && ctx->config->cs->gpio_dev) {
		if (on) {
			gpio_pin_set(ctx->config->cs->gpio_dev, ctx->config->cs->gpio_pin, 1);
			k_busy_wait(ctx->config->cs->delay);
		} else {
			if (!force_off && ctx->config->operation & SPI_HOLD_ON_CS) {
				return;
			}

			k_busy_wait(ctx->config->cs->delay);
			gpio_pin_set(ctx->config->cs->gpio_dev, ctx->config->cs->gpio_pin, 0);
		}
	}
}

static inline void spi_context_cs_control(struct spi_context *ctx, bool on)
{
	_spi_context_cs_control(ctx, on, false);
}

static inline void spi_context_unlock_unconditionally(struct spi_context *ctx)
{
	/* Forcing CS to go to inactive status */
	_spi_context_cs_control(ctx, false, true);

	if (!k_sem_count_get(&ctx->lock)) {
		ctx->owner = NULL;
		k_sem_give(&ctx->lock);
	}
}

static inline void spi_context_buffers_setup(struct spi_context *ctx,
					     const struct spi_buf_set *tx_bufs,
					     const struct spi_buf_set *rx_bufs, uint8_t dfs)
{
	LOG_DBG("tx_bufs %p - rx_bufs %p - %u", tx_bufs, rx_bufs, dfs);

	if (tx_bufs) {
		ctx->current_tx = tx_bufs->buffers;
		ctx->tx_count = tx_bufs->count;
		ctx->tx_buf = (const uint8_t *)ctx->current_tx->buf;
		ctx->tx_len = ctx->current_tx->len / dfs;
	} else {
		ctx->current_tx = NULL;
		ctx->tx_count = 0;
		ctx->tx_buf = NULL;
		ctx->tx_len = 0;
	}

	if (rx_bufs) {
		ctx->current_rx = rx_bufs->buffers;
		ctx->rx_count = rx_bufs->count;
		ctx->rx_buf = (uint8_t *)ctx->current_rx->buf;
		ctx->rx_len = ctx->current_rx->len / dfs;
	} else {
		ctx->current_rx = NULL;
		ctx->rx_count = 0;
		ctx->rx_buf = NULL;
		ctx->rx_len = 0;
	}

	ctx->sync_status = 0;

#ifdef CONFIG_SPI_SLAVE
	ctx->recv_frames = 0;
#endif /* CONFIG_SPI_SLAVE */

	LOG_DBG("current_tx %p (%zu), current_rx %p (%zu), tx buf/len %p/%zu, rx buf/len %p/%zu",
		ctx->current_tx, ctx->tx_count, ctx->current_rx, ctx->rx_count, ctx->tx_buf,
		ctx->tx_len, ctx->rx_buf, ctx->rx_len);
}

static ALWAYS_INLINE void spi_context_update_tx(struct spi_context *ctx, uint8_t dfs, uint32_t len)
{
	if (!ctx->tx_len)
		return;

	if (len > ctx->tx_len) {
		LOG_ERR("Update exceeds current buffer");
		return;
	}

	ctx->tx_len -= len;
	if (!ctx->tx_len) {
		ctx->tx_count--;
		if (ctx->tx_count) {
			ctx->current_tx++;
			ctx->tx_buf = (const uint8_t *)ctx->current_tx->buf;
			ctx->tx_len = ctx->current_tx->len / dfs;
		} else {
			ctx->tx_buf = NULL;
		}
	} else if (ctx->tx_buf) {
		ctx->tx_buf += dfs * len;
	}

	LOG_DBG("tx buf/len %p/%zu", ctx->tx_buf, ctx->tx_len);
}

static ALWAYS_INLINE bool spi_context_tx_on(struct spi_context *ctx)
{
	return !!(ctx->tx_len);
}

static ALWAYS_INLINE bool spi_context_tx_buf_on(struct spi_context *ctx)
{
	return !!(ctx->tx_buf && ctx->tx_len);
}

static ALWAYS_INLINE void spi_context_update_rx(struct spi_context *ctx, uint8_t dfs, uint32_t len)
{
#ifdef CONFIG_SPI_SLAVE
	if (spi_context_is_slave(ctx))
		ctx->recv_frames += len;

#endif /* CONFIG_SPI_SLAVE */

	if (!ctx->rx_len)
		return;

	if (len > ctx->rx_len) {
		LOG_ERR("Update exceeds current buffer");
		return;
	}

	ctx->rx_len -= len;

	if (!ctx->rx_len) {
		ctx->rx_count--;

		if (ctx->rx_count) {
			ctx->current_rx++;
			ctx->rx_buf = (uint8_t *)ctx->current_rx->buf;
			ctx->rx_len = ctx->current_rx->len / dfs;
		} else
			ctx->rx_buf = NULL;
	} else if (ctx->rx_buf)
		ctx->rx_buf += dfs * len;

	LOG_DBG("rx buf/len %p/%zu", ctx->rx_buf, ctx->rx_len);
}

static ALWAYS_INLINE bool spi_context_rx_on(struct spi_context *ctx)
{
	return !!(ctx->rx_len);
}

static ALWAYS_INLINE bool spi_context_rx_buf_on(struct spi_context *ctx)
{
	return !!(ctx->rx_buf && ctx->rx_len);
}

/*
 * Returns the maximum length of a transfer for which all currently active
 * directions have a continuous buffer, i.e. the maximum SPI transfer that
 * can be done with DMA that handles only non-scattered buffers.
 */
static inline size_t spi_context_max_continuous_chunk(struct spi_context *ctx)
{
	if (!ctx->tx_len)
		return ctx->rx_len;
	else if (!ctx->rx_len)
		return ctx->tx_len;

	return MIN(ctx->tx_len, ctx->rx_len);
}

static inline size_t spi_context_longest_current_buf(struct spi_context *ctx)
{
	return ctx->tx_len > ctx->rx_len ? ctx->tx_len : ctx->rx_len;
}

static inline size_t spi_context_total_tx_len(struct spi_context *ctx)
{
	size_t n;
	size_t total_len = 0;

	for (n = 0; n < ctx->tx_count; ++n)
		total_len += ctx->current_tx[n].len;

	return total_len;
}

static inline size_t spi_context_total_rx_len(struct spi_context *ctx)
{
	size_t n;
	size_t total_len = 0;

	for (n = 0; n < ctx->rx_count; ++n)
		total_len += ctx->current_rx[n].len;

	return total_len;
}

#ifdef __cplusplus
}
#endif

#endif /* __SPI_CONTEXT_H__ */
```

## src/spi_if.c
```c
/*
 * Copyright (c) 2022 Nordic Semiconductor ASA
 *
 * SPDX-License-Identifier: LicenseRef-Nordic-5-Clause
 */

/**
 * @brief File containing SPI device interface specific definitions for the
 * Zephyr OS layer of the Wi-Fi driver.
 */

#include <drivers/spi.h>
#include <nrfx_spim.h>
#include <string.h>

#define LOG_DOMAIN "spi_nrfx_spim"
#define LOG_LEVEL CONFIG_SPI_LOG_LEVEL
#include <logging/log.h>
LOG_MODULE_REGISTER(spi_nrfx_spim);

#include "spi_context.h"
#include "qspi_if.h"
#include "spi_if.h"

struct qspi_config *spim_config;
struct spi_nrfx_data {
	struct spi_context ctx;
	const struct device *dev;
	size_t chunk_len;
	bool busy;
#ifdef CONFIG_PM_DEVICE
	uint32_t pm_state;
#endif
#if (CONFIG_SPI_NRFX_RAM_BUFFER_SIZE > 0)
	uint8_t buffer[CONFIG_SPI_NRFX_RAM_BUFFER_SIZE];
#endif
};

struct spi_nrfx_config {
	nrfx_spim_t spim;
	size_t max_chunk_len;
	uint32_t max_freq;
	nrfx_spim_config_t config;
};

static inline struct spi_nrfx_data *get_dev_data(const struct device *dev)
{
	return dev->data;
}

static inline const struct spi_nrfx_config *get_dev_config(const struct device *dev)
{
	return dev->config;
}

static inline nrf_spim_frequency_t get_nrf_spim_frequency(uint32_t frequency)
{
	/* Get the highest supported frequency not exceeding the requested one.
	 */
	if (frequency < 250000) {
		return NRF_SPIM_FREQ_125K;
	} else if (frequency < 500000) {
		return NRF_SPIM_FREQ_250K;
	} else if (frequency < 1000000) {
		return NRF_SPIM_FREQ_500K;
	} else if (frequency < 2000000) {
		return NRF_SPIM_FREQ_1M;
	} else if (frequency < 4000000) {
		return NRF_SPIM_FREQ_2M;
	} else if (frequency < 8000000) {
		return NRF_SPIM_FREQ_4M;
/* Only the devices with HS-SPI can use SPI clock higher than 8 MHz and
 * have SPIM_FREQUENCY_FREQUENCY_M32 defined in their own bitfields.h
 */
#if defined(SPIM_FREQUENCY_FREQUENCY_M32)
	} else if (frequency < 16000000) {
		return NRF_SPIM_FREQ_8M;
	} else if (frequency < 32000000) {
		return NRF_SPIM_FREQ_16M;
	} else {
		return NRF_SPIM_FREQ_32M;
#else
	} else {
		return NRF_SPIM_FREQ_8M;
#endif
	}
}

static inline nrf_spim_mode_t get_nrf_spim_mode(uint16_t operation)
{
	if (SPI_MODE_GET(operation) & SPI_MODE_CPOL) {
		if (SPI_MODE_GET(operation) & SPI_MODE_CPHA)
			return NRF_SPIM_MODE_3;
		else
			return NRF_SPIM_MODE_2;
	} else {
		if (SPI_MODE_GET(operation) & SPI_MODE_CPHA)
			return NRF_SPIM_MODE_1;
		else
			return NRF_SPIM_MODE_0;
	}
}

static inline nrf_spim_bit_order_t get_nrf_spim_bit_order(uint16_t operation)
{
	if (operation & SPI_TRANSFER_LSB)
		return NRF_SPIM_BIT_ORDER_LSB_FIRST;
	else
		return NRF_SPIM_BIT_ORDER_MSB_FIRST;
}

static int configure(const struct device *dev, const struct spi_config *spi_cfg)
{
	struct spi_context *ctx = &get_dev_data(dev)->ctx;
	const nrfx_spim_t *spim = &get_dev_config(dev)->spim;
	nrf_spim_frequency_t freq;

	if (spi_context_configured(ctx, spi_cfg))
		/* Already configured. No need to do it again. */
		return 0;

	if (SPI_OP_MODE_GET(spi_cfg->operation) != SPI_OP_MODE_MASTER) {
		LOG_ERR("Slave mode is not supported on %s", dev->name);
		return -EINVAL;
	}

	if (spi_cfg->operation & SPI_MODE_LOOP) {
		LOG_ERR("Loopback mode is not supported");
		return -EINVAL;
	}

	if ((spi_cfg->operation & SPI_LINES_MASK) != SPI_LINES_SINGLE) {
		LOG_ERR("Only single line mode is supported");
		return -EINVAL;
	}

	if (SPI_WORD_SIZE_GET(spi_cfg->operation) != 8) {
		LOG_ERR("Word sizes other than 8 bits are not supported");
		return -EINVAL;
	}

	if (spi_cfg->frequency < 125000) {
		LOG_ERR("Frequencies lower than 125 kHz are not supported");
		return -EINVAL;
	}

	ctx->config = spi_cfg;
	spi_context_cs_configure(ctx);

	/* Limit the frequency to that supported by the SPIM instance */
	freq = get_nrf_spim_frequency(MIN(spi_cfg->frequency, get_dev_config(dev)->max_freq));

	nrf_spim_configure(spim->p_reg, get_nrf_spim_mode(spi_cfg->operation),
			   get_nrf_spim_bit_order(spi_cfg->operation));

	nrf_spim_frequency_set(spim->p_reg, get_nrf_spim_frequency(spim_config->spimfreq));

	return 0;
}

static void transfer_next_chunk(const struct device *dev)
{
	struct spi_nrfx_data *dev_data = get_dev_data(dev);
	const struct spi_nrfx_config *dev_config = get_dev_config(dev);
	struct spi_context *ctx = &dev_data->ctx;
	int error = 0;

	size_t chunk_len = spi_context_max_continuous_chunk(ctx);

	if (chunk_len > 0) {
		nrfx_spim_xfer_desc_t xfer;
		nrfx_err_t result;
		const uint8_t *tx_buf = ctx->tx_buf;
#if (CONFIG_SPI_NRFX_RAM_BUFFER_SIZE > 0)
		if (spi_context_tx_buf_on(ctx) && !nrfx_is_in_ram(tx_buf)) {
			if (chunk_len > sizeof(dev_data->buffer))
				chunk_len = sizeof(dev_data->buffer);

			memcpy(dev_data->buffer, tx_buf, chunk_len);
			tx_buf = dev_data->buffer;
		}
#endif
		if (chunk_len > dev_config->max_chunk_len)
			chunk_len = dev_config->max_chunk_len;

		dev_data->chunk_len = chunk_len;

		xfer.p_tx_buffer = tx_buf;
		xfer.tx_length = spi_context_tx_buf_on(ctx) ? chunk_len : 0;
		xfer.p_rx_buffer = ctx->rx_buf;
		xfer.rx_length = spi_context_rx_buf_on(ctx) ? chunk_len : 0;

		/* This SPIM driver is only used by the NRF52832 if
		 * SOC_NRF52832_ALLOW_SPIM_DESPITE_PAN_58 is enabled
		 */
		if (IS_ENABLED(CONFIG_SOC_NRF52832) &&
		    (xfer.rx_length == 1 && xfer.tx_length <= 1)) {
			LOG_WRN("Transaction aborted since it would trigger nRF52832 PAN 58");
			error = -EIO;
		}

		if (!error) {
			result = nrfx_spim_xfer(&dev_config->spim, &xfer, 0);

			if (result == NRFX_SUCCESS)
				return;

			error = -EIO;
		}
	}

	spi_context_cs_control(ctx, false);

	LOG_DBG("Transaction finished with status %d", error);

	spi_context_complete(ctx, error);
	dev_data->busy = false;
}

static int transceive(const struct device *dev, const struct spi_config *spi_cfg,
		      const struct spi_buf_set *tx_bufs, const struct spi_buf_set *rx_bufs,
		      bool asynchronous, struct k_poll_signal *signal)
{
	struct spi_nrfx_data *dev_data = get_dev_data(dev);
	int error;

	spi_context_lock(&dev_data->ctx, asynchronous, signal, spi_cfg);

	error = configure(dev, spi_cfg);

	if (error == 0) {
		dev_data->busy = true;

		spi_context_buffers_setup(&dev_data->ctx, tx_bufs, rx_bufs, 1);
		spi_context_cs_control(&dev_data->ctx, true);

		transfer_next_chunk(dev);

		error = spi_context_wait_for_completion(&dev_data->ctx);
	}

	spi_context_release(&dev_data->ctx, error);

	return error;
}

static int spi_nrfx_transceive(const struct device *dev, const struct spi_config *spi_cfg,
			       const struct spi_buf_set *tx_bufs, const struct spi_buf_set *rx_bufs)
{
	return transceive(dev, spi_cfg, tx_bufs, rx_bufs, false, NULL);
}

#ifdef CONFIG_SPI_ASYNC
static int spi_nrfx_transceive_async(const struct device *dev, const struct spi_config *spi_cfg,
				     const struct spi_buf_set *tx_bufs,
				     const struct spi_buf_set *rx_bufs, struct k_poll_signal *async)
{
	return transceive(dev, spi_cfg, tx_bufs, rx_bufs, true, async);
}
#endif /* CONFIG_SPI_ASYNC */

static int spi_nrfx_release(const struct device *dev, const struct spi_config *spi_cfg)
{
	struct spi_nrfx_data *dev_data = get_dev_data(dev);

	if (!spi_context_configured(&dev_data->ctx, spi_cfg))
		return -EINVAL;

	if (dev_data->busy)
		return -EBUSY;

	spi_context_unlock_unconditionally(&dev_data->ctx);

	return 0;
}

static const struct spi_driver_api spi_nrfx_driver_api = {
	.transceive = spi_nrfx_transceive,
#ifdef CONFIG_SPI_ASYNC
	.transceive_async = spi_nrfx_transceive_async,
#endif
	.release = spi_nrfx_release,
};

static void event_handler(const nrfx_spim_evt_t *p_event, void *p_context)
{
	struct spi_nrfx_data *dev_data = p_context;

	if (p_event->type == NRFX_SPIM_EVENT_DONE) {
		spi_context_update_tx(&dev_data->ctx, 1, dev_data->chunk_len);
		spi_context_update_rx(&dev_data->ctx, 1, dev_data->chunk_len);

		transfer_next_chunk(dev_data->dev);
	}
}

static int init_spim(const struct device *dev)
{
	struct spi_nrfx_data *data = get_dev_data(dev);
	nrfx_err_t result;

	data->dev = dev;

	/* This sets only default values of frequency, mode and bit order.
	 * The proper ones are set in configure() when a transfer is started.
	 */
	result = nrfx_spim_init(&get_dev_config(dev)->spim, &get_dev_config(dev)->config,
				event_handler, data);
	if (result != NRFX_SUCCESS) {
		LOG_ERR("Failed to initialize device: %s", dev->name);
		return -EBUSY;
	}

#ifdef CONFIG_PM_DEVICE
	data->pm_state = PM_DEVICE_STATE_ACTIVE;
	get_dev_data(dev)->pm_state = PM_DEVICE_STATE_ACTIVE;
#endif

	return 0;
}

#ifdef CONFIG_PM_DEVICE
static int spim_nrfx_pm_control(const struct device *dev, uint32_t ctrl_command, uint32_t *state,
				pm_device_cb cb, void *arg)
{
	int ret = 0;
	struct spi_nrfx_data *data = get_dev_data(dev);
	const struct spi_nrfx_config *config = get_dev_config(dev);

	if (ctrl_command == PM_DEVICE_STATE_SET) {
		uint32_t new_state = *state;

		if (new_state != data->pm_state) {
			switch (new_state) {
			case PM_DEVICE_STATE_ACTIVE:
				ret = init_spim(dev);
				/* Force reconfiguration before next transfer */
				data->ctx.config = NULL;
				break;

			case PM_DEVICE_STATE_LOW_POWER:
			case PM_DEVICE_STATE_SUSPEND:
			case PM_DEVICE_STATE_OFF:
				if (data->pm_state == PM_DEVICE_STATE_ACTIVE)
					nrfx_spim_uninit(&config->spim);

				break;

			default:
				ret = -ENOTSUP;
			}

			if (!ret)
				data->pm_state = new_state;
		}
	} else {
		__ASSERT_NO_MSG(ctrl_command == PM_DEVICE_STATE_GET);
		*state = data->pm_state;
	}

	if (cb)
		cb(dev, ret, state, arg);

	return ret;
}
#endif /* CONFIG_PM_DEVICE */

/*
 * We use NODELABEL here because the nrfx API requires us to call
 * functions which are named according to SoC peripheral instance
 * being operated on. Since DT_INST() makes no guarantees about that,
 * it won't work.
 */
#define SPIM(idx) DT_NODELABEL(spi##idx)
#define SPIM_PROP(idx, prop) DT_PROP(SPIM(idx), prop)

#define SPIM_NRFX_MISO_PULL_DOWN(idx) DT_PROP(SPIM(idx), miso_pull_down)
#define SPIM_NRFX_MISO_PULL_UP(idx) DT_PROP(SPIM(idx), miso_pull_up)

#define SPIM_NRFX_MISO_PULL(idx)                                                                   \
	(SPIM_NRFX_MISO_PULL_UP(idx)   ? SPIM_NRFX_MISO_PULL_DOWN(idx) ?                           \
					 -1 /* invalid configuration */                            \
					 :                                                         \
					 NRF_GPIO_PIN_PULLUP :                                     \
	 SPIM_NRFX_MISO_PULL_DOWN(idx) ? NRF_GPIO_PIN_PULLDOWN :                                   \
					 NRF_GPIO_PIN_NOPULL)

#define SPI_NRFX_SPIM_EXTENDED_CONFIG(idx)                                                         \
	IF_ENABLED(NRFX_SPIM_EXTENDED_ENABLED,                                                     \
		   (.dcx_pin = NRFX_SPIM_PIN_NOT_USED,                                             \
		    IF_ENABLED(SPIM##idx##_FEATURE_RXDELAY_PRESENT,                                \
			       (.rx_delay = CONFIG_SPI_##idx##_NRF_RX_DELAY,))))

#define SPI_NRFX_SPIM_DEVICE(idx)                                                                  \
	BUILD_ASSERT(!SPIM_NRFX_MISO_PULL_UP(idx) || !SPIM_NRFX_MISO_PULL_DOWN(idx),               \
		     "SPIM" #idx ": cannot enable both pull-up and pull-down on MISO line");       \
	static int spi_##idx##_init(const struct device *dev)                                      \
	{                                                                                          \
		IRQ_CONNECT(NRFX_IRQ_NUMBER_GET(NRF_SPIM##idx), DT_IRQ(SPIM(idx), priority),       \
			    nrfx_isr, nrfx_spim_##idx##_irq_handler, 0);                           \
		int err = init_spim(dev);                                                          \
		spi_context_unlock_unconditionally(&get_dev_data(dev)->ctx);                       \
		return err;                                                                        \
	}                                                                                          \
	static struct spi_nrfx_data spi_##idx##_data = {                                           \
		SPI_CONTEXT_INIT_LOCK(spi_##idx##_data, ctx),                                      \
		SPI_CONTEXT_INIT_SYNC(spi_##idx##_data, ctx),                                      \
		.busy = false,                                                                     \
	};                                                                                         \
	static const struct spi_nrfx_config spi_##idx##z_config = {                                \
		.spim = NRFX_SPIM_INSTANCE(idx),                                                   \
		.max_chunk_len = (1 << SPIM##idx##_EASYDMA_MAXCNT_SIZE) - 1,                       \
		.max_freq = SPIM##idx##_MAX_DATARATE * 1000000,                                    \
		.config = { .sck_pin = SPIM_PROP(idx, sck_pin),                                    \
			    .mosi_pin = SPIM_PROP(idx, mosi_pin),                                  \
			    .miso_pin = SPIM_PROP(idx, miso_pin),                                  \
			    .ss_pin = 0x2c,                                                        \
			    .orc = CONFIG_SPI_##idx##_NRF_ORC,                                     \
			    .frequency = NRF_SPIM_FREQ_4M,                                         \
			    .mode = NRF_SPIM_MODE_0,                                               \
			    .bit_order = NRF_SPIM_BIT_ORDER_MSB_FIRST,                             \
			    .miso_pull = SPIM_NRFX_MISO_PULL(idx),                                 \
			    SPI_NRFX_SPIM_EXTENDED_CONFIG(idx) }                                   \
	};                                                                                         \
	DEVICE_DT_DEFINE(SPIM(idx), spi_##idx##_init, spim_nrfx_pm_control, &spi_##idx##_data,     \
			 &spi_##idx##z_config, POST_KERNEL, CONFIG_SPI_INIT_PRIORITY,              \
			 &spi_nrfx_driver_api)

#ifdef CONFIG_SPI_0_NRF_SPIM
SPI_NRFX_SPIM_DEVICE(0);
#endif

#ifdef CONFIG_SPI_1_NRF_SPIM
SPI_NRFX_SPIM_DEVICE(1);
#endif

#ifdef CONFIG_SPI_2_NRF_SPIM
SPI_NRFX_SPIM_DEVICE(2);
#endif

#ifdef CONFIG_SPI_3_NRF_SPIM
SPI_NRFX_SPIM_DEVICE(3);
#endif

#ifdef CONFIG_SPI_4_NRF_SPIM
SPI_NRFX_SPIM_DEVICE(4);
#endif

const struct device *spim_perip_get(void)
{
	const struct device *spi_perip;

#ifdef CONFIG_BOARD_NRF52840DK_NRF52840
	spi_perip = device_get_binding("SPI_3");
#elif CONFIG_BOARD_NRF5340DK_NRF5340_CPUAPP
	spi_perip = device_get_binding("SPI_4");
#endif

	if (spi_perip == NULL) {
		printk("Could not get SPI device\n");
		return NULL;
	}

	printk("%p : got device\n", spi_perip);

	return spi_perip;
}

unsigned int spim_xfer_tx(const struct device *spi_perip, const struct spi_config *spi_cfg,
			  unsigned int addr, const void *data, unsigned int len)
{
	int err;
	static uint8_t *tx_buffer;

	tx_buffer = (uint8_t *)(k_malloc(4 + len));

	const struct spi_buf tx_buf = { .buf = tx_buffer, .len = 4 + len };
	const struct spi_buf_set tx = { .buffers = &tx_buf, .count = 1 };

	/* PP opcode : 0x02 */
	tx_buffer[0] = 0x02;

	/* addr */
	tx_buffer[1] = (((addr >> 16) & 0xFF) | 0x80);
	tx_buffer[2] = (addr >> 8) & 0xFF;
	tx_buffer[3] = addr & 0xFF;

	/* data */
	memcpy(tx_buffer + 4, data, len);

	err = spi_transceive(spi_perip, spi_cfg, &tx, NULL);

	k_free(tx_buffer);

	return err;
}

unsigned int spim_xfer_rx(const struct device *spi_perip, const struct spi_config *spi_cfg,
			  unsigned int addr, void *data, unsigned int len)
{
	int err;
	int dummy = 5;
	uint8_t *tx_buffer = NULL;
	uint8_t *rx_buffer = NULL;

	tx_buffer = (uint8_t *)(k_malloc(dummy + len));

	if (tx_buffer == NULL) {
		printk("SPI error:NO MEMORY for tx_buffer\n");
		return -ENOMEM;
	}

	rx_buffer = (uint8_t *)(k_malloc(dummy + len));

	if (rx_buffer == NULL) {
		printk("SPI error:NO MEMORY rx_buffer\n");
		k_free(tx_buffer);
		return -ENOMEM;
	}

	memset(tx_buffer, 0, len + dummy);
	memset(rx_buffer, 0, len + dummy);

	const struct spi_buf tx_buf = { .buf = tx_buffer, .len = (len + dummy) };
	const struct spi_buf_set tx = { .buffers = &tx_buf, .count = 1 };

	struct spi_buf rx_buf = {
		.buf = rx_buffer,
		.len = (len + dummy),
	};
	const struct spi_buf_set rx = { .buffers = &rx_buf, .count = 1 };

	/* FASTREAD opcode : 0x0b */

	tx_buffer[0] = 0x0b;
	tx_buffer[1] = (addr >> 16) & 0xFF;
	tx_buffer[2] = (addr >> 8) & 0xFF;
	tx_buffer[3] = addr & 0xFF;

	err = spi_transceive(spi_perip, spi_cfg, &tx, &rx);
	memcpy(data, rx_buffer + dummy, len);

	if (err)
		printk("SPI error: %d\n", err);

	k_free(tx_buffer);
	k_free(rx_buffer);

	return err;
}

unsigned int spim_wait_while_rpu_awake(const struct device *spi_perip,
				       const struct spi_config *spi_cfg)
{
	int err, len;
	static uint8_t tx_buffer[6] = { 0x1f };

	len = sizeof(tx_buffer);

	const struct spi_buf tx_buf = { .buf = tx_buffer, .len = len };
	const struct spi_buf_set tx = { .buffers = &tx_buf, .count = 1 };

	uint8_t sr[6];

	struct spi_buf rx_buf = {
		.buf = &sr,
		.len = sizeof(sr),
	};
	const struct spi_buf_set rx = { .buffers = &rx_buf, .count = 1 };

	for (int ii = 0; ii < 10; ii++) {
		err = spi_transceive(spi_perip, spi_cfg, &tx, &rx);

		printk("%x %x %x %x %x %x\n", sr[0], sr[1], sr[2], sr[3], sr[4], sr[5]);

		if ((err < 0) || ((sr[1] & RPU_AWAKE_BIT) == 0)) {
			printk("ret val = 0x%x\t RDSR1 = 0x%x --- FAILED RPU Wakeup\n", err, sr[1]);
		} else {
			printk("ret val = 0x%x\t RDSR1 = 0x%x -- RPU Awake!!\n", err, sr[1]);
			break;
		}
		k_msleep(1);
	}

	return 0;
}

/* Wait until RDSR2 confirms RPU_WAKE write is successful */
unsigned int spim_validate_rpu_awake(const struct device *spi_perip,
				     const struct spi_config *spi_cfg)
{
	int err, len;
	static uint8_t tx_buffer[6] = { 0x2f };

	len = sizeof(tx_buffer);

	const struct spi_buf tx_buf = { .buf = tx_buffer, .len = len };
	const struct spi_buf_set tx = { .buffers = &tx_buf, .count = 1 };

	uint8_t sr[6];

	struct spi_buf rx_buf = {
		.buf = &sr,
		.len = sizeof(sr),
	};
	const struct spi_buf_set rx = { .buffers = &rx_buf, .count = 1 };

	for (int ii = 0; ii < 1; ii++) {
		err = spi_transceive(spi_perip, spi_cfg, &tx, &rx);

		printk("%x %x %x %x %x %x\n", sr[0], sr[1], sr[2], sr[3], sr[4], sr[5]);

		if ((err < 0) || ((sr[1] & RPU_AWAKE_BIT) == 0)) {
			printk("RDSR2 = 0x%x\n", sr[1]);
		} else {
			printk("RDSR2 = 0x%x\n", sr[1]);
			break;
		}
		/* k_msleep(1); */
	}

	return 0;
}

unsigned int spim_cmd_rpu_wakeup(const struct device *spi_perip, const struct spi_config *spi_cfg,
				 uint32_t data)
{
	int err, len;
	static uint8_t tx_buffer[] = { 0x3f, 0x1 };

	tx_buffer[1] = data & 0xff;

	/* printf("TODO : %s:\n", __func__); */

	len = sizeof(tx_buffer);

	const struct spi_buf tx_buf = { .buf = tx_buffer, .len = len };
	const struct spi_buf_set tx = { .buffers = &tx_buf, .count = 1 };

	err = spi_transceive(spi_perip, spi_cfg, &tx, NULL);

	if (err) {
		printk("SPI error: %d\n", err);
	} else {
		/* Connect MISO to MOSI for loopback */
		/* printk("TX sent: %x\n", tx_buffer[0]); */
	}

	return 0;
}

unsigned int spim_cmd_sleep_rpu(const struct device *spi_perip, const struct spi_config *spi_cfg)
{
	int err, len;
	static uint8_t tx_buffer[] = { 0x3f, 0x0 };

	/* printf("TODO : %s:\n", __func__); */

	len = sizeof(tx_buffer);

	const struct spi_buf tx_buf = { .buf = tx_buffer, .len = len };
	const struct spi_buf_set tx = { .buffers = &tx_buf, .count = 1 };

	err = spi_transceive(spi_perip, spi_cfg, &tx, NULL);

	if (err) {
		printk("SPI error: %d\n", err);
	} else {
		/* Connect MISO to MOSI for loopback */
		/* printk("TX sent: %x\n", tx_buffer[0]); */
	}

	return 0;
}
static const struct spi_config spi_cfg = {
	.operation = SPI_WORD_SET(8) | SPI_TRANSFER_MSB,
	.frequency = 8000000,
	.slave = 0,
};

const struct device *spim_perip;

int spim_init(struct qspi_config *config)
{
	spim_perip = spim_perip_get();

	spim_config = config;

#ifdef CONFIG_BOARD_NRF5340DK_NRF5340_CPUAPP
	/* SPIM4 (<32Mbps)  : 1Mbps -> 1Mhz */
	config->spimfreq = config->freq * 1000000;
#endif
#ifdef CONFIG_BOARD_NRF52840DK_NRF52840
	/* SPIM3 (<8Mbps): 1Mbps -> 1Mhz */
	config->spimfreq = config->freq * 1000000;
#endif

	printk("sck pin = 0x%08x\n", spi_4z_config.config.sck_pin);
	printk("mosi pin = 0x%08x\n", spi_4z_config.config.mosi_pin);
	printk("miso pin = 0x%08x\n", spi_4z_config.config.miso_pin);
	printk("ss pin = 0x%08x\n", spi_4z_config.config.ss_pin);

	k_sem_init(&spim_config->lock, 1, 1);

	return 0;
}

void spim_addr_check(unsigned int addr, const void *data, unsigned int len)
{
	if ((addr % 4 != 0) || (((unsigned int)data) % 4 != 0) || (len % 4 != 0)) {
		printk("%s : Unaligned address %x %x %d %x %x\n", __func__, addr,
		       (unsigned int)data, (addr % 4 != 0), (((unsigned int)data) % 4 != 0),
		       (len % 4 != 0));
	}
}

int spim_write(unsigned int addr, const void *data, int len)
{
	int status;

	spim_addr_check(addr, data, len);

	addr |= spim_config->addrmask;

	k_sem_take(&spim_config->lock, K_FOREVER);

	status = spim_xfer_tx(spim_perip, &spi_cfg, addr, data, len);

	k_sem_give(&spim_config->lock);

	return status;
}

int spim_read(unsigned int addr, void *data, int len)
{
	int status;

	spim_addr_check(addr, data, len);

	addr |= spim_config->addrmask;

	k_sem_take(&spim_config->lock, K_FOREVER);

	status = spim_xfer_rx(spim_perip, &spi_cfg, addr, data, len);

	k_sem_give(&spim_config->lock);

	return status;
}

int spim_hl_readw(unsigned int addr, void *data)
{
	uint8_t *rxb = NULL;
	int status = -1;
	int len = 4;

	len = len + (4 * spim_config->qspi_slave_latency);

	rxb = k_malloc(len);

	if (rxb == NULL) {
		printk("%s: ERROR ENOMEM line %d\n", __func__, __LINE__);
		return -ENOMEM;
	}
	memset(rxb, 0, len);

	k_sem_take(&spim_config->lock, K_FOREVER);

	status = spim_xfer_rx(spim_perip, &spi_cfg, addr, rxb, len);

	k_sem_give(&spim_config->lock);

	*(uint32_t *)data = *(uint32_t *)(rxb + (len - 4));

	k_free(rxb);

	return status;
}

int spim_hl_read(unsigned int addr, void *data, int len)
{
	int count = 0;

	spim_addr_check(addr, data, len);

	while (count < (len / 4)) {
		spim_hl_readw(addr + (4 * count), (char *)data + (4 * count));
		count++;
	}

	return 0;
}

/* ------------------------------added for wifi utils -------------------------------- */

void spim_cmd_rpu_wakeup_fn(const struct device *spi_perip, uint32_t data)
{
	spim_cmd_rpu_wakeup(spim_perip, &spi_cfg, data);
}

void spim_cmd_sleep_rpu_fn(const struct device *spi_perip)
{
	spim_cmd_sleep_rpu(spim_perip, &spi_cfg);
}

void spim_wait_while_rpu_awake_fn(const struct device *spi_perip)
{
	spim_wait_while_rpu_awake(spim_perip, &spi_cfg);
}

void spim_validate_rpu_awake_fn(const struct device *spi_perip)
{
	spim_validate_rpu_awake(spim_perip, &spi_cfg);
}
```

## src/spi_if.h
```c
/*
 * Copyright (c) 2022 Nordic Semiconductor ASA
 *
 * SPDX-License-Identifier: LicenseRef-Nordic-5-Clause
 */

/**
 * @brief Header containing SPI device interface specific declarations for the
 * Zephyr OS layer of the Wi-Fi driver.
 */

/* SPIM driver config */

#ifdef CONFIG_BOARD_NRF52840DK_NRF52840

#define CONFIG_SPI_3_NRF_SPIM 1
#define CONFIG_SPI_3_NRF_ORC 0xff
#define CONFIG_SPI_3_NRF_RX_DELAY 2

#elif CONFIG_BOARD_NRF5340DK_NRF5340_CPUAPP

#define CONFIG_SPI_4_NRF_SPIM 1
#define CONFIG_SPI_4_NRF_ORC 0xff
#define CONFIG_SPI_4_NRF_RX_DELAY 2
#define CONFIG_SPI_INIT_PRIORITY 70
#define CONFIG_SPI_NRFX_RAM_BUFFER_SIZE 8

#endif

#define CONFIG_SPI_INIT_PRIORITY 70
#define CONFIG_SPI_NRFX_RAM_BUFFER_SIZE 8

#define QSPI_NODE DT_NODELABEL(qspi)
#define QSPI_PROP_AT(prop, idx) DT_PROP_BY_IDX(QSPI_NODE, prop, idx)

int spim_init(struct qspi_config *config);

int spim_write(unsigned int addr, const void *data, int len);

int spim_read(unsigned int addr, void *data, int len);

int spim_hl_read(unsigned int addr, void *data, int len);

extern const struct device *spim_perip;

void spim_cmd_rpu_wakeup_fn(const struct device *spi_perip, uint32_t data);

void spim_wait_while_rpu_awake_fn(const struct device *spi_perip);

void spim_validate_rpu_awake_fn(const struct device *spi_perip);

void spim_cmd_sleep_rpu_fn(const struct device *spi_perip);
```

## src/spi_nor.h
```c
/*
 * Copyright (c) 2022 Nordic Semiconductor ASA
 *
 * SPDX-License-Identifier: LicenseRef-Nordic-5-Clause
 */

/**
 * @brief Header containing SPI device specific declarations for the
 * Zephyr OS layer of the Wi-Fi driver.
 */

#ifndef __SPI_NOR_H__
#define __SPI_NOR_H__

#include <sys/util.h>

#define SPI_NOR_MAX_ID_LEN	3

/* Status register bits */
#define SPI_NOR_WIP_BIT         BIT(0)  /* Write in progress */
#define SPI_NOR_WEL_BIT         BIT(1)  /* Write enable latch */

/* Flash opcodes */
#define SPI_NOR_CMD_WRSR        0x01    /* Write status register */
#define SPI_NOR_CMD_RDSR        0x05    /* Read status register */
#define SPI_NOR_CMD_READ        0x03    /* Read data */
#define SPI_NOR_CMD_WREN        0x06    /* Write enable */
#define SPI_NOR_CMD_WRDI        0x04    /* Write disable */
#define SPI_NOR_CMD_PP          0x02    /* Page program */
#define SPI_NOR_CMD_SE          0x20    /* Sector erase */
#define SPI_NOR_CMD_BE_32K      0x52    /* Block erase 32KB */
#define SPI_NOR_CMD_BE          0xD8    /* Block erase */
#define SPI_NOR_CMD_CE          0xC7    /* Chip erase */
#define SPI_NOR_CMD_RDID        0x9F    /* Read JEDEC ID */
#define SPI_NOR_CMD_ULBPR       0x98    /* Global Block Protection Unlock */
#define SPI_NOR_CMD_4BA         0xB7    /* Enter 4-Byte Address Mode */
#define SPI_NOR_CMD_DPD         0xB9    /* Deep Power Down */
#define SPI_NOR_CMD_RDPD        0xAB    /* Release from Deep Power Down */

/* Page, sector, and block size are standard, not configurable. */
#define SPI_NOR_PAGE_SIZE    0x0100U
#define SPI_NOR_SECTOR_SIZE  0x1000U
#define SPI_NOR_BLOCK_SIZE   0x10000U

/* Test whether offset is aligned to a given number of bits. */
#define SPI_NOR_IS_ALIGNED(_ofs, _bits) (((_ofs) & BIT_MASK(_bits)) == 0)
#define SPI_NOR_IS_SECTOR_ALIGNED(_ofs) SPI_NOR_IS_ALIGNED(_ofs, 12)

#endif /*__SPI_NOR_H__*/
```
