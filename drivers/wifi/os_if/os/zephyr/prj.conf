## CMakeLists.txt
```
#
# Copyright (c) 2022 Nordic Semiconductor ASA
#
# SPDX-License-Identifier: LicenseRef-Nordic-5-Clause
#

zephyr_library_compile_definitions(
	KERNEL_VERSION_5_4
	SOC_CALDER
	RPU_SUPPORT_WAPI
	RPU_VHT_SUPPORT
	RPU_HE_SUPPORT
	RPU_BSS_DB_SUPPORT
	RPU_32_BIT_DMA_SUPPORT
	RPU_CONFIG_FMAC
	REG_MODE_SUPPORT
	REG_DEBUG_MODE_SUPPORT
	OFFLINE_MODE
	#FW_PATCH_INBUILT
)

zephyr_library_include_directories(
	../../../os_if/os/zephyr/inc
	../../../utils/inc
	../../../os_if/osal/inc
	../../../bus_if/bus/qspi/inc
	../../../bus_if/bal/inc
	../../../fw_if/umac_if/inc
	../../../fw_if/umac_if/inc/fw
	../../../fw_load/mips/fw/inc
	../../../hw_if/hal/inc
	../../../hw_if/hal/inc/fw
	./src/qspi/src/
	../../../../supplicant/wpa_supplicant_zephyr/src/wpa_supplicant/src/drivers/
)

file(GLOB OSAL_IF_SRC "../../../os_if/osal/src/*.c")
file(GLOB UTILS_IF_SRC "../../../utils/src/*.c")
file(GLOB HW_IF_SRC "../../../hw_if/hal/src/*.c")
file(GLOB BUS_IF_BAL "../../../bus_if/bal/src/*.c")
file(GLOB BUS_IF_SRC "../../../bus_if/bus/qspi/src/*.c")
file(GLOB FW_IF_SRC "../../../fw_if/umac_if/src/*.c")
file(GLOB OS_IF_SRC "src/*.c")
file(GLOB QSPI_IF_SRC "src/qspi/src/*.c")

list(FILTER QSPI_IF_SRC EXCLUDE REGEX ".*main.c$")

zephyr_library_sources(
	${OSAL_IF_SRC}
	${UTILS_IF_SRC}
	${HW_IF_SRC}
	${BUS_IF_BAL}
	${BUS_IF_SRC}
	${FW_IF_SRC}
	${OS_IF_SRC}
	${QSPI_IF_SRC}
)
```

## Kconfig
```
# Nordic WiFi driver for nRF52840 and nRF5340
#
# Copyright (c) 2022 Nordic Semiconductor
#
# SPDX-License-Identifier: LicenseRef-Nordic-5-Clause
#

menuconfig NVLSI_WIFI
        bool "Nordic WiFi driver"
	default n
        help
          Nordic Wifi Driver
```

## prj.conf
```kconfig
# POSIX
CONFIG_POSIX_API=y
CONFIG_POSIX_CLOCK=y

# QSPI
CONFIG_FLASH=y
CONFIG_NRFX_QSPI=y
CONFIG_HEAP_MEM_POOL_SIZE=200000

# SPIM
CONFIG_NRFX_SPIM=y
CONFIG_NRFX_SPIM3=y
CONFIG_NRFX_SPIM4=y

# WIFI

CONFIG_NETWORKING=y
CONFIG_TEST_RANDOM_GENERATOR=y

CONFIG_NET_TX_STACK_SIZE=2048
CONFIG_NET_RX_STACK_SIZE=2048

CONFIG_NET_PKT_RX_COUNT=10
CONFIG_NET_PKT_TX_COUNT=10
CONFIG_NET_BUF_RX_COUNT=20
CONFIG_NET_BUF_TX_COUNT=20
CONFIG_NET_MAX_CONTEXTS=10

CONFIG_NET_IPV4=y
CONFIG_NET_IPV6=n

CONFIG_NET_LOG=y
CONFIG_INIT_STACKS=y

CONFIG_NET_SHELL=y

CONFIG_NET_STATISTICS=y
CONFIG_NET_STATISTICS_PERIODIC_OUTPUT=n

CONFIG_WIFI=y
CONFIG_WIFI_LOG_LEVEL_ERR=y
CONFIG_NET_L2_WIFI_SHELL=y

# SDK 1.6.1
# CONFIG_NET_TCP=y      # error on warnings
CONFIG_USE_SEGGER_RTT=n # compilation error

# Ethernet
CONFIG_NETWORKING=y
CONFIG_NET_UDP=y
CONFIG_NET_TCP=y
CONFIG_NET_IPV6=y
CONFIG_NET_IPV4=y
#CONFIG_NET_DHCPV4=y

CONFIG_ENTROPY_GENERATOR=y
CONFIG_TEST_RANDOM_GENERATOR=y
CONFIG_INIT_STACKS=y

CONFIG_NET_LOG=y
CONFIG_LOG=y

CONFIG_NET_STATISTICS=y

CONFIG_NET_PKT_RX_COUNT=32
CONFIG_NET_PKT_TX_COUNT=32
CONFIG_NET_BUF_RX_COUNT=32
CONFIG_NET_BUF_TX_COUNT=32

CONFIG_NET_IF_UNICAST_IPV6_ADDR_COUNT=3
CONFIG_NET_IF_MCAST_IPV6_ADDR_COUNT=4
CONFIG_NET_MAX_CONTEXTS=10

CONFIG_NET_SHELL=y

CONFIG_NET_CONFIG_SETTINGS=y
CONFIG_NET_CONFIG_NEED_IPV6=y
CONFIG_NET_CONFIG_NEED_IPV4=y
CONFIG_NET_CONFIG_MY_IPV6_ADDR="2001:db8::1"
CONFIG_NET_CONFIG_PEER_IPV6_ADDR="2001:db8::2"
CONFIG_NET_CONFIG_MY_IPV4_ADDR="192.168.1.98"
CONFIG_NET_CONFIG_PEER_IPV4_ADDR="192.168.1.99"

CONFIG_NET_L2_ETHERNET=y

CONFIG_ETH_NATIVE_POSIX=y
CONFIG_ETH_NATIVE_POSIX_RANDOM_MAC=y
#CONFIG_ETH_NATIVE_POSIX_MAC_ADDR="00:00:5e:00:53:2a"

#CONFIG_NET_BUF_DATA_SIZE=1600
```

## inc/zephyr_disp_scan.h
```c
/*
 * Copyright (c) 2022 Nordic Semiconductor ASA
 *
 * SPDX-License-Identifier: LicenseRef-Nordic-5-Clause
 */

/**
 * @brief Header containing display scan specific declarations for the
 * Zephyr OS layer of the Wi-Fi driver.
 */

#ifndef __ZEPHYR_DISP_SCAN_H__
#define __ZEPHYR_DISP_SCAN_H__

#include <device.h>
#include <net/wifi_mgmt.h>
#include "osal_api.h"

int wifi_nrf_disp_scan_zep(const struct device *dev,
			scan_result_cb_t cb);

enum wifi_nrf_status wifi_nrf_disp_scan_res_get_zep(struct wifi_nrf_vif_ctx_zep *vif_ctx_zep);

void wifi_nrf_event_proc_disp_scan_res_zep(void *vif_ctx,
					struct img_umac_event_new_scan_display_results *scan_res,
					bool is_last);
#endif /*  __ZEPHYR_DISP_SCAN_H__ */
```

## inc/zephyr_fmac_main.h
```c
/*
 * Copyright (c) 2022 Nordic Semiconductor ASA
 *
 * SPDX-License-Identifier: LicenseRef-Nordic-5-Clause
 */

/**
 * @brief Header containing FMAC interface specific declarations for the
 * Zephyr OS layer of the Wi-Fi driver.
 */

#ifndef __ZEPHYR_FMAC_MAIN_H__
#define __ZEPHYR_FMAC_MAIN_H__

#include <zephyr.h>
#include <stdio.h>
#include <net/wifi_mgmt.h>
#include "drivers/driver_zephyr.h"
#include "fmac_api.h"
#include "host_rpu_umac_if.h"

struct wifi_nrf_vif_ctx_zep {
	const struct device *zep_dev_ctx;
	struct net_if *zep_net_if_ctx;
	void *supp_drv_if_ctx;
	void *rpu_ctx_zep;
	unsigned char vif_idx;

	struct zep_wpa_supp_dev_callbk_fns supp_callbk_fns;
	scan_result_cb_t disp_scan_cb;
	bool scan_in_progress;
	int scan_type;

	unsigned int assoc_freq;
	enum wifi_nrf_fmac_if_state if_state;
};


struct wifi_nrf_vif_ctx_map {
        const char *ifname;
        struct wifi_nrf_vif_ctx_zep *vif_ctx;
};

struct wifi_nrf_ctx_zep {
	void *drv_priv_zep;
	void *rpu_ctx;
	struct wifi_nrf_vif_ctx_zep vif_ctx_zep[MAX_NUM_VIFS];
	struct net_eth_addr mac_addr;
};

struct wifi_nrf_drv_priv_zep {
	struct wifi_nrf_fmac_priv *fmac_priv;
	/* TODO: Replace with a linked list to handle unlimited RPUs */
	struct wifi_nrf_ctx_zep rpu_ctx_zep;
};
#endif /* __ZEPHYR_FMAC_MAIN_H__ */
```

## inc/zephyr_net_if.h
```c
/*
 * Copyright (c) 2022 Nordic Semiconductor ASA
 *
 * SPDX-License-Identifier: LicenseRef-Nordic-5-Clause
 */

/**
 * @brief Header containing network stack interface specific declarations for
 * the Zephyr OS layer of the Wi-Fi driver.
 */

#ifndef __ZEPHYR_NET_IF_H__
#define __ZEPHYR_NET_IF_H__
#include <device.h>
#include <net/net_pkt.h>
#include <net/net_if.h>
#include <net/ethernet.h>


void wifi_nrf_if_init(struct net_if *iface);
enum ethernet_hw_caps wifi_nrf_if_caps_get(const struct device *dev);
int wifi_nrf_if_send(const struct device *dev,
		  struct net_pkt *pkt);

void wifi_nrf_if_rx_frm(void *os_vif_ctx, void *frm);

enum wifi_nrf_status wifi_nrf_if_state_chg(
		void *os_vif_ctx,
		enum wifi_nrf_fmac_if_state if_state);

#endif /* __ZEPHYR_NET_IF_H__ */
```

## inc/zephyr_wpa_supp_if.h
```c
/*
 * Copyright (c) 2022 Nordic Semiconductor ASA
 *
 * SPDX-License-Identifier: LicenseRef-Nordic-5-Clause
 */

/**
 * @brief Header containing WPA supplicant interface specific declarations for
 * the Zephyr OS layer of the Wi-Fi driver.
 */

#ifndef __ZEPHYR_WPA_SUPP_IF_H__
#define __ZEPHYR_WPA_SUPP_IF_H__

void *wifi_nrf_wpa_supp_dev_init(void *supp_drv_if_ctx, const char *iface_name,
				 struct zep_wpa_supp_dev_callbk_fns *supp_callbk_fns);

void wifi_nrf_wpa_supp_dev_deinit(void *if_priv);

int wifi_nrf_wpa_supp_scan2(void *if_priv, struct wpa_driver_scan_params *params);

int wifi_nrf_wpa_supp_scan_abort(void *if_priv);

int wifi_nrf_wpa_supp_scan_results_get(void *if_priv);

int wifi_nrf_wpa_supp_deauthenticate(void *if_priv, const char *addr, unsigned short reason_code);

int wifi_nrf_wpa_supp_authenticate(void *if_priv, struct wpa_driver_auth_params *params);

int wifi_nrf_wpa_supp_associate(void *if_priv, struct wpa_driver_associate_params *params);

int wifi_nrf_wpa_set_supp_port(void *if_priv, int authorized, char *bssid);

int wifi_nrf_wpa_supp_set_key(void *if_priv, const unsigned char *ifname, enum wpa_alg alg,
			      const unsigned char *addr, int key_idx, int set_tx,
			      const unsigned char *seq, size_t seq_len, const unsigned char *key,
			      size_t key_len);

void wifi_nrf_wpa_supp_event_proc_scan_start(void *if_priv);

void wifi_nrf_wpa_supp_event_proc_scan_done(void *if_priv,
					    struct img_umac_event_trigger_scan *scan_done_event,
					    int aborted);

void wifi_nrf_wpa_supp_event_proc_scan_res(void *if_priv,
					   struct img_umac_event_new_scan_results *scan_res,
					   bool more_res);

void wifi_nrf_wpa_supp_event_proc_auth_resp(void *if_priv, struct img_umac_event_mlme *auth_resp);

void wifi_nrf_wpa_supp_event_proc_assoc_resp(void *if_priv, struct img_umac_event_mlme *assoc_resp);

void wifi_nrf_wpa_supp_event_proc_deauth(void *if_priv, struct img_umac_event_mlme *deauth);

void wifi_nrf_wpa_supp_event_proc_disassoc(void *if_priv, struct img_umac_event_mlme *disassoc);
#endif /*  __ZEPHYR_WPA_SUPP_IF_H__ */
```

## src/shim.c
```c
/*
 * Copyright (c) 2022 Nordic Semiconductor ASA
 *
 * SPDX-License-Identifier: LicenseRef-Nordic-5-Clause
 */

/**
 * @brief Header containing OS specific definitions for the
 * Zephyr OS layer of the Wi-Fi driver.
 */

#include <zephyr.h>
#include <sys/printk.h>
#include <drivers/gpio.h>
#include <stdio.h>
#include <string.h>

#include <sys/time.h>
#include "shim.h"

#include "tasklet.h"
#include "timer.h"

#include "osal_ops.h"

#include "qspi_if.h"

#include <logging/log.h>

LOG_MODULE_DECLARE(wifi_nrf, CONFIG_WIFI_NRF_LOG_LEVEL);

static void *zep_shim_mem_alloc(size_t size)
{
	size = (size + 4) & 0xfffffffc;
	return k_malloc(size);
}

static void *zep_shim_mem_zalloc(size_t size)
{
	size = (size + 4) & 0xfffffffc;
	return k_calloc(size, sizeof(char));
}

static void *zep_shim_mem_cpy(void *dest, const void *src, size_t count)
{
	return memcpy(dest, src, count);
}

static void *zep_shim_mem_set(void *start, int val, size_t size)
{
	return memset(start, val, size);
}

static unsigned int zep_shim_qspi_read_reg32(void *priv, unsigned long addr)
{
	unsigned int val;
	struct zep_shim_bus_qspi_priv *qspi_priv = priv;
	struct qspi_dev *dev;

	dev = qspi_priv->qspi_dev;

	if (addr < 0x0C0000) {
		dev->hl_read(addr, &val, 4);
	} else {
		dev->read(addr, &val, 4);
	}

	return val;
}

static void zep_shim_qspi_write_reg32(void *priv, unsigned long addr, unsigned int val)
{
	struct zep_shim_bus_qspi_priv *qspi_priv = priv;
	struct qspi_dev *dev;

	dev = qspi_priv->qspi_dev;

	dev->write(addr, &val, 4);
}

static void zep_shim_qspi_cpy_from(void *priv, void *dest, unsigned long addr, size_t count)
{
	struct zep_shim_bus_qspi_priv *qspi_priv = priv;
	struct qspi_dev *dev;

	dev = qspi_priv->qspi_dev;

	if (count % 4 != 0) {
		count = (count + 4) & 0xfffffffc;
	}

	dev->read(addr, dest, count);
}

static void zep_shim_qspi_cpy_to(void *priv, unsigned long addr, const void *src, size_t count)
{
	struct zep_shim_bus_qspi_priv *qspi_priv = priv;
	struct qspi_dev *dev;

	dev = qspi_priv->qspi_dev;

	if (count % 4 != 0) {
		count = (count + 4) & 0xfffffffc;
	}

	dev->write(addr, src, count);
}

static void *zep_shim_spinlock_alloc(void)
{
	struct k_sem *lock = NULL;

	lock = k_malloc(sizeof(*lock));

	if (!lock) {
		printk("%s: Unable to allocate memory for spinlock\n", __func__);
	}

	return lock;
}

static void zep_shim_spinlock_free(void *lock)
{
	k_free(lock);
}

static void zep_shim_spinlock_init(void *lock)
{
	k_sem_init(lock, 1, 1);
}

static void zep_shim_spinlock_take(void *lock)
{
	k_sem_take(lock, K_FOREVER);
}

static void zep_shim_spinlock_rel(void *lock)
{
	k_sem_give(lock);
}

static void zep_shim_spinlock_irq_take(void *lock, unsigned long *flags)
{
	k_sem_take(lock, K_FOREVER);
}

static void zep_shim_spinlock_irq_rel(void *lock, unsigned long *flags)
{
	k_sem_give(lock);
}

static int zep_shim_pr_dbg(const char *fmt, va_list args)
{
	char *mod_fmt = NULL;

	mod_fmt = k_calloc(strlen(fmt) + 1 + 3, sizeof(char));

	if (!mod_fmt) {
		printk("%s: Unable to allocate memory for mod_fmt\n", __func__);
		return -1;
	}

	strcpy(mod_fmt, "Debug: ");
	strcat(mod_fmt, fmt);

	vprintk(mod_fmt, args);

	return 0;
}

static int zep_shim_pr_info(const char *fmt, va_list args)
{
	char *mod_fmt = NULL;

	mod_fmt = k_calloc(strlen(fmt) + 1 + 3, sizeof(char));

	if (!mod_fmt) {
		printk("%s: Unable to allocate memory for mod_fmt\n", __func__);
		return -1;
	}

	strcpy(mod_fmt, "Info: ");
	strcat(mod_fmt, fmt);

	vprintk(mod_fmt, args);

	return 0;
}

static int zep_shim_pr_err(const char *fmt, va_list args)
{
	char *mod_fmt = NULL;

	mod_fmt = k_calloc(strlen(fmt) + 1 + 3, sizeof(char));

	if (!mod_fmt) {
		printk("%s: Unable to allocate memory for mod_fmt\n", __func__);
		return -1;
	}

	strcpy(mod_fmt, "Error: ");
	strcat(mod_fmt, fmt);

	vprintk(mod_fmt, args);

	return 0;
}

struct nwb {
	unsigned char *data;
	unsigned char *tail;
	int len;
	int headroom;
	void *next;
	void *priv;
	int iftype;
	void *ifaddr;
	void *dev;
	int hostbuffer;
	void *cleanup_ctx;
	void (*cleanup_cb)();
};

static void *zep_shim_nbuf_alloc(unsigned int size)
{
	struct nwb *nwb;

	nwb = (struct nwb *)k_calloc(sizeof(struct nwb), sizeof(char));

	if (!nwb)
		return NULL;

	nwb->priv = k_calloc(size, sizeof(char));

	if (!nwb->priv) {
		k_free(nwb);
		return NULL;
	}

	nwb->data = (unsigned char *)nwb->priv;
	nwb->tail = nwb->data;
	nwb->len = 0;
	nwb->headroom = 0;
	nwb->next = NULL;

	return nwb;
}

static void zep_shim_nbuf_free(void *nbuf)
{
	struct nwb *nwb;

	nwb = nbuf;

	k_free(((struct nwb *)nbuf)->priv);

	k_free(nbuf);
}

static void zep_shim_nbuf_headroom_res(void *nbuf, unsigned int size)
{
	struct nwb *nwb = (struct nwb *)nbuf;

	nwb->data += size;
	nwb->tail += size;
	nwb->headroom += size;
}

static unsigned int zep_shim_nbuf_headroom_get(void *nbuf)
{
	return ((struct nwb *)nbuf)->headroom;
}

static unsigned int zep_shim_nbuf_data_size(void *nbuf)
{
	return ((struct nwb *)nbuf)->len;
}

static void *zep_shim_nbuf_data_get(void *nbuf)
{
	return ((struct nwb *)nbuf)->data;
}

static void *zep_shim_nbuf_data_put(void *nbuf, unsigned int size)
{
	struct nwb *nwb = (struct nwb *)nbuf;
	unsigned char *data = nwb->tail;

	nwb->tail += size;
	nwb->len += size;

	return data;
}

static void *zep_shim_nbuf_data_push(void *nbuf, unsigned int size)
{
	struct nwb *nwb = (struct nwb *)nbuf;

	nwb->data -= size;
	nwb->headroom -= size;
	nwb->len += size;

	return nwb->data;
}

static void *zep_shim_nbuf_data_pull(void *nbuf, unsigned int size)
{
	struct nwb *nwb = (struct nwb *)nbuf;

	nwb->data += size;
	nwb->headroom += size;
	nwb->len -= size;

	return nwb->data;
}

#include <net/ethernet.h>
#include <net/net_core.h>

void *net_pkt_to_nbuf(struct net_pkt *pkt)
{
	struct nwb *nwb;
	unsigned char *data;
	unsigned int len;

	len = net_pkt_get_len(pkt);

	nwb = zep_shim_nbuf_alloc(len + 100);

	if (!nwb) {
		printk("Out of memory for sending frame\n");
		return NULL;
	}

	zep_shim_nbuf_headroom_res(nwb, 100);

	data = zep_shim_nbuf_data_put(nwb, len);

	net_pkt_read(pkt, data, len);

	return nwb;
}

void *net_pkt_from_nbuf(void *iface, void *frm)
{
	struct net_pkt *pkt;
	unsigned char *data;
	unsigned int len;
	struct nwb *nwb = frm;

	len = zep_shim_nbuf_data_size(nwb);

	data = zep_shim_nbuf_data_get(nwb);

	pkt = net_pkt_rx_alloc_with_buffer(iface, len, AF_UNSPEC, 0, K_FOREVER);

	if (net_pkt_write(pkt, data, len)) {
		printk("Out of memory for received frame");
		net_pkt_unref(pkt);
		pkt = NULL;
	}

	zep_shim_nbuf_free(nwb);

	return pkt;
}

static void *zep_shim_llist_node_alloc(void)
{
	struct zep_shim_llist_node *llist_node = NULL;

	llist_node = k_calloc(sizeof(*llist_node), sizeof(char));

	if (!llist_node) {
		printk("%s: Unable to allocate memory for linked list node\n", __func__);
		return NULL;
	}

	sys_dnode_init(&llist_node->head);

	return llist_node;
}

static void zep_shim_llist_node_free(void *llist_node)
{
	k_free(llist_node);
}

static void *zep_shim_llist_node_data_get(void *llist_node)
{
	struct zep_shim_llist_node *zep_llist_node = NULL;

	zep_llist_node = (struct zep_shim_llist_node *)llist_node;

	return zep_llist_node->data;
}

static void zep_shim_llist_node_data_set(void *llist_node, void *data)
{
	struct zep_shim_llist_node *zep_llist_node = NULL;

	zep_llist_node = (struct zep_shim_llist_node *)llist_node;

	zep_llist_node->data = data;
}

static void *zep_shim_llist_alloc(void)
{
	struct zep_shim_llist *llist = NULL;

	llist = k_calloc(sizeof(*llist), sizeof(char));

	if (!llist) {
		printk("%s: Unable to allocate memory for linked list\n", __func__);
	}

	return llist;
}

static void zep_shim_llist_free(void *llist)
{
	k_free(llist);
}

static void zep_shim_llist_init(void *llist)
{
	struct zep_shim_llist *zep_llist = NULL;

	zep_llist = (struct zep_shim_llist *)llist;

	sys_dlist_init(&zep_llist->head);
}

static void zep_shim_llist_add_node_tail(void *llist, void *llist_node)
{
	struct zep_shim_llist *zep_llist = NULL;
	struct zep_shim_llist_node *zep_node = NULL;

	zep_llist = (struct zep_shim_llist *)llist;
	zep_node = (struct zep_shim_llist_node *)llist_node;

	sys_dlist_append(&zep_llist->head, &zep_node->head);

	zep_llist->len += 1;
}

static void *zep_shim_llist_get_node_head(void *llist)
{
	struct zep_shim_llist_node *zep_head_node = NULL;
	struct zep_shim_llist *zep_llist = NULL;

	zep_llist = (struct zep_shim_llist *)llist;

	if (!zep_llist->len) {
		return NULL;
	}

	zep_head_node = (struct zep_shim_llist_node *)sys_dlist_peek_head(&zep_llist->head);

	return zep_head_node;
}

static void *zep_shim_llist_get_node_nxt(void *llist, void *llist_node)
{
	struct zep_shim_llist_node *zep_node = NULL;
	struct zep_shim_llist_node *zep_nxt_node = NULL;
	struct zep_shim_llist *zep_llist = NULL;

	zep_llist = (struct zep_shim_llist *)llist;
	zep_node = (struct zep_shim_llist_node *)llist_node;

	zep_nxt_node = (struct zep_shim_llist_node *)sys_dlist_peek_next(&zep_llist->head,
									 &zep_node->head);

	return zep_nxt_node;
}

static void zep_shim_llist_del_node(void *llist, void *llist_node)
{
	struct zep_shim_llist_node *zep_node = NULL;
	struct zep_shim_llist *zep_llist = NULL;

	zep_llist = (struct zep_shim_llist *)llist;
	zep_node = (struct zep_shim_llist_node *)llist_node;

	sys_dlist_remove(&zep_node->head);

	zep_llist->len -= 1;
}

static unsigned int zep_shim_llist_len(void *llist)
{
	struct zep_shim_llist *zep_llist = NULL;

	zep_llist = (struct zep_shim_llist *)llist;

	return zep_llist->len;
}

static void *zep_shim_tasklet_alloc(void)
{
	struct tasklet_struct *tasklet = NULL;

	tasklet = k_malloc(sizeof(*tasklet));

	if (!tasklet) {
		printk("%s: Unable to allocate memory for tasklet\n", __func__);
	}

	return tasklet;
}

static void zep_shim_tasklet_free(void *tasklet)
{
	k_free(tasklet);
}

static void zep_shim_tasklet_init(void *tasklet, void (*callback)(unsigned long data),
				  unsigned long data)
{
	tasklet_init(tasklet, callback, data);
}

static void zep_shim_tasklet_schedule(void *tasklet)
{
	tasklet_schedule(tasklet);
}

static void zep_shim_tasklet_kill(void *tasklet)
{
	tasklet_kill(tasklet);
}

static unsigned long zep_shim_time_get_curr_us(void)
{
	struct timeval curr_time;
	unsigned long curr_time_us = 0;

	gettimeofday(&curr_time, NULL);

	curr_time_us = (curr_time.tv_sec * 1000 * 1000) + curr_time.tv_usec;

	return curr_time_us;
}

static unsigned int zep_shim_time_elapsed_us(unsigned long start_time_us)
{
	struct timeval curr_time;
	unsigned long curr_time_us = 0;

	gettimeofday(&curr_time, NULL);

	curr_time_us = (curr_time.tv_sec * 1000 * 1000) + curr_time.tv_usec;

	return curr_time_us - start_time_us;
}

static enum wifi_nrf_status zep_shim_bus_qspi_dev_init(void *os_qspi_dev_ctx)
{
	enum wifi_nrf_status status = WIFI_NRF_STATUS_FAIL;
	struct qspi_dev *dev = NULL;

	dev = os_qspi_dev_ctx;

	status = WIFI_NRF_STATUS_SUCCESS;

	return status;
}

static void zep_shim_bus_qspi_dev_deinit(void *os_qspi_dev_ctx)
{
	struct qspi_dev *dev = NULL;

	dev = os_qspi_dev_ctx;

	dev->deinit();
}

static void *zep_shim_bus_qspi_dev_add(void *os_qspi_priv, void *osal_qspi_dev_ctx)
{
	struct zep_shim_bus_qspi_priv *zep_qspi_priv = NULL;
	struct qspi_dev *qdev = NULL;

	zep_qspi_priv = os_qspi_priv;

	func_wifi_on();

#if QSPI_IF
	qdev = qspi_dev(0); /* QSPI dev */
#else
	qdev = qspi_dev(1); /* SPIM dev */
#endif

	zep_qspi_priv->qspi_dev = qdev;
	zep_qspi_priv->dev_added = true;

	return zep_qspi_priv;
}

static void zep_shim_bus_qspi_dev_rem(void *os_qspi_dev_ctx)
{
	struct qspi_dev *dev = NULL;

	dev = os_qspi_dev_ctx;

	/* TODO: Make qspi_dev a dynamic instance and remove it here */
}

static void *zep_shim_bus_qspi_init(void)
{
	struct zep_shim_bus_qspi_priv *qspi_priv = NULL;

	qspi_priv = k_calloc(sizeof(*qspi_priv), sizeof(char));

	if (!qspi_priv) {
		printk("%s: Unable to allocate memory for qspi_priv\n", __func__);
		goto out;
	}
out:
	return qspi_priv;
}

static void zep_shim_bus_qspi_deinit(void *os_qspi_priv)
{
	struct zep_shim_bus_qspi_priv *qspi_priv = NULL;

	qspi_priv = os_qspi_priv;

	k_free(qspi_priv);
}

#ifdef RPU_SLEEP_SUPPORT
static int zep_shim_bus_qspi_ps_sleep(void *os_qspi_priv)
{
	struct zep_shim_bus_qspi_priv *qspi_priv = os_qspi_priv;

	func_rpu_sleep();

	return 0;
}

static int zep_shim_bus_qspi_ps_wake(void *os_qspi_priv)
{
	struct zep_shim_bus_qspi_priv *qspi_priv = os_qspi_priv;

	func_rpu_wake();

	return 0;
}

static int zep_shim_bus_qspi_ps_status(void *os_qspi_priv)
{
	struct zep_shim_bus_qspi_priv *qspi_priv = os_qspi_priv;

	return func_rpu_sleep_status();
}
#endif

static void zep_shim_bus_qspi_dev_host_map_get(void *os_qspi_dev_ctx,
					       struct wifi_nrf_osal_host_map *host_map)
{
	if (!os_qspi_dev_ctx || !host_map) {
		printk("%s: Invalid parameters\n", __func__);
		return;
	}

	host_map->addr = 0;
}

static void irq_work_handler(struct k_work *work)
{
	struct zep_shim_intr_priv *intr_priv = NULL;
	int ret = 0;

	intr_priv =
		(struct zep_shim_intr_priv *)CONTAINER_OF(work, struct zep_shim_intr_priv, work);

	ret = intr_priv->callbk_fn(intr_priv->callbk_data);

	if (ret) {
		printk("%s: Interrupt callback failed\n", __func__);
	}
}

static void zep_shim_irq_handler(const struct device *dev, struct gpio_callback *cb, uint32_t pins)
{
	struct zep_shim_intr_priv *intr_priv = NULL;

	intr_priv = (struct zep_shim_intr_priv *)cb;

	k_work_schedule(&intr_priv->work, K_NO_WAIT);
}

static enum wifi_nrf_status zep_shim_bus_qspi_intr_reg(void *os_dev_ctx, void *callbk_data,
						       int (*callbk_fn)(void *callbk_data))
{
	enum wifi_nrf_status status = WIFI_NRF_STATUS_FAIL;
	struct zep_shim_intr_priv *intr_priv = NULL;
	int ret = -1;

	intr_priv = k_calloc(sizeof(*intr_priv), sizeof(char));

	if (!intr_priv) {
		printk("%s: Unable to allocate memory for intr_priv\n", __func__);
		goto out;
	}

	intr_priv->callbk_data = callbk_data;
	intr_priv->callbk_fn = callbk_fn;

	k_work_init_delayable(&intr_priv->work, irq_work_handler);

	ret = func_irq_config(&intr_priv->gpio_cb_data, zep_shim_irq_handler);

	if (ret) {
		printk("%s: request_irq failed\n", __func__);
		k_free(intr_priv);
		intr_priv = NULL;
		goto out;
	}

	status = WIFI_NRF_STATUS_SUCCESS;

out:
	return status;
}

static void zep_shim_bus_qspi_intr_unreg(void *os_qspi_dev_ctx)
{
#ifdef notyet
	struct zep_shim_intr_priv *intr_priv = NULL;

	intr_priv = (struct zep_shim_intr_priv *)os_intr_priv;

	gpio_free_irq(24, &intr_priv->gpio_cb_data);

	k_free(intr_priv);
#endif
}

#ifdef RPU_SLEEP_SUPPORT
static void *zep_shim_timer_alloc(void)
{
	struct timer_list *timer = NULL;

	timer = k_malloc(sizeof(*timer));

	if (!timer)
		printk("%s: Unable to allocate memory for tasklet\n", __func__);

	return timer;
}

static void zep_shim_timer_init(void *timer, void (*callback)(unsigned long), unsigned long data)
{
	((struct timer_list *)timer)->function = callback;
	((struct timer_list *)timer)->data = data;

	init_timer(timer);
}

static void zep_shim_timer_free(void *timer)
{
	k_free(timer);
}

static void zep_shim_timer_schedule(void *timer, unsigned long duration)
{
	mod_timer(timer, duration);
}

static void zep_shim_timer_kill(void *timer)
{
	del_timer_sync(timer);
}
#endif

static const struct wifi_nrf_osal_ops wifi_nrf_os_zep_ops = {
	.mem_alloc = zep_shim_mem_alloc,
	.mem_zalloc = zep_shim_mem_zalloc,
	.mem_free = k_free,
	.mem_cpy = zep_shim_mem_cpy,
	.mem_set = zep_shim_mem_set,

	.qspi_read_reg32 = zep_shim_qspi_read_reg32,
	.qspi_write_reg32 = zep_shim_qspi_write_reg32,
	.qspi_cpy_from = zep_shim_qspi_cpy_from,
	.qspi_cpy_to = zep_shim_qspi_cpy_to,

	.spinlock_alloc = zep_shim_spinlock_alloc,
	.spinlock_free = zep_shim_spinlock_free,
	.spinlock_init = zep_shim_spinlock_init,
	.spinlock_take = zep_shim_spinlock_take,
	.spinlock_rel = zep_shim_spinlock_rel,

	.spinlock_irq_take = zep_shim_spinlock_irq_take,
	.spinlock_irq_rel = zep_shim_spinlock_irq_rel,

	.log_dbg = zep_shim_pr_dbg,
	.log_info = zep_shim_pr_info,
	.log_err = zep_shim_pr_err,

	.llist_node_alloc = zep_shim_llist_node_alloc,
	.llist_node_free = zep_shim_llist_node_free,
	.llist_node_data_get = zep_shim_llist_node_data_get,
	.llist_node_data_set = zep_shim_llist_node_data_set,

	.llist_alloc = zep_shim_llist_alloc,
	.llist_free = zep_shim_llist_free,
	.llist_init = zep_shim_llist_init,
	.llist_add_node_tail = zep_shim_llist_add_node_tail,
	.llist_get_node_head = zep_shim_llist_get_node_head,
	.llist_get_node_nxt = zep_shim_llist_get_node_nxt,
	.llist_del_node = zep_shim_llist_del_node,
	.llist_len = zep_shim_llist_len,

	.nbuf_alloc = zep_shim_nbuf_alloc,
	.nbuf_free = zep_shim_nbuf_free,
	.nbuf_headroom_res = zep_shim_nbuf_headroom_res,
	.nbuf_headroom_get = zep_shim_nbuf_headroom_get,
	.nbuf_data_size = zep_shim_nbuf_data_size,
	.nbuf_data_get = zep_shim_nbuf_data_get,
	.nbuf_data_put = zep_shim_nbuf_data_put,
	.nbuf_data_push = zep_shim_nbuf_data_push,
	.nbuf_data_pull = zep_shim_nbuf_data_pull,

	.tasklet_alloc = zep_shim_tasklet_alloc,
	.tasklet_free = zep_shim_tasklet_free,
	.tasklet_init = zep_shim_tasklet_init,
	.tasklet_schedule = zep_shim_tasklet_schedule,
	.tasklet_kill = zep_shim_tasklet_kill,

	.sleep_ms = k_msleep,
	.delay_us = k_usleep,
	.time_get_curr_us = zep_shim_time_get_curr_us,
	.time_elapsed_us = zep_shim_time_elapsed_us,

	.bus_qspi_init = zep_shim_bus_qspi_init,
	.bus_qspi_deinit = zep_shim_bus_qspi_deinit,
	.bus_qspi_dev_add = zep_shim_bus_qspi_dev_add,
	.bus_qspi_dev_rem = zep_shim_bus_qspi_dev_rem,
	.bus_qspi_dev_init = zep_shim_bus_qspi_dev_init,
	.bus_qspi_dev_deinit = zep_shim_bus_qspi_dev_deinit,
	.bus_qspi_dev_intr_reg = zep_shim_bus_qspi_intr_reg,
	.bus_qspi_dev_intr_unreg = zep_shim_bus_qspi_intr_unreg,
	.bus_qspi_dev_host_map_get = zep_shim_bus_qspi_dev_host_map_get,

#ifdef RPU_SLEEP_SUPPORT
	.timer_alloc = zep_shim_timer_alloc,
	.timer_init = zep_shim_timer_init,
	.timer_free = zep_shim_timer_free,
	.timer_schedule = zep_shim_timer_schedule,
	.timer_kill = zep_shim_timer_kill,

	.bus_qspi_ps_sleep = zep_shim_bus_qspi_ps_sleep,
	.bus_qspi_ps_wake = zep_shim_bus_qspi_ps_wake,
	.bus_qspi_ps_status = zep_shim_bus_qspi_ps_status,
#endif
};

const struct wifi_nrf_osal_ops *get_os_ops(void)
{
	return &wifi_nrf_os_zep_ops;
}
```

## src/shim.h
```c
/*
 * Copyright (c) 2022 Nordic Semiconductor ASA
 *
 * SPDX-License-Identifier: LicenseRef-Nordic-5-Clause
 */

/**
 * @brief Header containing OS interface specific declarations for the
 * Zephyr OS layer of the Wi-Fi driver.
 */

#ifndef __SHIM_H__
#define __SHIM_H__

#include <zephyr.h>
#include <drivers/gpio.h>
#include <net/net_pkt.h>

/**
 * struct zep_shim_bus_qspi_priv - Structure to hold context information for the Linux OS
 *                        shim.
 * @opriv: Pointer to OSAL context.
 * @pcie_callbk_data: Callback data to be passed to the PCIe callback functions.
 * @pcie_prb_callbk: The callback function to be called when a PCIe device
 *                   has been probed.
 * @pcie_rem_callbk: The callback function to be called when a PCIe device
 *                   has been removed.
 *
 * This structure maintains the context information necessary for the operation
 * of the Linux shim. Some of the elements of the structure need to be
 * initialized during the initialization of the Linux shim while others need to
 * be kept updated over the duration of the Linux shim operation.
 */
struct zep_shim_bus_qspi_priv {
	void *qspi_dev;

	bool dev_added;
	bool dev_init;
};


struct zep_shim_intr_priv {
	struct gpio_callback gpio_cb_data;
	void *callbk_data;
	int (*callbk_fn)(void *callbk_data);
	struct k_work_delayable work;
};


struct zep_shim_llist_node {
	sys_dnode_t head;
	void *data;
};

struct zep_shim_llist {
	sys_dlist_t head;
	unsigned int len;
};

void *net_pkt_to_nbuf(struct net_pkt *pkt);
void *net_pkt_from_nbuf(void *iface, void *frm);

#endif /* __SHIM_H__ */
```

## src/tasklet.c
```c
/*
 * Copyright (c) 2022 Nordic Semiconductor ASA
 *
 * SPDX-License-Identifier: LicenseRef-Nordic-5-Clause
 */

/**
 * @brief File containing tasklet specific definitions for the
 * Zephyr OS layer of the Wi-Fi driver.
 */

#include <zephyr.h>
#include <sys/printk.h>

#include "tasklet.h"

#define STACKSIZE 4096
#define PRIORITY 0

K_THREAD_STACK_DEFINE(thread1_stack_area, STACKSIZE);

void tasklet_cb(void *dummy1, void *dummy2, void *dummy3)
{
	struct tasklet_struct *tasklet = dummy1;

	while (1) {
		k_sem_take(&tasklet->lock, K_FOREVER);

		tasklet->callback(tasklet->data);
	}
}

void tasklet_init(struct tasklet_struct *tasklet, void (*callback)(unsigned long),
		  unsigned long data)
{
	tasklet->callback = callback;
	tasklet->data = data;

	printk("TODO : %s\n", __func__);
	printk("TODO : Can handle only 1 thread creation\n");
	printk("TODO : Use Meta-IRQ Priorities ??\n");

	k_sem_init(&tasklet->lock, 1, 1);

	tasklet->tid = k_thread_create(&tasklet->tdata, thread1_stack_area,
				       K_THREAD_STACK_SIZEOF(thread1_stack_area), tasklet_cb,
				       tasklet, NULL, NULL, PRIORITY, 0, K_NO_WAIT);
}

void tasklet_schedule(struct tasklet_struct *tasklet)
{
	k_sem_give(&tasklet->lock);
}

void tasklet_kill(struct tasklet_struct *tasklet)
{
	k_thread_abort(tasklet->tid);
}
```

## src/tasklet.h
```c
/*
 * Copyright (c) 2022 Nordic Semiconductor ASA
 *
 * SPDX-License-Identifier: LicenseRef-Nordic-5-Clause
 */

/**
 * @brief Header containing tasklet specific declarations for the
 * Zephyr OS layer of the Wi-Fi driver.
 */

#ifndef __TASKLET_H__
#define __TASKLET_H__

struct tasklet_struct {
	struct k_sem lock;
	void (*callback)(unsigned long data);
	unsigned long data;
	k_tid_t tid;
	struct k_thread tdata;
};

void tasklet_init(struct tasklet_struct *tasklet, void (*callback)(unsigned long callbk_data),
		  unsigned long data);

void tasklet_schedule(struct tasklet_struct *tasklet);

void tasklet_kill(struct tasklet_struct *tasklet);

#endif /* __TASKLET_H__ */
```

## src/timer.c
```c
/*
 * Copyright (c) 2022 Nordic Semiconductor ASA
 *
 * SPDX-License-Identifier: LicenseRef-Nordic-5-Clause
 */

/**
 * @brief File containing timer specific definitons for the
 * Zephyr OS layer of the Wi-Fi driver.
 */

#include <zephyr.h>
#include <sys/printk.h>
#include <drivers/gpio.h>
#include <stdio.h>
#include <string.h>

#include "timer.h"

static void my_expiry_function(struct k_work *work)
{
	struct timer_list *timer;

	timer = (struct timer_list *)CONTAINER_OF(work, struct timer_list, work);

	timer->function(timer->data);
}

void init_timer(struct timer_list *timer)
{
	k_work_init_delayable(&timer->work, my_expiry_function);
}

void mod_timer(struct timer_list *timer, int msec)
{
	k_work_schedule(&timer->work, K_MSEC(msec));
}

void del_timer_sync(struct timer_list *timer)
{
	k_work_cancel_delayable(&timer->work);
}
```

## src/timer.h
```c
/*
 * Copyright (c) 2022 Nordic Semiconductor ASA
 *
 * SPDX-License-Identifier: LicenseRef-Nordic-5-Clause
 */

/**
 * @brief Header containing timer specific declarations for the
 * Zephyr OS layer of the Wi-Fi driver.
 */
#ifndef __TIMER_H__
#define __TIMER_H__

struct timer_list {
	struct k_timer k_timer;
	void (*function)(unsigned long data);
	unsigned long data;
};

void init_timer(struct timer_list *timer);

void mod_timer(struct timer_list *timer, int msec);

void del_timer_sync(struct timer_list *timer);

#endif /* __TIMER_H__ */
```

## src/util.c
```c
/*
 * Copyright (c) 2022 Nordic Semiconductor ASA
 *
 * SPDX-License-Identifier: LicenseRef-Nordic-5-Clause
 */

/**
 * @brief File containing utility function definitions for the
 * Zephyr OS layer of the Wi-Fi driver.
 */

#include <zephyr.h>
#include <sys/printk.h>
#include <stdio.h>
#include <string.h>

int hex_str_to_val(unsigned char *hex_arr, unsigned int hex_arr_sz, unsigned char *str)
{
	int i = 0;
	int j = 0;
	unsigned char ch = 0;
	unsigned char val = 0;
	int len = 0;

	len = strlen(str);

	if (len / 2 > hex_arr_sz) {
		printk("%s: String length (%d) greater than array size (%d)\n", __func__, len,
		       hex_arr_sz);
		return -1;
	}

	if (len % 2) {
		printk("%s:String length = %d, is not the multiple of 2\n", __func__, len);
		return -1;
	}

	memset(hex_arr, 0, hex_arr_sz);

	for (i = 0; i < len; i++) {
		/* Convert to lower case */
		ch = ((str[i] >= 'A' && str[i] <= 'Z') ? str[i] + 32 : str[i]);

		if ((ch < '0' || ch > '9') && (ch < 'a' || ch > 'f')) {
			printk("%s: Invalid hex character in string %d\n", __func__, ch);
			return -1;
		}

		if (ch >= '0' && ch <= '9') {
			ch = ch - '0';
		} else {
			ch = ch - 'a' + 10;
		}

		val += ch;

		if (!(i % 2)) {
			val <<= 4;
		} else {
			hex_arr[j] = val;
			j++;
			val = 0;
		}
	}

	return j;
}
```

## src/zephyr_disp_scan.c
```c
/*
 * Copyright (c) 2022 Nordic Semiconductor ASA
 *
 * SPDX-License-Identifier: LicenseRef-Nordic-5-Clause
 */

/**
 * @brief File containing display scan specific definitions for the
 * Zephyr OS layer of the Wi-Fi driver.
 */

#include <stdlib.h>
#include <zephyr.h>
#include "fmac_api.h"
#include "zephyr_fmac_main.h"
#include "zephyr_disp_scan.h"

int wifi_nrf_disp_scan_zep(const struct device *dev, scan_result_cb_t cb)
{
	enum wifi_nrf_status status = WIFI_NRF_STATUS_FAIL;
	struct wifi_nrf_ctx_zep *rpu_ctx_zep = NULL;
	struct wifi_nrf_vif_ctx_zep *vif_ctx_zep = NULL;
	struct img_umac_scan_info scan_info;
	int ret = -1;

	vif_ctx_zep = dev->data;
	rpu_ctx_zep = vif_ctx_zep->rpu_ctx_zep;

	if (!vif_ctx_zep) {
		printk("%s: vif_ctx_zep is NULL\n", __func__);
		goto out;
	}

	vif_ctx_zep->disp_scan_cb = cb;

	memset(&scan_info, 0, sizeof(scan_info));

	scan_info.scan_mode = AUTO_SCAN;
	scan_info.scan_reason = SCAN_DISPLAY;

	status = wifi_nrf_fmac_scan(rpu_ctx_zep->rpu_ctx, vif_ctx_zep->vif_idx, &scan_info);

	if (status != WIFI_NRF_STATUS_SUCCESS) {
		printk("%s: wifi_nrf_fmac_scan failed\n", __func__);
		goto out;
	}

	vif_ctx_zep->scan_type = SCAN_DISPLAY;
	vif_ctx_zep->scan_in_progress = true;

	ret = 0;
out:
	return ret;
}

enum wifi_nrf_status wifi_nrf_disp_scan_res_get_zep(struct wifi_nrf_vif_ctx_zep *vif_ctx_zep)
{
	enum wifi_nrf_status status = WIFI_NRF_STATUS_FAIL;
	struct wifi_nrf_ctx_zep *rpu_ctx_zep = NULL;

	rpu_ctx_zep = vif_ctx_zep->rpu_ctx_zep;

	status = wifi_nrf_fmac_scan_res_get(rpu_ctx_zep->rpu_ctx, vif_ctx_zep->vif_idx,
					    SCAN_DISPLAY);

	if (status != WIFI_NRF_STATUS_SUCCESS) {
		printk("%s: wifi_nrf_fmac_scan failed\n", __func__);
		goto out;
	}

	status = WIFI_NRF_STATUS_SUCCESS;
out:
	return status;
}

void wifi_nrf_event_proc_disp_scan_res_zep(void *vif_ctx,
					   struct img_umac_event_new_scan_display_results *scan_res,
					   bool more_res)
{
	struct wifi_nrf_vif_ctx_zep *vif_ctx_zep = NULL;
	struct umac_display_results *r = NULL;
	struct wifi_scan_result res;
	unsigned int i = 0;

	vif_ctx_zep = vif_ctx;

	for (i = 0; i < scan_res->event_bss_count; i++) {
		memset(&res, 0x0, sizeof(res));

		r = &scan_res->display_results[i];

		res.ssid_length = MIN(sizeof(res.ssid), r->ssid.img_ssid_len);

		res.channel = r->nwk_channel;
		res.security = WIFI_SECURITY_TYPE_NONE;

		/* TODO : show other security modes as PSK */
		if (r->security_type != IMG_OPEN) {
			res.security = WIFI_SECURITY_TYPE_PSK;
		}

		memcpy(res.ssid, r->ssid.img_ssid, res.ssid_length);

		if (r->signal.signal_type == IMG_SIGNAL_TYPE_MBM) {
			int val = (r->signal.signal.mbm_signal);

			res.rssi = (val / 100);
		} else if (r->signal.signal_type == IMG_SIGNAL_TYPE_UNSPEC) {
			res.rssi = (r->signal.signal.unspec_signal);
		}

		vif_ctx_zep->disp_scan_cb(vif_ctx_zep->zep_net_if_ctx, 0, &res);

		/* NET_MGMT dropping events if too many are queued */
		k_yield();
	}

	if (more_res == false) {
		vif_ctx_zep->disp_scan_cb(vif_ctx_zep->zep_net_if_ctx, 0, NULL);

		vif_ctx_zep->scan_in_progress = false;
	}
}
```
