## drivers/wifi/Kconfig
```kconfig
#
# Copyright (c) 2018-2020 Nordic Semiconductor ASA
#
# SPDX-License-Identifier: LicenseRef-Nordic-5-Clause
#

menu "NRF WiFi Drivers"

rsource "nrf700x/Kconfig"

endmenu
```

## drivers/wifi/nrf700x/Kconfig
```kconfig
# Nordic Wi-Fi driver for nRF700x
#
# Copyright (c) 2022 Nordic Semiconductor
#
# SPDX-License-Identifier: LicenseRef-Nordic-5-Clause
#

config NRF_700X
	bool "nRF700x driver"
	select NRFX_QSPI
	select WPA_SUPP
	select NRFX_SPIM
	select NRFX_SPIM3
	select NRFX_SPIM4
	select WIFI
	select SPI
	help
	  Nordic Wi-Fi Driver

module = WIFI_NRF
module-str = WIFI_NRF
source "subsys/logging/Kconfig.template.log_config"
```

## dts/bindings/wifi/nordic,nrf7002-qspi.yaml
```yaml
# Copyright (c) 2022 Nordic Semiconductor ASA
# SPDX-License-Identifier: Apache-2.0


description: This is a representation of the nRF7002 WiFi chip.

compatible: "nordic,nrf7002-qspi"

include: "nordic,nrf7002.yaml"

on-bus: qspi

properties:
  sck-frequency:
    type: int
    required: true
    description: |
      Maximum clock speed supported by the device, in Hz.

  reg:
    type: int
    required: true

  label:
    type: string
    required: true
```

## samples/wifi/ps_client/sample.yaml
```yaml
sample:
  description: Wi-Fi power save client sample
    application
  name: Wi-Fi power save client sample
tests:
  sample.ps_client:
    build_only: true
    integration_platforms:
      - nrf7002dk_nrf5340_cpuapp
    platform_allow: nrf7002dk_nrf5340_cpuapp
    tags: ci_build
```

## subsys/net/lib/wifi_ready/Kconfig
```kconfig
#
# Copyright (c) 2024 Nordic Semiconductor
#
# SPDX-License-Identifier: LicenseRef-Nordic-5-Clause
#

menuconfig WIFI_READY_EVENT_HANDLING
	bool "WIFI ready event handling"
	select EXPERIMENTAL
	help
	  Enable WiFi ready management subsystem.

if WIFI_READY_EVENT_HANDLING

module = WIFI_READY_EVENT_HANDLING
module-str = wifi_ready_event_handling
source "subsys/logging/Kconfig.template.log_config"

endif
```

## tests/wifi/memtest/Kconfig
```kconfig
# Configuration opions for Wi-Fi test

# Copyright (c) 2023 Nordic Semiconductor ASA
# SPDX-License-Identifier: Apache-2.0


source "Kconfig.zephyr"

# The purpose of this Kconfig is to select the hidden symbol
config WIFI_MEM_TEST_ENABLE
	bool "Enable Wi-Fi memory test"
	default y
```

## tests/wifi/memtest/testcase.yaml
```yaml
tests:
  wifi.memtest:
    integration_platforms:
      - nrf7002dk/nrf5340/cpuapp
    tags: wifi
```

## tests/wifi/raw_tx/testcase.yaml
```yaml
tests:
  wifi.raw_tx:
    platform_allow: nrf7002dk_nrf5340_cpuapp nrf9160dk_nrf9160_ns
    integration_platforms:
      - nrf7002dk_nrf5340_cpuapp
      - nrf9160dk_nrf9160_ns
    tags: wifi_raw_tx
```
