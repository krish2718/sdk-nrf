## CMakeLists.txt
```
#
# Copyright (c) 2026 Nordic Semiconductor ASA
#
# SPDX-License-Identifier: LicenseRef-Nordic-5-Clause
#

cmake_minimum_required(VERSION 3.20.0)

find_package(Zephyr REQUIRED HINTS $ENV{ZEPHYR_BASE})
project(net_host_tput)

set(ZPERF_DIR ${ZEPHYR_BASE}/samples/net/zperf)

target_sources(app PRIVATE
  ${ZPERF_DIR}/src/main.c
  src/bench.c
  )

target_sources_ifdef(CONFIG_BENCH_NULL_ETH app PRIVATE src/null_eth.c)
target_sources_ifdef(CONFIG_BENCH_RAW_TX app PRIVATE src/raw_tx.c)

if(CONFIG_NET_SAMPLE_CODE_RELOCATE)
  zephyr_code_relocate(LIBRARY subsys__net__ip
    LOCATION "${CONFIG_NET_SAMPLE_CODE_RAM_NAME}_TEXT" NOKEEP)
  zephyr_code_relocate(LIBRARY subsys__net
    LOCATION "${CONFIG_NET_SAMPLE_CODE_RAM_NAME}_TEXT" NOKEEP)
  zephyr_code_relocate(LIBRARY drivers__net
    LOCATION "${CONFIG_NET_SAMPLE_CODE_RAM_NAME}_TEXT" NOKEEP)
  zephyr_code_relocate(LIBRARY lib__net_buf
    LOCATION "${CONFIG_NET_SAMPLE_CODE_RAM_NAME}_TEXT" NOKEEP)
  zephyr_code_relocate(LIBRARY zperf
    LOCATION "${CONFIG_NET_SAMPLE_CODE_RAM_NAME}_TEXT" NOKEEP)
endif()

# Core-local TCM (APP_RAM0, renamed by tcm.overlay) is 32 KB, so only the
# UDP TX hot path fits; net_if.c (24 KB) stays in MRAM.
if(CONFIG_BENCH_LOCAL_RAM_HOTPATH)
  if(CONFIG_BENCH_NULL_ETH)
    set(l2_hot
      ${CMAKE_CURRENT_SOURCE_DIR}/src/null_eth.c
      ${ZEPHYR_BASE}/subsys/net/l2/ethernet/ethernet.c
      )
  else()
    set(l2_hot ${ZEPHYR_BASE}/drivers/net/loopback.c)
  endif()

  if(CONFIG_BENCH_RAW_TX)
    list(APPEND l2_hot
      ${CMAKE_CURRENT_SOURCE_DIR}/src/raw_tx.c
      ${ZEPHYR_BASE}/subsys/net/lib/sockets/sockets_packet.c
      )
  endif()

  if(NOT CONFIG_BENCH_HOTPATH_CSUM_IN_NVM)
    list(APPEND l2_hot ${ZEPHYR_BASE}/subsys/net/ip/utils.c)
  endif()

  zephyr_code_relocate(FILES
    ${l2_hot}
    ${ZEPHYR_BASE}/subsys/net/ip/net_context.c
    ${ZEPHYR_BASE}/subsys/net/ip/net_pkt.c
    ${ZEPHYR_BASE}/subsys/net/ip/udp.c
    ${ZEPHYR_BASE}/subsys/net/ip/ipv4.c
    ${ZEPHYR_BASE}/subsys/net/ip/net_core.c
    ${ZEPHYR_BASE}/lib/net_buf/buf.c
    ${ZEPHYR_BASE}/lib/net_buf/buf_simple.c
    ${ZEPHYR_BASE}/subsys/net/lib/sockets/sockets.c
    ${ZEPHYR_BASE}/subsys/net/lib/sockets/sockets_inet.c
    ${ZEPHYR_BASE}/subsys/net/lib/zperf/zperf_udp_uploader.c
    LOCATION ${CONFIG_BENCH_HOTPATH_REGION} NOKEEP)
endif()
```

## Kconfig
```
#
# Copyright (c) 2026 Nordic Semiconductor ASA
#
# SPDX-License-Identifier: LicenseRef-Nordic-5-Clause
#

config BENCH_LOCAL_RAM_HOTPATH
	bool "Place the UDP TX hot path in local RAM (TCM or SRAMCODE)"
	select CODE_DATA_RELOCATION

config BENCH_HOTPATH_REGION
	string "Linker region for the UDP TX hot path"
	depends on BENCH_LOCAL_RAM_HOTPATH
	default "APPTCM_TEXT"
	help
	  APPTCM_TEXT is the nRF54H20 app core local RAM (tcm.overlay). Parts
	  without core-local RAM, such as nRF7120, use SRAMCODE_TEXT together
	  with sramcode-ram01.overlay (RAM01, single-cycle for the CM33).
	  sramcode.overlay (RAM02/03, 2-cycle) is kept for the older runs.

config BENCH_HOTPATH_CSUM_IN_NVM
	bool "Keep the checksum (utils.c) out of the relocated hot path"
	depends on BENCH_LOCAL_RAM_HOTPATH
	help
	  On nRF7120, RAM02/03 are 2-cycle for the CM33 and code in SRAM is not
	  cached, so with sramcode.overlay the checksum loop runs faster from
	  cached MRAM. From RAM01 it is within ~6% of cached MRAM.

config BENCH_NULL_ETH
	bool "Ethernet L2 sink driver instead of loopback"
	depends on NET_L2_ETHERNET
	select NET_CHECKSUM_OFFLOAD_SUPPORTED

config BENCH_NULL_ETH_CSUM_OFFLOAD
	bool "Advertise TX/RX checksum offload from the sink driver"
	depends on BENCH_NULL_ETH

config BENCH_RAW_TX
	bool "Raw Ethernet frame TX benchmark (raw tx shell command)"
	depends on BENCH_NULL_ETH
	select NET_SOCKETS_PACKET
	help
	  Sends raw frames into the null driver through an AF_PACKET socket,
	  a direct net_pkt with a copy, or an external-data net_buf with no
	  copy. Prices a network processor that forwards host frames without
	  running IP/UDP/TCP itself.

source "$(ZEPHYR_BASE)/samples/net/zperf/Kconfig"
```

## prj.conf
```kconfig
# Mirrors samples/net/zperf prj.conf + overlay-loopback.conf as used for the
# nRF7120 PDK baseline (124 Mbps @ 1K), UDP TX only.
CONFIG_NETWORKING=y
CONFIG_NET_ZPERF=y
CONFIG_NET_ZPERF_SERVER=y
CONFIG_NET_LOG=y
CONFIG_NET_IPV6=y
CONFIG_NET_IPV4=y
CONFIG_NET_DHCPV4=n
CONFIG_NET_UDP=y
CONFIG_NET_TCP=y
CONFIG_NET_STATISTICS=y

CONFIG_NET_IF_UNICAST_IPV6_ADDR_COUNT=4
CONFIG_NET_IF_MCAST_IPV6_ADDR_COUNT=5
CONFIG_NET_IF_UNICAST_IPV4_ADDR_COUNT=1
CONFIG_NET_MAX_CONTEXTS=5
CONFIG_NET_TC_TX_COUNT=1
CONFIG_NET_SOCKETS=y
CONFIG_NET_SOCKETS_SERVICE_THREAD_PRIO=-1
CONFIG_ZVFS_POLL_MAX=9

CONFIG_INIT_STACKS=y
CONFIG_TEST_RANDOM_GENERATOR=y
CONFIG_NET_SHELL=y

CONFIG_NET_CONFIG_SETTINGS=y
CONFIG_NET_CONFIG_MY_IPV6_ADDR="2001:db8::1"
CONFIG_NET_CONFIG_PEER_IPV6_ADDR="2001:db8::2"
CONFIG_NET_CONFIG_MY_IPV4_ADDR="192.0.2.1"
CONFIG_NET_CONFIG_PEER_IPV4_ADDR="192.0.2.2"

CONFIG_LOG=y
CONFIG_SHELL_CMDS_RESIZE=n

CONFIG_CACHE_MANAGEMENT=y
CONFIG_SPEED_OPTIMIZATIONS=y
CONFIG_TIMESLICING=n
CONFIG_PICOLIBC_USE_MODULE=y
CONFIG_CLOCK_CONTROL=y

# Loopback, TX only
CONFIG_NET_DRIVERS=y
CONFIG_NET_LOOPBACK=y
CONFIG_NET_L2_ETHERNET=n
CONFIG_NET_LOOPBACK_MTU=1100
CONFIG_NET_LOOPBACK_SIMULATE_PACKET_DROP=y
CONFIG_NET_ZPERF_UDP_REPORT_RETANSMISSION_COUNT=0
CONFIG_NET_BUF_DATA_SIZE=1100
CONFIG_NET_PKT_RX_COUNT=32
CONFIG_NET_PKT_TX_COUNT=48
CONFIG_NET_BUF_RX_COUNT=32
CONFIG_NET_BUF_TX_COUNT=96
```

## overlay-ablate.conf
```kconfig
# Strip what the bench adds on top of a lean stack: TX goes straight from
# the caller to the driver (no TX thread), and no stats or net logging.
CONFIG_NET_TC_TX_COUNT=0
CONFIG_NET_STATISTICS=n
CONFIG_NET_LOG=n
```

## overlay-mtu1500.conf
```kconfig
CONFIG_NET_LOOPBACK_MTU=1500
CONFIG_NET_BUF_DATA_SIZE=1500
CONFIG_NET_ZPERF_MAX_PACKET_SIZE=1472
```

## overlay-nulleth.conf
```kconfig
CONFIG_NET_LOOPBACK=n
CONFIG_NET_L2_ETHERNET=y
CONFIG_NET_ARP=y
CONFIG_BENCH_NULL_ETH=y
CONFIG_NET_LOOPBACK_SIMULATE_PACKET_DROP=n
CONFIG_ETH_DRIVER=n
# Ethernet header + 1472 B UDP payload must fit one buffer, as with loopback.
CONFIG_NET_BUF_DATA_SIZE=1536
```

## overlay-pdk-hot.conf
```kconfig
CONFIG_BENCH_LOCAL_RAM_HOTPATH=y
CONFIG_BENCH_HOTPATH_REGION="SRAMCODE_TEXT"
```

## overlay-pdk-reloc.conf
```kconfig
CONFIG_NET_SAMPLE_CODE_RELOCATE=y
CONFIG_NET_SAMPLE_CODE_RAM_NAME="SRAMCODE"
```

## overlay-raw.conf
```kconfig
# Raw frame TX modes (raw tx). Adds packet sockets; the UDP path is unchanged.
CONFIG_BENCH_RAW_TX=y
CONFIG_NET_MAX_CONTEXTS=6
```

## sramcode-ram00.overlay
```dts
/*
 * Relocated code in the top 128 KB of RAM00, in the same RAM block as all
 * data. Control case for sramcode-ram01.overlay: same single-cycle latency,
 * but code fetch and data share one block.
 */
/delete-node/ &ram00_sram;
/delete-node/ &ram01_sram;
/delete-node/ &ram02_sram;
/delete-node/ &ram03_sram;

&cpuapp_sram {
	reg = <0x0 DT_SIZE_K(384)>;
	ranges = <0x0 0x0 DT_SIZE_K(384)>;
};

&sram {
	sramcode: memory@60000 {
		compatible = "zephyr,memory-region", "mmio-sram";
		reg = <0x60000 DT_SIZE_K(128)>;
		zephyr,memory-region = "SRAMCODE";
	};
};
```

## sramcode-ram01.overlay
```dts
/*
 * Relocated code in RAM01 (single-cycle for the CM33), data in RAM00 only.
 * RAM02/03 are 2-cycle for the CM33, so sramcode.overlay pays that on every
 * uncached fetch. Code and data stay in separate RAM blocks to limit S-AHB
 * contention. RAM02/03 are left unused.
 */
/delete-node/ &ram01_sram;
/delete-node/ &ram02_sram;
/delete-node/ &ram03_sram;

&cpuapp_sram {
	reg = <0x0 DT_SIZE_K(512)>;
	ranges = <0x0 0x0 DT_SIZE_K(512)>;
};

&sram {
	sramcode: memory@80000 {
		compatible = "zephyr,memory-region", "mmio-sram";
		reg = <0x80000 DT_SIZE_K(256)>;
		zephyr,memory-region = "SRAMCODE";
	};
};
```

## sramcode.overlay
```dts
/*
 * nRF7120 has no core-local RAM. Carve RAM02 + RAM03 (top 248 KB of SRAM)
 * out of cpuapp_sram as a separate region for relocated code. The KMU push
 * area must stay at RAM_ADDR, which rules out relocating into the main SRAM
 * region. Full net stack relocation needs ~128 KB, more than RAM03 alone.
 * The region name cannot contain '_' (gen_relocate_app.py).
 */
/delete-node/ &ram02_sram;
/delete-node/ &ram03_sram;

&cpuapp_sram {
	reg = <0x0 DT_SIZE_K(768)>;
	ranges = <0x0 0x0 DT_SIZE_K(768)>;
};

&sram {
	sramcode: memory@c0000 {
		compatible = "zephyr,memory-region", "mmio-sram";
		reg = <0xc0000 (DT_SIZE_K(248) - 0x20)>;
		zephyr,memory-region = "SRAMCODE";
	};
};
```

## tcm.overlay
```dts
/* gen_relocate_app.py cannot parse region names containing '_'. */
&cpuapp_tcm_region {
	zephyr,memory-region = "APPTCM";
};
```

## src/bench.c
```c
/*
 * Copyright (c) 2026 Nordic Semiconductor ASA
 *
 * SPDX-License-Identifier: LicenseRef-Nordic-5-Clause
 */

#include <zephyr/kernel.h>
#include <zephyr/shell/shell.h>
#include <zephyr/drivers/clock_control/nrf_clock_control.h>

#include <stdlib.h>
#include <string.h>

#include <cmsis_core.h>

#define HAS_CPU_DVFS DT_NODE_EXISTS(DT_NODELABEL(cpuapp_hsfll))

#if HAS_CPU_DVFS
static const struct device *const cpu_clk = DEVICE_DT_GET(DT_NODELABEL(cpuapp_hsfll));
static struct nrf_clock_spec cur_spec;
static bool have_req;
#endif

static uint32_t measure_cpu_hz(void)
{
	uint64_t hw_hz = sys_clock_hw_cycles_per_sec();
	uint64_t cycles = 0;
	uint64_t t0;
	uint32_t prev, now;
	unsigned int key;

	/*
	 * DWT CYCCNT does not count on this part without debug authentication,
	 * so use SysTick on the core clock. It is free since GRTC is the system
	 * timer. 24-bit down-counter wraps every ~50 ms at 320 MHz, hence the
	 * tight polling loop.
	 */
	SysTick->LOAD = SysTick_LOAD_RELOAD_Msk;
	SysTick->VAL = 0;
	SysTick->CTRL = SysTick_CTRL_CLKSOURCE_Msk | SysTick_CTRL_ENABLE_Msk;

	key = irq_lock();
	prev = SysTick->VAL;
	t0 = k_cycle_get_64();
	while ((k_cycle_get_64() - t0) < hw_hz / 4) {
		now = SysTick->VAL;
		cycles += (prev - now) & SysTick_LOAD_RELOAD_Msk;
		prev = now;
	}
	irq_unlock(key);

	SysTick->CTRL = 0;

	return (uint32_t)(cycles * 4U);
}

uint32_t bench_cpu_hz(void)
{
	return measure_cpu_hz();
}

static int cmd_clk(const struct shell *sh, size_t argc, char **argv)
{
#if !HAS_CPU_DVFS
	/* Fixed app core clock (e.g. nRF7120 HFPLL): report it so sweeps still log cpu_hz. */
	shell_print(sh, "cpu_hz=%u", measure_cpu_hz());

	return 0;
#else
	struct nrf_clock_spec spec = {0};
	struct onoff_client cli;
	unsigned long mhz = strtoul(argv[1], NULL, 10);
	int res = 0;
	int ret;

	if (mhz == 0) {
		shell_error(sh, "invalid clock: %s", argv[1]);
		return -EINVAL;
	}

	spec.frequency = MHZ(mhz);

	sys_notify_init_spinwait(&cli.notify);
	ret = nrf_clock_control_request(cpu_clk, &spec, &cli);
	if (ret < 0) {
		shell_error(sh, "request failed: %d", ret);
		return ret;
	}

	do {
		ret = sys_notify_fetch_result(&cli.notify, &res);
		k_yield();
	} while (ret == -EAGAIN);

	if (ret || res) {
		shell_error(sh, "clock change failed: %d/%d", ret, res);
		return -EIO;
	}

	if (have_req) {
		nrf_clock_control_release(cpu_clk, &cur_spec);
	}

	cur_spec = spec;
	have_req = true;

	shell_print(sh, "cpu_hz=%u", measure_cpu_hz());

	return 0;
#endif
}

static int cmd_freq(const struct shell *sh, size_t argc, char **argv)
{
	shell_print(sh, "cpu_hz=%u", measure_cpu_hz());

	return 0;
}

/* Internal to subsys/net/ip (net_private.h); used here to price checksum offload. */
uint16_t calc_chksum(uint16_t sum_in, const uint8_t *data, size_t len);

static uint8_t src_buf[1536] __aligned(4);
static uint8_t dst_buf[1536] __aligned(4);
/* Keeps the compiler from dropping the timed calls as dead code. */
static volatile uint16_t sink;

static int cmd_perbyte(const struct shell *sh, size_t argc, char **argv, bool csum)
{
	size_t len = strtoul(argv[1], NULL, 10);
	uint32_t iters = strtoul(argv[2], NULL, 10);
	uint32_t hz = measure_cpu_hz();
	uint64_t t0, us;
	unsigned int key;

	if (len == 0 || len > sizeof(src_buf) || iters == 0) {
		return -EINVAL;
	}

	for (size_t i = 0; i < sizeof(src_buf); i++) {
		src_buf[i] = (uint8_t)i;
	}

	key = irq_lock();
	t0 = k_cycle_get_64();
	for (uint32_t i = 0; i < iters; i++) {
		if (csum) {
			sink = calc_chksum(0, src_buf, len);
		} else {
			memcpy(dst_buf, src_buf, len);
			sink = dst_buf[i % len];
		}
	}
	us = k_cyc_to_us_floor64(k_cycle_get_64() - t0);
	irq_unlock(key);

	/* Fixed-point x1000 to keep float printing out of the shell. */
	shell_print(sh, "%s len=%u cpu_hz=%u cycles_per_call=%llu milli_cycles_per_byte=%llu",
		    csum ? "csum" : "memcpy", len, hz,
		    us * hz / 1000000ULL / iters,
		    us * hz / 1000ULL / iters / len);

	return 0;
}

static int cmd_csum(const struct shell *sh, size_t argc, char **argv)
{
	return cmd_perbyte(sh, argc, argv, true);
}

static int cmd_memcpy(const struct shell *sh, size_t argc, char **argv)
{
	return cmd_perbyte(sh, argc, argv, false);
}

/* NRF_MRAMC is the secure alias, so a non-secure build would fault on it. */
#if defined(NRF_MRAMC) && defined(MRAMC_WAITSTATES_WAITSTATENUM_Msk) && \
	!defined(CONFIG_TRUSTED_EXECUTION_NONSECURE)
#define HAS_MRAMC_WS 1
#else
#define HAS_MRAMC_WS 0
#endif

#if defined(NRF_ICACHE) && defined(CACHE_PROFILING_ENABLE_ENABLE_Msk)
#define HAS_ICACHE_PROF 1
#else
#define HAS_ICACHE_PROF 0
#endif

/* Same bit, 1 while busy: READY on nRF7120, BUSY on nRF54H20. */
#if defined(CACHE_STATUS_READY_Msk)
#define BENCH_CACHE_BUSY_Msk CACHE_STATUS_READY_Msk
#elif defined(CACHE_STATUS_BUSY_Msk)
#define BENCH_CACHE_BUSY_Msk CACHE_STATUS_BUSY_Msk
#endif

#if HAS_MRAMC_WS
static uint32_t mram_ws_get(void)
{
	return (NRF_MRAMC->WAITSTATES & MRAMC_WAITSTATES_WAITSTATENUM_Msk) >>
	       MRAMC_WAITSTATES_WAITSTATENUM_Pos;
}
#endif

static int cmd_mem(const struct shell *sh, size_t argc, char **argv)
{
	shell_print(sh, "cpu_hz=%u", measure_cpu_hz());
#if HAS_MRAMC_WS
	shell_print(sh, "mramc_waitstates=0x%08x mram_ws=%u mramc_config=0x%08x",
		    NRF_MRAMC->WAITSTATES, mram_ws_get(), NRF_MRAMC->CONFIG);
#endif
#if HAS_ICACHE_PROF
	shell_print(sh, "icache_enable=%u icache_status=0x%08x prof_enable=%u",
		    NRF_ICACHE->ENABLE, NRF_ICACHE->STATUS, NRF_ICACHE->PROFILING.ENABLE);
#endif
	return 0;
}

static int cmd_ws(const struct shell *sh, size_t argc, char **argv)
{
#if HAS_MRAMC_WS
	uint32_t ws = strtoul(argv[1], NULL, 10);
	uint32_t reg;

	if (ws < MRAMC_WAITSTATES_WAITSTATENUM_Min || ws > MRAMC_WAITSTATES_WAITSTATENUM_Max) {
		shell_error(sh, "ws out of range %lu..%lu", MRAMC_WAITSTATES_WAITSTATENUM_Min,
			    MRAMC_WAITSTATES_WAITSTATENUM_Max);
		return -EINVAL;
	}

	/* KEY is write-only; the other control bits must be written back unchanged. */
	reg = NRF_MRAMC->WAITSTATES & ~(MRAMC_WAITSTATES_WAITSTATENUM_Msk |
					MRAMC_WAITSTATES_KEY_Msk);
	reg |= (ws << MRAMC_WAITSTATES_WAITSTATENUM_Pos) |
	       (MRAMC_WAITSTATES_KEY_Enable << MRAMC_WAITSTATES_KEY_Pos);
	NRF_MRAMC->WAITSTATES = reg;
	__DSB();
	__ISB();

	/* MRAMC keeps the old value for settings below its floor (4 and 3 at 256 MHz). */
	if (mram_ws_get() != ws) {
		shell_error(sh, "ws %u rejected, mram_ws=%u", ws, mram_ws_get());
		return -EIO;
	}

	shell_print(sh, "mram_ws=%u", mram_ws_get());
	return 0;
#else
	return -ENOTSUP;
#endif
}

static int cmd_icache(const struct shell *sh, size_t argc, char **argv)
{
#if HAS_ICACHE_PROF
	bool on = strcmp(argv[1], "on") == 0;

	if (on) {
		NRF_ICACHE->TASKS_INVALIDATECACHE = 1;
		while (NRF_ICACHE->STATUS & BENCH_CACHE_BUSY_Msk) {
		}
	}
	NRF_ICACHE->ENABLE = on;
	__DSB();
	__ISB();

	shell_print(sh, "icache_enable=%u", NRF_ICACHE->ENABLE);
	return 0;
#else
	return -ENOTSUP;
#endif
}

static int cmd_prof(const struct shell *sh, size_t argc, char **argv)
{
#if HAS_ICACHE_PROF
	if (strcmp(argv[1], "clear") == 0) {
		NRF_ICACHE->PROFILING.ENABLE = 1;
		NRF_ICACHE->PROFILING.CLEAR = 1;
		return 0;
	}

	shell_print(sh, "icache_hit=%u icache_miss=%u", NRF_ICACHE->PROFILING.HIT,
		    NRF_ICACHE->PROFILING.MISS);
	return 0;
#else
	return -ENOTSUP;
#endif
}

SHELL_STATIC_SUBCMD_SET_CREATE(bench_cmds,
	SHELL_CMD_ARG(clk, NULL, "Request app core clock: clk <MHz>", cmd_clk, 2, 0),
	SHELL_CMD(freq, NULL, "Measure app core clock", cmd_freq),
	SHELL_CMD_ARG(csum, NULL, "Time calc_chksum: csum <len> <iters>", cmd_csum, 3, 0),
	SHELL_CMD_ARG(memcpy, NULL, "Time memcpy: memcpy <len> <iters>", cmd_memcpy, 3, 0),
	SHELL_CMD(mem, NULL, "Dump MRAM wait states and I-cache state", cmd_mem),
	SHELL_CMD_ARG(ws, NULL, "Set MRAM read wait states: ws <n>", cmd_ws, 2, 0),
	SHELL_CMD_ARG(icache, NULL, "I-cache: icache <on|off>", cmd_icache, 2, 0),
	SHELL_CMD_ARG(prof, NULL, "I-cache profiling: prof <clear|show>", cmd_prof, 2, 0),
	SHELL_SUBCMD_SET_END
);

SHELL_CMD_REGISTER(bench, &bench_cmds, "Throughput benchmark helpers", NULL);
```

## src/null_eth.c
```c
/*
 * Copyright (c) 2026 Nordic Semiconductor ASA
 *
 * SPDX-License-Identifier: LicenseRef-Nordic-5-Clause
 */

/*
 * Ethernet L2 sink: send() only counts the frame and returns 0, then
 * ethernet_send() drops the last reference and frees it. Unlike the
 * loopback (dummy L2), this exercises the Ethernet L2 path and lets the
 * stack skip software checksums when offload is advertised.
 */

#include <zephyr/kernel.h>
#include <zephyr/net/ethernet.h>
#include <zephyr/net/net_if.h>
#include <zephyr/net/net_pkt.h>

struct null_eth_ctx {
	uint8_t mac[6];
	uint32_t tx_pkts;
};

static struct null_eth_ctx null_eth_data = {
	.mac = {0x02, 0x00, 0x5e, 0x10, 0x00, 0x01},
};

static enum ethernet_hw_caps null_eth_caps(const struct device *dev, struct net_if *iface)
{
	ARG_UNUSED(dev);
	ARG_UNUSED(iface);

	if (IS_ENABLED(CONFIG_BENCH_NULL_ETH_CSUM_OFFLOAD)) {
		return ETHERNET_HW_TX_CHKSUM_OFFLOAD | ETHERNET_HW_RX_CHKSUM_OFFLOAD;
	}

	return 0;
}

static int null_eth_send(const struct device *dev, struct net_pkt *pkt)
{
	struct null_eth_ctx *ctx = dev->data;

	ARG_UNUSED(pkt);
	ctx->tx_pkts++;

	return 0;
}

static void null_eth_iface_init(struct net_if *iface)
{
	const struct device *dev = net_if_get_device(iface);
	struct null_eth_ctx *ctx = dev->data;

	net_if_set_link_addr(iface, ctx->mac, sizeof(ctx->mac), NET_LINK_ETHERNET);
	ethernet_init(iface);
}

static const struct ethernet_api null_eth_api = {
	.iface_api.init = null_eth_iface_init,
	.get_capabilities = null_eth_caps,
	.send = null_eth_send,
};

ETH_NET_DEVICE_INIT(null_eth, "null_eth", NULL, NULL, &null_eth_data, NULL,
		    CONFIG_ETH_INIT_PRIORITY, &null_eth_api, NET_ETH_MTU);
```

## src/raw_tx.c
```c
/*
 * Copyright (c) 2026 Nordic Semiconductor ASA
 *
 * SPDX-License-Identifier: LicenseRef-Nordic-5-Clause
 */

/*
 * Raw Ethernet frame TX into the null driver, bypassing IP/UDP/TCP. Prices
 * what a network processor forwarding host frames would pay per frame:
 *
 *   sock  AF_PACKET SOCK_RAW sendto(): socket layer + one copy into net_buf
 *   copy  net_pkt built here, frame copied in, net_if_send_data(): no socket
 *   zc    frame wrapped in an external-data net_buf, no socket and no copy
 */

#include <zephyr/kernel.h>
#include <zephyr/shell/shell.h>
#include <zephyr/net/ethernet.h>
#include <zephyr/net/net_if.h>
#include <zephyr/net/net_pkt.h>
#include <zephyr/net/socket.h>
#include <zephyr/net_buf.h>

#include <stdlib.h>
#include <string.h>

#define RAW_ETHERTYPE 0x88B5 /* IEEE 802 local experimental */
#define RAW_MAX_FRAME 1514

uint32_t bench_cpu_hz(void);

/* Descriptors only: data stays in the caller's buffer (NET_BUF_EXTERNAL_DATA). */
NET_BUF_POOL_HEAP_DEFINE(raw_ext_pool, 8, 0, NULL);

static uint8_t frame[RAW_MAX_FRAME] __aligned(4);
static const uint8_t peer_mac[NET_ETH_ADDR_LEN] = {0x02, 0x00, 0x5e, 0x10, 0x00, 0x02};

enum raw_mode {
	RAW_SOCK,
	RAW_COPY,
	RAW_ZC,
};

static void frame_init(struct net_if *iface, size_t len)
{
	struct net_eth_hdr *hdr = (struct net_eth_hdr *)frame;

	memcpy(hdr->dst.addr, peer_mac, sizeof(hdr->dst.addr));
	memcpy(hdr->src.addr, net_if_get_link_addr(iface)->addr, sizeof(hdr->src.addr));
	hdr->type = net_htons(RAW_ETHERTYPE);

	for (size_t i = sizeof(*hdr); i < len; i++) {
		frame[i] = (uint8_t)i;
	}
}

static int send_direct(struct net_if *iface, size_t len, bool zero_copy)
{
	struct net_pkt *pkt;
	struct net_buf *buf;

	if (zero_copy) {
		buf = net_buf_alloc_with_data(&raw_ext_pool, frame, len, K_NO_WAIT);
		if (!buf) {
			return -ENOBUFS;
		}

		pkt = net_pkt_alloc_on_iface(iface, K_NO_WAIT);
		if (!pkt) {
			net_buf_unref(buf);
			return -ENOMEM;
		}

		net_pkt_append_buffer(pkt, buf);
		net_pkt_set_family(pkt, NET_AF_PACKET);
	} else {
		pkt = net_pkt_alloc_with_buffer(iface, len, NET_AF_PACKET, 0, K_NO_WAIT);
		if (!pkt) {
			return -ENOMEM;
		}

		if (net_pkt_write(pkt, frame, len) < 0) {
			net_pkt_unref(pkt);
			return -ENOBUFS;
		}
	}

	net_pkt_cursor_init(pkt);

	if (net_if_send_data(iface, pkt) == NET_DROP) {
		net_pkt_unref(pkt);
		return -EIO;
	}

	return 0;
}

static int cmd_raw(const struct shell *sh, size_t argc, char **argv)
{
	struct net_if *iface = net_if_get_first_by_type(&NET_L2_GET_NAME(ETHERNET));
	struct net_sockaddr_ll ll = {0};
	size_t len = strtoul(argv[2], NULL, 10);
	uint32_t secs = strtoul(argv[3], NULL, 10);
	uint64_t frames = 0, errors = 0;
	uint64_t t0, dt, end;
	enum raw_mode mode;
	uint32_t hz;
	int fd = -1;

	if (!strcmp(argv[1], "sock")) {
		mode = RAW_SOCK;
	} else if (!strcmp(argv[1], "copy")) {
		mode = RAW_COPY;
	} else if (!strcmp(argv[1], "zc")) {
		mode = RAW_ZC;
	} else {
		shell_error(sh, "mode must be sock, copy or zc");
		return -EINVAL;
	}

	if (!iface || len < sizeof(struct net_eth_hdr) || len > RAW_MAX_FRAME || secs == 0) {
		return -EINVAL;
	}

	frame_init(iface, len);

	if (mode == RAW_SOCK) {
		/* SOCK_RAW only accepts 0, ETH_P_ALL and a few fixed types; 0 is TX only. */
		fd = zsock_socket(NET_AF_PACKET, NET_SOCK_RAW, 0);
		if (fd < 0) {
			shell_error(sh, "socket: %d", errno);
			return -errno;
		}

		ll.sll_family = NET_AF_PACKET;
		ll.sll_protocol = net_htons(RAW_ETHERTYPE);
		ll.sll_ifindex = net_if_get_by_iface(iface);
		ll.sll_halen = NET_ETH_ADDR_LEN;
		memcpy(ll.sll_addr, peer_mac, NET_ETH_ADDR_LEN);

		if (zsock_bind(fd, (struct net_sockaddr *)&ll, sizeof(ll)) < 0) {
			shell_error(sh, "bind: %d", errno);
			zsock_close(fd);
			return -errno;
		}
	}

	hz = bench_cpu_hz();
	t0 = k_cycle_get_64();
	end = t0 + (uint64_t)secs * sys_clock_hw_cycles_per_sec();

	do {
		/* Check the clock every 32 frames to keep it out of the per-frame cost. */
		for (int i = 0; i < 32; i++) {
			int ret;

			if (mode == RAW_SOCK) {
				ret = zsock_sendto(fd, frame, len, 0, (struct net_sockaddr *)&ll,
						   sizeof(ll));
				ret = ret == (int)len ? 0 : -EIO;
			} else {
				ret = send_direct(iface, len, mode == RAW_ZC);
			}

			if (ret) {
				errors++;
			} else {
				frames++;
			}
		}
	} while (k_cycle_get_64() < end);

	dt = k_cycle_get_64() - t0;

	if (fd >= 0) {
		zsock_close(fd);
	}

	/* Fixed-point x100 for Mbps to keep float printing out of the shell. */
	shell_print(sh, "raw mode=%s len=%zu cpu_hz=%u frames=%llu errors=%llu "
		    "cycles_per_frame=%llu centi_mbps=%llu",
		    argv[1], len, hz, frames, errors,
		    frames ? (uint64_t)hz * dt / sys_clock_hw_cycles_per_sec() / frames : 0,
		    frames * len * 8ULL * 100ULL * sys_clock_hw_cycles_per_sec() / dt / 1000000ULL);

	return errors && !frames ? -EIO : 0;
}

SHELL_STATIC_SUBCMD_SET_CREATE(raw_cmds,
	SHELL_CMD_ARG(tx, NULL, "Raw frame TX: raw tx <sock|copy|zc> <frame_len> <secs>",
		      cmd_raw, 4, 0),
	SHELL_SUBCMD_SET_END
);

SHELL_CMD_REGISTER(raw, &raw_cmds, "Raw Ethernet frame TX benchmark", NULL);
```
