## CMakeLists.txt
```
#
# Copyright (c) 2026 Nordic Semiconductor ASA
#
# SPDX-License-Identifier: LicenseRef-Nordic-5-Clause
#

cmake_minimum_required(VERSION 3.20.0)

find_package(Zephyr REQUIRED HINTS $ENV{ZEPHYR_BASE})
project(x509_amazon_s3_chain)

set(gen_dir ${CMAKE_CURRENT_BINARY_DIR}/certs)
zephyr_include_directories(${gen_dir})

generate_inc_file_for_target(app data/ca_amazon_root.pem ${gen_dir}/ca_amazon_root.pem.inc)
generate_inc_file_for_target(app data/server_chain.pem ${gen_dir}/server_chain.pem.inc)

target_sources(app PRIVATE src/main.c)
```

## prj.conf
```kconfig
#
# Copyright (c) 2026 Nordic Semiconductor ASA
#
# SPDX-License-Identifier: LicenseRef-Nordic-5-Clause
#

CONFIG_ZTEST=y
CONFIG_ZTEST_FAIL_FAST=y
CONFIG_MAIN_STACK_SIZE=8192
CONFIG_ZTEST_STACK_SIZE=8192

CONFIG_ENTROPY_GENERATOR=y
CONFIG_ENTROPY_DEVICE_RANDOM_GENERATOR=y

CONFIG_NRF_SECURITY=y
CONFIG_MBEDTLS=y
CONFIG_MBEDTLS_ENABLE_HEAP=y
CONFIG_MBEDTLS_HEAP_SIZE=65536

# mbedTLS X.509 library (links mbedx509; CRT parse is on by default under this).
CONFIG_MBEDTLS_X509_LIBRARY=y

# Default y strips mbedtls_x509_crt_verify_info / mbedtls_x509_crt_info; keep them for
# failure diagnostics (NOT_TRUSTED / signature issues show up in verify_info + chain dump).
CONFIG_MBEDTLS_X509_REMOVE_INFO=n

# PSA-backed PK/RSA for certificate verify (same setting as net/download + TLS).
CONFIG_MBEDTLS_USE_PSA_CRYPTO=y

# nrf_security Kconfig only exposes CONFIG_MBEDTLS_RSA_C under LEGACY_CRYPTO_C; rsa.c is
# still built from the legacy CMake list, but operations route through PSA when USE_PSA_CRYPTO.
CONFIG_MBEDTLS_LEGACY_CRYPTO_C=y

CONFIG_MBEDTLS_RSA_C=y
CONFIG_MBEDTLS_PKCS1_V15=y
CONFIG_PSA_WANT_KEY_TYPE_RSA_KEY_PAIR_IMPORT=y
CONFIG_PSA_WANT_ALG_RSA_PKCS1V15_SIGN=y
CONFIG_PSA_WANT_ALG_RSA_PKCS1V15_SIGN_RAW=y
CONFIG_MBEDTLS_MPI_MAX_SIZE=512

# mbedTLS trace: Zephyr hook (CONFIG_MBEDTLS_DEBUG) + nrf MBEDTLS_DEBUG_C + debug.c
# linked into mbedx509 (no need for CONFIG_MBEDTLS_TLS_LIBRARY).
CONFIG_PRINTK=y

CONFIG_LOG=y
CONFIG_LOG_MODE_IMMEDIATE=y
CONFIG_MBEDTLS_DEBUG=y
CONFIG_MBEDTLS_DEBUG_C=y
CONFIG_MBEDTLS_LOG_LEVEL_DBG=y
```

## src/main.c
```c
/*
 * Copyright (c) 2026 Nordic Semiconductor ASA
 *
 * SPDX-License-Identifier: LicenseRef-Nordic-5-Clause
 */

#include <zephyr/ztest.h>
#include <zephyr/sys/printk.h>

#include <mbedtls/pk.h>
#include <mbedtls/x509.h>
#include <mbedtls/x509_crt.h>

#define AWS_S3_HOSTNAME "nrfconnectsdk.s3.eu-central-1.amazonaws.com"

static const unsigned char ca_pem[] = {
#include "ca_amazon_root.pem.inc"
	0x00
};

static const unsigned char server_chain_pem[] = {
#include "server_chain.pem.inc"
	0x00
};

/**
 * Print mbedTLS verify failure details. mbedtls_debug does not trace x509_crt_verify();
 * mbedtls_x509_crt_verify_info() and mbedtls_x509_crt_info() require
 * MBEDTLS_X509_REMOVE_INFO unset (see prj.conf).
 */
static void x509_dump_verify_failure(int ret, uint32_t flags,
				     const mbedtls_x509_crt *chain)
{
	const mbedtls_x509_crt *crt;
	int info_len;

	/* nrf_security often omits mbedtls_strerror (no MBEDTLS_ERROR_C); print code + flags. */
	printk("x509 verify: ret=%d flags=0x%x", ret, flags);
	if (ret == MBEDTLS_ERR_X509_CERT_VERIFY_FAILED) {
		printk(" (MBEDTLS_ERR_X509_CERT_VERIFY_FAILED)");
	}
	printk("\n");

	printk("leaf public key type: %d\n", mbedtls_pk_get_type(&chain->pk));

#if !defined(MBEDTLS_X509_REMOVE_INFO)
	{
		char vinfobuf[384];
		char crtbuf[1024];

		info_len = mbedtls_x509_crt_verify_info(vinfobuf, sizeof(vinfobuf), "", flags);
		if (info_len >= 0) {
			printk("%s", vinfobuf);
		}

		for (crt = chain; crt != NULL; crt = crt->next) {
			info_len = mbedtls_x509_crt_info(crtbuf, sizeof(crtbuf), "  ", crt);
			if (info_len >= 0) {
				printk("%s", crtbuf);
			}
		}
	}
#else
	ARG_UNUSED(flags);
	printk("Set CONFIG_MBEDTLS_X509_REMOVE_INFO=n for verify_info + PEM dump.\n");
#endif
}

ZTEST(x509_amazon_s3_chain, test_verify_pem_chain)
{
	mbedtls_x509_crt ca;
	mbedtls_x509_crt chain;
	int ret;
	uint32_t flags = 0;

	mbedtls_x509_crt_init(&ca);
	mbedtls_x509_crt_init(&chain);

	ret = mbedtls_x509_crt_parse(&ca, ca_pem, sizeof(ca_pem));
	zassert_equal(ret, 0, "parse CA failed: %d", ret);

	ret = mbedtls_x509_crt_parse(&chain, server_chain_pem, sizeof(server_chain_pem));
	zassert_equal(ret, 0, "parse server chain failed: %d", ret);

	ret = mbedtls_x509_crt_verify(&chain, &ca, NULL, AWS_S3_HOSTNAME, &flags, NULL, NULL);
	if (ret != 0) {
		x509_dump_verify_failure(ret, flags, &chain);
	}
	zassert_equal(ret, 0, "verify failed: ret=%d flags=0x%x", ret, flags);

	mbedtls_x509_crt_free(&chain);
	mbedtls_x509_crt_free(&ca);
}

ZTEST_SUITE(x509_amazon_s3_chain, NULL, NULL, NULL, NULL, NULL);
```
